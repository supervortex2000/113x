## buildroot/buildroot/board/amlogic/mesona1_ad403_sbr_k515/meson64_a32_ad403_linux_defconfig
```kconfig
#
# Copyright (c) 2023 Amlogic, Inc. All rights reserved.
# This source code is subject to the terms and conditions
# defined in the file 'LICENSE' which is part of this source code package.
# Description: kernel defconfig file
#
CONFIG_KERNEL_LZO=y
CONFIG_SYSVIPC=y
CONFIG_NO_HZ=y
CONFIG_HIGH_RES_TIMERS=y
CONFIG_PREEMPT=y
CONFIG_IRQ_TIME_ACCOUNTING=y
CONFIG_TASKSTATS=y
CONFIG_TASK_DELAY_ACCT=y
CONFIG_TASK_XACCT=y
CONFIG_TASK_IO_ACCOUNTING=y
CONFIG_IKCONFIG=y
CONFIG_IKCONFIG_PROC=y
CONFIG_LOG_BUF_SHIFT=18
CONFIG_BLK_DEV_INITRD=y
# CONFIG_RD_BZIP2 is not set
# CONFIG_RD_LZMA is not set
# CONFIG_RD_XZ is not set
# CONFIG_RD_LZO is not set
# CONFIG_RD_ZSTD is not set
# CONFIG_FHANDLE is not set
CONFIG_KALLSYMS_ALL=y
CONFIG_EMBEDDED=y
# CONFIG_COMPAT_BRK is not set
CONFIG_ARCH_VIRT=y
CONFIG_ARM_THUMBEE=y
# CONFIG_CACHE_L2X0 is not set
# CONFIG_ARM_ERRATA_643719 is not set
CONFIG_SMP=y
# CONFIG_SMP_ON_UP is not set
CONFIG_SCHED_MC=y
CONFIG_MCPM=y
CONFIG_HZ_1000=y
CONFIG_HIGHMEM=y
# CONFIG_ATAGS is not set
CONFIG_ARM_APPENDED_DTB=y
CONFIG_ARM_ATAG_DTB_COMPAT=y
CONFIG_CPU_FREQ=y
CONFIG_CPU_FREQ_STAT=y
CONFIG_CPU_FREQ_DEFAULT_GOV_PERFORMANCE=y
CONFIG_CPU_IDLE=y
CONFIG_ARM_CPUIDLE=y
CONFIG_ARM_PSCI_CPUIDLE=y
CONFIG_VFP=y
CONFIG_NEON=y
CONFIG_PM_AUTOSLEEP=y
CONFIG_PM_WAKELOCKS=y
CONFIG_PM_WAKELOCKS_LIMIT=0
# CONFIG_PM_WAKELOCKS_GC is not set
CONFIG_ENERGY_MODEL=y
# CONFIG_SECCOMP is not set
# CONFIG_GCC_PLUGINS is not set
CONFIG_MODULES=y
CONFIG_MODULE_UNLOAD=y
CONFIG_MODVERSIONS=y
CONFIG_PARTITION_ADVANCED=y
# CONFIG_CORE_DUMP_DEFAULT_ELF_HEADERS is not set
CONFIG_DEFAULT_MMAP_MIN_ADDR=32768
CONFIG_CMA=y
CONFIG_ZSMALLOC=y
CONFIG_NET=y
CONFIG_PACKET=y
CONFIG_UNIX=y
CONFIG_XFRM_USER=y
CONFIG_NET_KEY=y
CONFIG_INET=y
CONFIG_IP_MULTICAST=y
CONFIG_IP_ADVANCED_ROUTER=y
CONFIG_IP_MULTIPLE_TABLES=y
CONFIG_IP_PNP=y
CONFIG_IP_PNP_DHCP=y
CONFIG_IP_PNP_BOOTP=y
CONFIG_INET_ESP=y
CONFIG_INET_DIAG_DESTROY=y
CONFIG_IPV6_ROUTER_PREF=y
CONFIG_IPV6_ROUTE_INFO=y
CONFIG_IPV6_OPTIMISTIC_DAD=y
CONFIG_INET6_AH=y
CONFIG_INET6_ESP=y
CONFIG_INET6_IPCOMP=y
CONFIG_IPV6_MIP6=y
CONFIG_IPV6_MULTIPLE_TABLES=y
CONFIG_NETFILTER=y
CONFIG_NF_CONNTRACK=y
CONFIG_NF_CONNTRACK_EVENTS=y
CONFIG_NF_CONNTRACK_AMANDA=y
CONFIG_NF_CONNTRACK_FTP=y
CONFIG_NF_CONNTRACK_H323=y
CONFIG_NF_CONNTRACK_IRC=y
CONFIG_NF_CONNTRACK_NETBIOS_NS=y
CONFIG_NF_CONNTRACK_PPTP=y
CONFIG_NF_CONNTRACK_SANE=y
CONFIG_NF_CONNTRACK_TFTP=y
CONFIG_NF_CT_NETLINK=y
CONFIG_NETFILTER_XT_TARGET_CLASSIFY=y
CONFIG_NETFILTER_XT_TARGET_CONNMARK=y
CONFIG_NETFILTER_XT_TARGET_IDLETIMER=y
CONFIG_NETFILTER_XT_TARGET_MARK=y
CONFIG_NETFILTER_XT_TARGET_NFLOG=y
CONFIG_NETFILTER_XT_TARGET_NFQUEUE=y
CONFIG_NETFILTER_XT_TARGET_TPROXY=y
CONFIG_NETFILTER_XT_TARGET_TRACE=y
CONFIG_NETFILTER_XT_TARGET_TCPMSS=y
CONFIG_NETFILTER_XT_MATCH_COMMENT=y
CONFIG_NETFILTER_XT_MATCH_CONNLIMIT=y
CONFIG_NETFILTER_XT_MATCH_CONNMARK=y
CONFIG_NETFILTER_XT_MATCH_CONNTRACK=y
CONFIG_NETFILTER_XT_MATCH_HASHLIMIT=y
CONFIG_NETFILTER_XT_MATCH_HELPER=y
CONFIG_NETFILTER_XT_MATCH_IPRANGE=y
CONFIG_NETFILTER_XT_MATCH_LENGTH=y
CONFIG_NETFILTER_XT_MATCH_LIMIT=y
CONFIG_NETFILTER_XT_MATCH_MAC=y
CONFIG_NETFILTER_XT_MATCH_MARK=y
CONFIG_NETFILTER_XT_MATCH_POLICY=y
CONFIG_NETFILTER_XT_MATCH_PKTTYPE=y
CONFIG_NETFILTER_XT_MATCH_QUOTA=y
CONFIG_NETFILTER_XT_MATCH_SOCKET=y
CONFIG_NETFILTER_XT_MATCH_STATE=y
CONFIG_NETFILTER_XT_MATCH_STATISTIC=y
CONFIG_NETFILTER_XT_MATCH_STRING=y
CONFIG_NETFILTER_XT_MATCH_TIME=y
CONFIG_NETFILTER_XT_MATCH_U32=y
CONFIG_IP_NF_IPTABLES=y
CONFIG_IP_NF_MATCH_AH=y
CONFIG_IP_NF_MATCH_ECN=y
CONFIG_IP_NF_MATCH_TTL=y
CONFIG_IP_NF_FILTER=y
CONFIG_IP_NF_TARGET_REJECT=y
CONFIG_IP_NF_NAT=y
CONFIG_IP_NF_TARGET_MASQUERADE=y
CONFIG_IP_NF_TARGET_NETMAP=y
CONFIG_IP_NF_TARGET_REDIRECT=y
CONFIG_IP_NF_MANGLE=y
CONFIG_IP_NF_RAW=y
CONFIG_IP_NF_SECURITY=y
CONFIG_IP_NF_ARPTABLES=y
CONFIG_IP_NF_ARPFILTER=y
CONFIG_IP_NF_ARP_MANGLE=y
CONFIG_IP6_NF_IPTABLES=y
CONFIG_IP6_NF_FILTER=y
CONFIG_IP6_NF_TARGET_REJECT=y
CONFIG_IP6_NF_MANGLE=y
CONFIG_IP6_NF_RAW=y
CONFIG_NET_SCHED=y
CONFIG_NET_SCH_HTB=y
CONFIG_NET_CLS_U32=y
CONFIG_NET_EMATCH=y
CONFIG_NET_EMATCH_U32=y
CONFIG_NET_CLS_ACT=y
CONFIG_BT=y
CONFIG_BT_HCIUART=y
CONFIG_BT_HCIUART_H4=y
CONFIG_CFG80211=y
CONFIG_NL80211_TESTMODE=y
CONFIG_CFG80211_WEXT=y
CONFIG_MAC80211=y
CONFIG_RFKILL=y
CONFIG_DEVTMPFS=y
CONFIG_DEVTMPFS_MOUNT=y
# CONFIG_FW_CACHE is not set
CONFIG_ARM_SCPI_PROTOCOL=y
CONFIG_MTD=y
CONFIG_MTD_BLOCK=y
CONFIG_MTD_RAW_NAND=y
CONFIG_MTD_UBI=y
CONFIG_OF_OVERLAY=y
CONFIG_SRAM=y
CONFIG_INPUT_EVDEV=y
# CONFIG_INPUT_MOUSE is not set
CONFIG_INPUT_TABLET=y
CONFIG_INPUT_MISC=y
CONFIG_INPUT_UINPUT=y
# CONFIG_SERIO_SERPORT is not set
# CONFIG_VT is not set
# CONFIG_LEGACY_PTYS is not set
CONFIG_SERIAL_DEV_BUS=y
CONFIG_HW_RANDOM=y
CONFIG_I2C_CHARDEV=y
CONFIG_SPI=y
CONFIG_SPI_MEM=y
CONFIG_SPI_SPIDEV=y
CONFIG_PINCTRL=y
CONFIG_PINCTRL_SINGLE=y
CONFIG_GPIOLIB=y
CONFIG_GPIO_SYSFS=y
CONFIG_POWER_RESET=y
CONFIG_POWER_SUPPLY=y
# CONFIG_HWMON is not set
CONFIG_THERMAL=y
CONFIG_THERMAL_EMERGENCY_POWEROFF_DELAY_MS=200
CONFIG_THERMAL_WRITABLE_TRIPS=y
CONFIG_THERMAL_GOV_POWER_ALLOCATOR=y
CONFIG_CPU_THERMAL=y
CONFIG_WATCHDOG=y
CONFIG_WATCHDOG_CORE=y
CONFIG_WATCHDOG_SYSFS=y
CONFIG_MFD_SYSCON=y
CONFIG_REGULATOR=y
CONFIG_REGULATOR_FIXED_VOLTAGE=y
CONFIG_REGULATOR_GPIO=y
CONFIG_REGULATOR_PWM=m
CONFIG_MEDIA_SUPPORT=y
CONFIG_MEDIA_SUPPORT_FILTER=y
CONFIG_SOUND=y
CONFIG_SND=y
# CONFIG_SND_SPI is not set
CONFIG_SND_SOC=y
CONFIG_USB=y
CONFIG_USB_ANNOUNCE_NEW_DEVICES=y
CONFIG_USB_OTG=y
CONFIG_USB_XHCI_HCD=y
CONFIG_USB_DWC3=m
CONFIG_USB_DWC3_HOST=y
CONFIG_USB_GADGET=y
CONFIG_USB_CONFIGFS=y
CONFIG_USB_CONFIGFS_UEVENT=y
CONFIG_USB_CONFIGFS_RNDIS=y
CONFIG_USB_CONFIGFS_MASS_STORAGE=y
CONFIG_USB_CONFIGFS_F_FS=y
CONFIG_MMC=y
CONFIG_MMC_BLOCK_MINORS=16
CONFIG_MMC_SDHCI=y
CONFIG_NEW_LEDS=y
CONFIG_LEDS_CLASS=y
CONFIG_LEDS_GPIO=y
CONFIG_LEDS_PWM=y
CONFIG_LEDS_TRIGGERS=y
CONFIG_LEDS_TRIGGER_TIMER=y
CONFIG_LEDS_TRIGGER_ONESHOT=y
CONFIG_DMADEVICES=y
CONFIG_DMABUF_HEAPS=y
CONFIG_DMABUF_SYSFS_STATS=y
CONFIG_DMABUF_HEAPS_DEFERRED_FREE=y
CONFIG_DMABUF_HEAPS_PAGE_POOL=y
CONFIG_DMABUF_HEAPS_SYSTEM=m
# CONFIG_VIRTIO_MENU is not set
CONFIG_STAGING=y
CONFIG_MAILBOX=y
# CONFIG_IOMMU_SUPPORT is not set
CONFIG_PM_DEVFREQ=y
CONFIG_DEVFREQ_GOV_SIMPLE_ONDEMAND=y
CONFIG_IIO=y
CONFIG_IIO_BUFFER=y
CONFIG_PWM=y
# CONFIG_NVMEM is not set
CONFIG_AMLOGIC_DRIVER=y
CONFIG_AMLOGIC_BREAK_GKI_20=y
CONFIG_AMLOGIC_BREAK_GKI=y
CONFIG_AMLOGIC_MODIFY=y
CONFIG_AMLOGIC_IN_KERNEL_MODULES=y
CONFIG_AMLOGIC_SERIAL_MESON=y
CONFIG_AMLOGIC_SERIAL_MESON_CONSOLE=y
CONFIG_AMLOGIC_COMMON_CLK=m
CONFIG_AMLOGIC_COMMON_CLK_MESON_REGMAP=y
CONFIG_AMLOGIC_COMMON_CLK_MESON_DUALDIV=y
CONFIG_AMLOGIC_COMMON_CLK_MESON_MPLL=y
CONFIG_AMLOGIC_COMMON_CLK_MESON_PHASE=y
CONFIG_AMLOGIC_COMMON_CLK_MESON_PLL=y
CONFIG_AMLOGIC_COMMON_CLK_MESON_SCLK_DIV=y
CONFIG_AMLOGIC_COMMON_CLK_MESON_VID_PLL_DIV=y
CONFIG_AMLOGIC_COMMON_CLK_MESON_EE_CLKC=y
CONFIG_AMLOGIC_COMMON_CLK_MESON_CPU_DYNDIV=y
CONFIG_AMLOGIC_MESON_CLK_MEASURE=y
CONFIG_AMLOGIC_COMMON_CLK_A1=m
CONFIG_AMLOGIC_SECMON=m
CONFIG_AMLOGIC_DOLBY_FW=y
CONFIG_AMLOGIC_MEDIA_MODULE=m
CONFIG_AMLOGIC_MEDIA_ENABLE=y
CONFIG_AMLOGIC_MEDIA_COMMON=y
CONFIG_AMLOGIC_MEDIA_DRIVERS=y
CONFIG_AMLOGIC_MEDIA_CANVAS=y
CONFIG_AMLOGIC_POWER=m
CONFIG_AMLOGIC_CPU_INFO=m
CONFIG_AMLOGIC_SHOW_CPU_CHIPID=y
CONFIG_AMLOGIC_PM=m
CONFIG_AMLOGIC_GX_REBOOT=m
CONFIG_AMLOGIC_GPIO=m
CONFIG_AMLOGIC_GPIOLIB=y
CONFIG_AMLOGIC_MESON_IRQ_GPIO=y
CONFIG_AMLOGIC_PINCTRL_MESON=y
CONFIG_AMLOGIC_PINCTRL_MESON_A1=m
CONFIG_AMLOGIC_INPUT=m
CONFIG_AMLOGIC_GPIO_KEY=y
CONFIG_AMLOGIC_ADC_KEYPADS=y
CONFIG_AMLOGIC_I2C_MESON=m
CONFIG_AMLOGIC_SPI=m
CONFIG_AMLOGIC_SPI_MESON_SPICC=y
CONFIG_AMLOGIC_SPI_MESON_SPIFC_V2=m
CONFIG_AMLOGIC_GKI_TOOL=m
CONFIG_AMLOGIC_PWM_MESON=m
CONFIG_AMLOGIC_MESON_CPUFREQ=m
CONFIG_AMLOGIC_EFUSE_UNIFYKEY=m
CONFIG_AMLOGIC_EFUSE=y
CONFIG_AMLOGIC_UNIFYKEY=y
CONFIG_AMLOGIC_EFUSE_BURN=y
CONFIG_AMLOGIC_MHU_MBOX=m
CONFIG_AMLOGIC_JTAG_MESON=m
CONFIG_AMLOGIC_ARM_SMC_WATCHDOG=y
CONFIG_AMLOGIC_MESON_SARADC=m
CONFIG_AMLOGIC_IIO_KFIFO_BUF=y
CONFIG_AMLOGIC_COOLDEV=y
CONFIG_AMLOGIC_CPUCORE_THERMAL=y
CONFIG_AMLOGIC_GPU_THERMAL=y
CONFIG_AMLOGIC_GPUCORE_THERMAL=y
CONFIG_AMLOGIC_DDR_THERMAL=y
CONFIG_AMLOGIC_MMC_MESON_GX=m
CONFIG_AMLOGIC_AUTO_CAPTURE=y
CONFIG_AMLOGIC_USB=y
CONFIG_AMLOGIC_COMMON_USB=y
CONFIG_AMLOGIC_USB_SUPPORT=m
CONFIG_AMLOGIC_USB_DWC_OTG_HCD=m
CONFIG_AMLOGIC_CRG=y
CONFIG_AMLOGIC_USBPHY=y
CONFIG_AMLOGIC_USB2PHY=y
CONFIG_AMLOGIC_USB3PHY=y
CONFIG_AMLOGIC_USBPHYC2=y
CONFIG_AMLOGIC_BC=y
CONFIG_AMLOGIC_CC=y
CONFIG_AMLOGIC_CRYPTO_DMA=m
CONFIG_AMLOGIC_WIRELESS=m
CONFIG_AMLOGIC_BLUETOOTH=y
CONFIG_AMLOGIC_WIFI=y
CONFIG_AMLOGIC_PWM_32K=y
CONFIG_AMLOGIC_MTD_SPI_NAND=m
CONFIG_AMLOGIC_MTD_NAND=m
CONFIG_AMLOGIC_MTD_COMMON=m
CONFIG_AMLOGIC_MTD_RESV=m
CONFIG_AMLOGIC_SND_SOC=m
CONFIG_AMLOGIC_SND_SOC_AUGE=y
CONFIG_AMLOGIC_SND_SOC_COMMON=y
CONFIG_AMLOGIC_AMAUDIO=y
CONFIG_AMLOGIC_AUDIO_DSP=y
CONFIG_AMLOGIC_AUDIO_INFO=y
CONFIG_AMLOGIC_SND_SOC_CODECS=y
CONFIG_AMLOGIC_SND_CODEC_DUMMY_CODEC=m
CONFIG_AMLOGIC_SND_CODEC_A1_ACODEC=m
# CONFIG_DNOTIFY is not set
CONFIG_OVERLAY_FS=y
CONFIG_TMPFS=y
CONFIG_TMPFS_POSIX_ACL=y
CONFIG_UBIFS_FS=y
# CONFIG_NETWORK_FILESYSTEMS is not set
CONFIG_SECURITY=y
CONFIG_HARDENED_USERCOPY=y
CONFIG_CRYPTO_DES=y
# CONFIG_CRYPTO_HW is not set
CONFIG_DMA_CMA=y
CONFIG_CMA_SIZE_MBYTES=8
CONFIG_CMA_ALIGNMENT=4
CONFIG_PRINTK_TIME=y
CONFIG_CONSOLE_LOGLEVEL_DEFAULT=2
# CONFIG_SYMBOLIC_ERRNAME is not set
CONFIG_FRAME_WARN=2048
# CONFIG_SECTION_MISMATCH_WARN_ONLY is not set
CONFIG_PANIC_ON_OOPS=y
CONFIG_PANIC_TIMEOUT=5
# CONFIG_DEBUG_PREEMPT is not set
# CONFIG_RCU_TRACE is not set
# CONFIG_STRICT_DEVMEM is not set
# CONFIG_RUNTIME_TESTING_MENU is not set
```

## buildroot/buildroot/configs/a1_ad403_a32_release_defconfig
```kconfig
#----------------------------------------------------------#
#include "arch_a32_armv8_7.3.1.config"

#----------------------------------------------------------#
#include "a1_ad403.config"
BR2_TARGET_ROOTFS_INITRAMFS_LIST="board/amlogic/mesona1_ad403/initramfs/initramfs-419/ramfslist-32-ubi-release"
BR2_TARGET_CPIO_INIT_PATH="board/amlogic/mesona1_ad403"
BR2_TARGET_RECOVERY_BLACK_LIST="board/amlogic/mesona1_ad403/recovery_black_list.txt"
BR2_TARGET_RECOVERY_INITRAMFS_LIST="board/amlogic/mesona1_ad403/initramfs/initramfs-419/ramfslist-recovery"
```

## buildroot/buildroot/configs/a1_ad403_a32_soundbar_k515_release_defconfig
```kconfig
#
# Copyright (c) 2023 Amlogic, Inc. All rights reserved.
# This source code is subject to the terms and conditions defined
# in the file 'LICENSE' which is part of this source code package.
# Description: ad403 soundbar k515 default config file
#
#----------------------------------------------------------#
#include "arch_a32_10.3.config"

#----------------------------------------------------------#
#include "a1_ad403_sbr_k515.config"
BR2_TARGET_ROOTFS_INITRAMFS_LIST="board/amlogic/mesona1_ad403_sbr_k515/initramfs/initramfs-515/ramfslist-32-ubi-release"
BR2_TARGET_CPIO_INIT_PATH="board/amlogic/mesona1_ad403_sbr_k515"
BR2_TARGET_RECOVERY_BLACK_LIST="board/amlogic/mesona1_ad403_sbr_k515/recovery_black_list.txt"
BR2_TARGET_RECOVERY_INITRAMFS_LIST="board/amlogic/mesona1_ad403_sbr_k515/initramfs/initramfs-515/ramfslist-recovery"
BR2_LINUX_KERNEL_MODULES_SEQUENCE_LIST="board/amlogic/mesona1_ad403_sbr_k515/modules_sequence_list"
BR2_LINUX_KERNEL_MODULE_SOC_FAMILY="a1"
```

## buildroot/buildroot/configs/a213y_au401_a32_fastboot_release_defconfig
```kconfig
#----------------------------------------------------------#
#include "arch_a32_7.3.1.config"

#----------------------------------------------------------#
#include "a213y_au401.config"
#include "flash_nand_2k.config"

#----------------------------------------------------------#

BR2_TARGET_UBOOT_BOARDNAME="m8b_a213y_au401_fastboot"

BR2_TARGET_ROOTFS_INITRAMFS_LIST="board/amlogic/mesona213y_au401_fastboot/initramfs/ramfslist-32-ubi-release"
BR2_TARGET_RECOVERY_INITRAMFS_LIST="board/amlogic/mesona213y_au401_fastboot/initramfs/ramfslist-32-ubi-recovery"

BR2_LINUX_KERNEL_INTREE_DTS_NAME="mesona213y_au401_a330_fastboot_512m"

BR2_ROOTFS_OVERLAY="board/amlogic/mesona213y_au401_fastboot/rootfs/"
BR2_ROOTFS_UPGRADE_DIR_OVERLAY="board/amlogic/mesona213y_au401_fastboot/upgrade/"
BR2_ROOTFS_POST_BUILD_SCRIPT="$(TOPDIR)/board/amlogic/mesona213y_au401_fastboot/post_build.sh"

#----------------------delete package not used-------------------------------#
BR2_PACKAGE_BOOT_ANIMATION=y
BR2_PACKAGE_TEST_TOOLS=n
BR2_PACKAGE_LIBPLAYER=n


BR2_PACKAGE_AML_CUSTOMIZE_KERNEL=y
BR2_PACKAGE_AML_CUSTOMIZE_KERNEL_ENABLE_OPT_LIST="CONFIG_KERNEL_LZ4 CONFIG_SQUASHFS CONFIG_SQUASHFS_ZLIB CONFIG_RD_LZ4 CONFIG_SYNC_FILE CONFIG_CC_OPTIMIZE_FOR_SIZE CONFIG_THUMB2_KERNEL"
BR2_PACKAGE_AML_CUSTOMIZE_KERNEL_DISABLE_OPT_LIST="CONFIG_IPV6 CONFIG_AMLOGIC_NAND CONFIG_AMLOGIC_DEBUG CONFIG_NVMEM CONFIG_EXT4_FS CONFIG_NTFS_FS CONFIG_DEBUG_INFO CONFIG_RD_GZIP CONFIG_KALLSYMS CONFIG_KALLSYMS_BASE_RELATIVE CONFIG_ELF_CORE CONFIG_SLUB_DEBUG CONFIG_SLABINFO CONFIG_LBDAF CONFIG_MSDOS_PARTITION CONFIG_EFI_PARTITION CONFIG_DEBUG_RODATA CONFIG_DEBUG_ALIGN_RODATA CONFIG_CORE_DUMP_DEFAULT_ELF_HEADERS CONFIG_INET_XFRM_MODE_BEET CONFIG_AMLOGIC_MEDIA_FB_OSD_SYNC_FENCE CONFIG_AMLOGIC_M8B_MMC CONFIG_AMLOGIC_PAGE_TRACE CONFIG_AMLOGIC_SLAB_TRACE CONFIG_SCHED_DEBUG CONFIG_DEBUG_BUGVERBOSE CONFIG_DECOMPRESS_GZIP CONFIG_AMLOGIC_VMAP CONFIG_AEABI"

BR2_TARGET_ROOTFS_CPIO_GZIP=n
BR2_TARGET_ROOTFS_CPIO_LZ4=y
BR2_TARGET_ROOTFS_TAR_GZIP=n
BR2_TARGET_ROOTFS_TAR_LZ4=y

BR2_LINUX_KERNEL_LZ4=y
BR2_LINUX_KERNEL_GZIP=n


BR2_TARGET_ROOTFS_SQUASHFS=y
BR2_PACKAGE_SQUASHFS=y
```

## buildroot/buildroot/configs/a213y_au401_a32_release_defconfig
```kconfig
#----------------------------------------------------------#
#include "arch_a32_7.3.1.config"

#----------------------------------------------------------#
#include "a213y_au401.config"
#include "flash_nand_2k.config"

#----------------------------------------------------------#
#include "qt.config"
BR2_PACKAGE_AML_QT_LAUNCHER=y

#----------------------------------------------------------#

BR2_TARGET_ROOTFS_INITRAMFS_LIST="board/amlogic/mesona213y_au401/initramfs/ramfslist-32-ubi-release"
BR2_TARGET_RECOVERY_INITRAMFS_LIST="board/amlogic/mesona213y_au401/initramfs/ramfslist-32-ubi-recovery"
```

## buildroot/buildroot/configs/a213y_au40a1_a32_ass_release_defconfig
```kconfig
#----------------------------------------------------------#
#include "arch_a32_7.3.1.config"

#----------------------------------------------------------#
#include "a213y_au401.config"
#include "flash_emmc.config"

#----------------------------------------------------------#
# for alexa smart screen SDK feature
# ass include avs, so neednot include avs.config here
#include "ass.config"

#-----------------browser config--------------------------#
#include "browser.config"

#----------------------------------------------------------#

BR2_TARGET_ROOTFS_INITRAMFS_LIST="board/amlogic/mesona213y_au401/initramfs/ramfslist-32"
BR2_TARGET_RECOVERY_INITRAMFS_LIST="board/amlogic/mesona213y_au401/initramfs/ramfslist-32-recovery"

#--------------Please add new config here-----------------#
BR2_PACKAGE_MDNSRESPONDER=y

#--------------Overwrite Config Here-----------------#
BR2_LINUX_KERNEL_INTREE_DTS_NAME="mesona213y_au40a1_1g"
BR2_TARGET_UBOOT_BOARDNAME="m8b_a213y_au40a1"
```

## buildroot/buildroot/configs/a4_ba400_a6432_release_defconfig
```kconfig
#----------------------------------------------------------#
#include "arch_a6432_10.2_10.3.config"

#----------------------------------------------------------#
#include "a4_ba400.config"
#include "flash_emmc.config"
### if you want to use ext fs, change to #include "rootfs_extfs.config"
### if you want to use erofs, change to #include "rootfs_erofs.config"
#include "rootfs_squashfs.config"
BR2_TARGET_ROOTFS_INITRAMFS_LIST="board/amlogic/mesona4_ba400/initramfs/ramfslist-32-ext2"
```
