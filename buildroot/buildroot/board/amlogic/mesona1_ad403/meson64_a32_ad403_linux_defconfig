## buildroot/buildroot/configs/c2_af402_a64_release_defconfig
```kconfig
#----------------------------------------------------------#
# Architecture
BR2_aarch64=y
#-------------------------Toolchain-------------------------------#
BR2_TOOLCHAIN_EXTERNAL=y
BR2_TOOLCHAIN_EXTERNAL_PREINSTALLED=y
BR2_TOOLCHAIN_EXTERNAL_LINARO_AARCH64_7DOT3_201805_PREINSTALLED=y
BR2_TOOLCHAIN_EXTERNAL_PATH="$(TOPDIR)/../toolchain/gcc/linux-x86/aarch64/gcc-linaro-7.3.1-2018.05-x86_64_aarch64-linux-gnu"

BR2_TOOLCHAIN_EXTRA_LIBS="libthread_db libpcprofile libnss_nisplus libnss_nis libnss_hesiod libnss_db libnss_compat libmemusage libcidn libSegFault libBrokenLocale"

BR2_KERNEL_TOOLCHAIN_PATH="$(TOPDIR)/../toolchain/gcc/linux-x86/aarch64/gcc-linaro-7.3.1-2018.05-x86_64_aarch64-linux-gnu"
BR2_KERNEL_TOOLCHAIN_LINARO_AARCH64_201805=y

#----------------------------------------------------------#
# Mirrors and Download locations
BR2_BACKUP_SITE="http://sources.buildroot.net"
BR2_DEPRECATED=y


# CPU Architecture
BR2_ARM_ENABLE_NEON=y
BR2_ARM_ENABLE_VFP=y
BR2_ARM_FPU_NEON=y
#BR2_cortex_a9=y
BR2_cortex_a35=y

#Kernel Config
BR2_LINUX_KERNEL=y
BR2_LINUX_KERNEL_CUSTOM_LOCAL_VERSION_VALUE="amlogic-4.19-dev"
BR2_LINUX_KERNEL_CUSTOM_LOCAL=y
BR2_LINUX_KERNEL_CUSTOM_LOCAL_PATH="$(TOPDIR)/../kernel/aml-4.19"
BR2_LINUX_KERNEL_USE_DEFCONFIG=n
BR2_LINUX_KERNEL_USE_CUSTOM_CONFIG=y
BR2_LINUX_KERNEL_CUSTOM_CONFIG_FILE="board/amlogic/mesonc2_af402/linux.config"
BR2_LINUX_KERNEL_IMAGE_LOADADDR="0x1008000"
BR2_LINUX_KERNEL_PATCH="amlogic-4.19"
BR2_LINUX_KERNEL_DTS_SUPPORT=y
BR2_LINUX_KERNEL_USE_INTREE_DTS=y
BR2_LINUX_KERNEL_AMLOGIC_DTD=y
BR2_LINUX_KERNEL_ANDROID_FORMAT=y
BR2_LINUX_KERNEL_IMAGE=y
#BR2_LINUX_KERNEL_IMAGE_NOGZIP=y
BR2_LINUX_KERNEL_INTREE_DTS_NAME="meson-c2-c305x-af402"
BR2_TARGET_BOARD_PLATFORM="mesonc2"

# Kernel Additional Config
BR2_PACKAGE_AML_CUSTOMIZE_KERNEL=y
# BR2_PACKAGE_AML_CUSTOMIZE_KERNEL_ENABLE_OPT_LIST="CONFIG_NTFS_FS CONFIG_FUSE_FS CONFIG_NFS_FS CONFIG_NFS_V2 CONFIG_NFS_V3 CONFIG_NFS_V4 CONFIG_NFS_COMMON"


#Uboot Config
BR2_TARGET_UBOOT=y
BR2_TARGET_UBOOT_CUSTOM_LOCAL=y
BR2_TARGET_UBOOT_CUSTOM_LOCAL_VERSION_VALUE="2019"
BR2_TARGET_UBOOT_CUSTOM_LOCAL_LOCATION="$(TOPDIR)/../bootloader/uboot-repo"
BR2_TARGET_UBOOT_PATCH=""
BR2_TARGET_UBOOT_AMLOGIC_REPO=y
BR2_TARGET_UBOOT_PLATFORM="c2"
BR2_TARGET_UBOOT_BOARDNAME="c2_af402"

BR2_ROOTFS_OVERLAY="board/amlogic/mesonc2_af402/rootfs/"
BR2_ROOTFS_COMMON_OVERLAY="board/amlogic/common/rootfs/rootfs-419/"
BR2_ROOTFS_UPGRADE_DIR="board/amlogic/common/upgrade/upgrade-c2-base/"
BR2_ROOTFS_UPGRADE_DIR_OVERLAY="board/amlogic/mesonc2_af400/upgrade/"
BR2_ROOTFS_POST_BUILD_SCRIPT="$(TOPDIR)/board/amlogic/mesonc2_af402/post_build.sh"


#Rootfs Config
BR2_TARGET_ROOTFS_CPIO=y
BR2_TARGET_ROOTFS_CPIO_UIMAGE=y
BR2_TARGET_ROOTFS_TAR_GZIP=y
BR2_ROOTFS_DEVICE_CREATION_DYNAMIC_EUDEV=y
BR2_PACKAGE_HAS_UDEV=y
BR2_PACKAGE_PROVIDES_UDEV="eudev"
BR2_PACKAGE_EUDEV=y


#----------------------------------------------------------#
#BR2_PACKAGE_EUDEV_ENABLE_HWDB=y
##BR2_PACKAGE_MTDEV=y
##BR2_PACKAGE_LIBEVDEV=y
##BR2_PACKAGE_NETPLUG=y
##BR2_PACKAGE_DHCPCD=y
BR2_SYSTEM_DHCP="eth0"
#Public Package
##BR2_PACKAGE_UTIL_LINUX_BINARIES=y
BR2_PACKAGE_BUSYBOX_SHOW_OTHERS=y
BR2_PACKAGE_BUSYBOX_CONFIG="board/amlogic/mesonc2_af400/busybox.config"
BR2_TARGET_GENERIC_ROOT_PASSWD="123456"
BR2_PACKAGE_AML_AAA=y

BR2_TARGET_USBTOOL_AMLOGIC=y
BR2_PACKAGE_AML_UBOOTENV=y
BR2_PACKAGE_ZLIB=y

#----------------------------------------------------------#
#nand Config
BR2_TARGET_ROOTFS_TAR_OPTIONS=""
BR2_TARGET_ROOTFS_UBI=y
BR2_TARGET_ROOTFS_UBI_PEBSIZE=0x20000
BR2_TARGET_ROOTFS_UBI_SUBSIZE=2048
BR2_TARGET_ROOTFS_UBI_OPTS=""
BR2_TARGET_ROOTFS_UBIFS=y
BR2_TARGET_ROOTFS_UBIFS_LEBSIZE=0x1f000
BR2_TARGET_ROOTFS_UBIFS_MINIOSIZE=0x800
BR2_TARGET_ROOTFS_UBIFS_MAXLEBCNT=2212
BR2_TARGET_ROOTFS_UBIFS_RT_LZO=y
BR2_TARGET_ROOTFS_UBIFS_NONE=y
BR2_TARGET_ROOTFS_UBIFS_OPTS="-v"

#----------------------------------------------------------#
BR2_PACKAGE_IPC_SDK=y
BR2_PACKAGE_MTD=y
BR2_PACKAGE_MTD_UBIFS_UTILS=y
BR2_PACKAGE_AML_SOC_BOARD_NAME="AF402"
BR2_PACKAGE_AML_SOC_FAMILY_NAME="C2"
BR2_PACKAGE_AML_SOC_USE_MULTIENC=y
BR2_PACKAGE_AML_LIBGDC=y
BR2_PACKAGE_AML_LIBGDC_LOCAL_PATH="$(TOPDIR)/../hardware/aml-4.9/amlogic/libgdc"
BR2_PACKAGE_AML_LIBGE2D=y
BR2_PACKAGE_AML_LIBGE2D_LOCAL_PATH="$(TOPDIR)/../hardware/aml-4.9/amlogic/libge2d"
BR2_PACKAGE_AML_LIBION=y
BR2_PACKAGE_AML_LIBION_LOCAL_PATH="$(TOPDIR)/../hardware/aml-4.9/amlogic/libion"
BR2_PACKAGE_LIBMULTIENC=y
BR2_PACKAGE_LIBMULTIENC_LOCAL_PATH="$(TOPDIR)/../hardware/aml-4.9/amlogic/libencoder/multiEnc"

#-----------------------------------------------------------#
# MTD tools selection
BR2_PACKAGE_MTD_FLASHCP=y
BR2_PACKAGE_MTD_FLASH_ERASE=y
BR2_PACKAGE_MTD_FLASH_LOCK=y
BR2_PACKAGE_MTD_FLASH_UNLOCK=y
BR2_PACKAGE_MTD_MKFSUBIFS=y
BR2_PACKAGE_MTD_MTD_DEBUG=y
BR2_PACKAGE_MTD_NANDDUMP=y
BR2_PACKAGE_MTD_NANDTEST=y
BR2_PACKAGE_MTD_NANDWRITE=y
BR2_PACKAGE_MTD_MTDINFO=y
BR2_PACKAGE_MTD_UBIATTACH=y
BR2_PACKAGE_MTD_UBIDETACH=y
BR2_PACKAGE_MTD_UBIFORMAT=y
BR2_PACKAGE_MTD_UBIMKVOL=y
BR2_PACKAGE_MTD_UBINFO=y
BR2_PACKAGE_MTD_UBINIZE=y

#------------------------------------------------------------#
#Audio/sound
BR2_PACKAGE_ALSA_UTILS=y
BR2_PACKAGE_ALSA_UTILS_APLAY=y
BR2_PACKAGE_ALSA_LIB=y
BR2_PACKAGE_ALSA_LIB_DEVDIR="/dev/snd"
BR2_PACKAGE_ALSA_LIB_PCM_PLUGINS="all"
BR2_PACKAGE_ALSA_LIB_CTL_PLUGINS="all"
BR2_PACKAGE_ALSA_LIB_ALOAD=y
BR2_PACKAGE_ALSA_LIB_MIXER=y
BR2_PACKAGE_ALSA_LIB_PCM=y
BR2_PACKAGE_ALSA_LIB_RAWMIDI=y
BR2_PACKAGE_ALSA_LIB_HWDEP=y
BR2_PACKAGE_ALSA_LIB_SEQ=y
BR2_PACKAGE_ALSA_LIB_UCM=y
BR2_PACKAGE_ALSA_LIB_ALISP=y
BR2_PACKAGE_ALSA_LIB_OLD_SYMBOLS=y
BR2_PACKAGE_FDK_AAC=y
BR2_PACKAGE_SPEEXDSP=y

BR2_PACKAGE_LZO=y
BR2_PACKAGE_LIBFUSE=y
BR2_PACKAGE_FREETYPE=y

#JPEG
BR2_PACKAGE_JPEG=y
BR2_PACKAGE_LIBJPEG=y
BR2_PACKAGE_HAS_JPEG=y
BR2_PACKAGE_PROVIDES_JPEG="libjpeg"
BR2_PACKAGE_LIBPNG=y

BR2_PACKAGE_LIBGPIOD=y
BR2_PACKAGE_LIBGPIOD_TOOLS=y

BR2_PACKAGE_UTIL_LINUX_LIBUUID=y

#-------------------------------------------------------_#
# Filesystem images
BR2_TARGET_ROOTFS_INITRAMFS_LIST="board/amlogic/mesonc2_af402/initramfs/ramfslist-64-release"
BR2_TARGET_ROOTFS_UBI=y
BR2_TARGET_ROOTFS_UBI_PEBSIZE=0x20000
BR2_TARGET_ROOTFS_UBI_SUBSIZE=2048
BR2_TARGET_ROOTFS_UBI_OPTS=""
BR2_TARGET_ROOTFS_UBIFS=y
BR2_TARGET_ROOTFS_UBIFS_LEBSIZE=0x1f000
BR2_TARGET_ROOTFS_UBIFS_MINIOSIZE=0x800
BR2_TARGET_ROOTFS_UBIFS_MAXLEBCNT=2212
BR2_TARGET_ROOTFS_UBIFS_RT_LZO=y
BR2_TARGET_ROOTFS_UBIFS_NONE=y
BR2_TARGET_ROOTFS_UBIFS_OPTS="-v"

BR2_TARGET_UBOOT_AMLOGIC_BOOTARGS="init=/sbin/init root=ubi0:rootfs rw ubi.mtd=3,2048 noinitrd rootfstype=ubifs"
BR2_TARGET_USBTOOL_UBI_AMLOGIC=y
BR2_PACKAGE_AML_USB_CONFIG=y
BR2_PACKAGE_ADB_RNDIS=y
BR2_PACKAGE_ANDROID_TOOLS=y
BR2_PACKAGE_ANDROID_TOOLS_ADBD=y

#include "media_k4.19.config"
#include "isp_k4.19.config"

#wifi
#include "network_driver_k4.19.config"
BR2_PACKAGE_WIFI_FW_WIFI_MODULE="AP6201BM_MINIME"
BR2_PACKAGE_BRCMAP6XXX=y

#openssl
BR2_PACKAGE_OPENSSL=y
BR2_PACKAGE_LIBOPENSSL=y
BR2_PACKAGE_LIBOPENSSL_TARGET_ARCH="linux-aarch64"
BR2_PACKAGE_HAS_OPENSSL=y
BR2_PACKAGE_PROVIDES_OPENSSL="libopenssl"

#multi_wifi_load_driver
BR2_PACKAGE_AML_UTIL=y

#wpa
#BR2_PACKAGE_LIBNL=y
#BR2_PACKAGE_WPA_SUPPLICANT=y
#BR2_PACKAGE_WPA_SUPPLICANT_NL80211=y
#BR2_PACKAGE_WPA_SUPPLICANT_CLI=y

#ircut
BR2_PACKAGE_IPC_IRCUT_MODULE=y

#php
BR2_PACKAGE_PHP=y
BR2_PACKAGE_PHP_SAPI_CGI=y
BR2_PACKAGE_PHP_SAPI_FPM=y
BR2_PACKAGE_PHP_EXT_SESSION=y
BR2_PACKAGE_PHP_EXT_ZLIB=y
BR2_PACKAGE_PHP_EXT_JSON=y
BR2_PACKAGE_PHP_EXT_POSIX=y

#nginx
BR2_PACKAGE_NGINX=y
BR2_PACKAGE_NGINX_HTTP=y
BR2_PACKAGE_NGINX_HTTP_CHARSET_MODULE=y
BR2_PACKAGE_NGINX_HTTP_GZIP_MODULE=y
BR2_PACKAGE_NGINX_HTTP_SSI_MODULE=y
BR2_PACKAGE_NGINX_HTTP_USERID_MODULE=y
BR2_PACKAGE_NGINX_HTTP_ACCESS_MODULE=y
BR2_PACKAGE_NGINX_HTTP_AUTH_BASIC_MODULE=y
BR2_PACKAGE_NGINX_HTTP_AUTOINDEX_MODULE=y
BR2_PACKAGE_NGINX_HTTP_GEO_MODULE=y
BR2_PACKAGE_NGINX_HTTP_MAP_MODULE=y
BR2_PACKAGE_NGINX_HTTP_SPLIT_CLIENTS_MODULE=y
BR2_PACKAGE_NGINX_HTTP_REFERER_MODULE=y
BR2_PACKAGE_NGINX_HTTP_REWRITE_MODULE=y
BR2_PACKAGE_NGINX_HTTP_PROXY_MODULE=y
BR2_PACKAGE_NGINX_HTTP_FASTCGI_MODULE=y
BR2_PACKAGE_NGINX_HTTP_UWSGI_MODULE=y
BR2_PACKAGE_NGINX_HTTP_SCGI_MODULE=y
BR2_PACKAGE_NGINX_HTTP_MEMCACHED_MODULE=y
BR2_PACKAGE_NGINX_HTTP_LIMIT_CONN_MODULE=y
BR2_PACKAGE_NGINX_HTTP_LIMIT_REQ_MODULE=y
BR2_PACKAGE_NGINX_HTTP_EMPTY_GIF_MODULE=y
BR2_PACKAGE_NGINX_HTTP_BROWSER_MODULE=y
BR2_PACKAGE_NGINX_HTTP_UPSTREAM_IP_HASH_MODULE=y
BR2_PACKAGE_NGINX_HTTP_UPSTREAM_LEAST_CONN_MODULE=y
BR2_PACKAGE_NGINX_HTTP_UPSTREAM_KEEPALIVE_MODULE=y

#ip camera
BR2_PACKAGE_IPC_WEBUI=y
BR2_PACKAGE_IPC_PROPERTY=y
BR2_PACKAGE_IPC_PROPERTY_JSON=y
BR2_PACKAGE_IPC_SYSTEM_SERVICE=y
BR2_PACKAGE_IPC_WEBSTREAM_SERVER=y

#doorbell
BR2_PACKAGE_DOORBELL=y
BR2_PACKAGE_DNSMASQ=y
BR2_PACKAGE_DNSMASQ_DHCP=y
BR2_PACKAGE_LIBGPIOD=y
BR2_PACKAGE_LIBGPIOD_TOOLS=y
```

## buildroot/buildroot/configs/c3_aw401_a32_release_defconfig
```kconfig
#----------------------------------------------------------#
#include "arch_a32_10.3.config"

#----------------------------------------------------------#
#include "c3_aw401.config"
#include "flash_nand_2k.config"
BR2_TARGET_ROOTFS_INITRAMFS_LIST="board/amlogic/mesonc3_aw401/initramfs/ramfslist-32-ubi-release"
```
