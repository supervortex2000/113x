## buildroot/buildroot/configs/a4_ba400_spk_a6432_release_defconfig
```kconfig
#----------------------------------------------------------#
#include "arch_a6432_10.2_10.3.config"
#----------------------------------------------------------#
#include "a4_ba400_spk.config"
#include "flash_emmc.config"
#include "rootfs_squashfs.config"
BR2_TARGET_ROOTFS_INITRAMFS_LIST="board/amlogic/mesona4_ba400_spk/initramfs/ramfslist-32-ext2"
```

## buildroot/buildroot/configs/a5_av400_a6432_release_defconfig
```kconfig
#----------------------------------------------------------#
#include "arch_a6432_10.3_7.3.1.config"

#----------------------------------------------------------#
#include "a5_av400.config"
#include "flash_emmc.config"
### if you want to use ext fs, change to #include "rootfs_extfs.config"
### if you want to use erofs, change to #include "rootfs_erofs.config"
#include "rootfs_squashfs.config"
BR2_TARGET_ROOTFS_INITRAMFS_LIST="board/amlogic/mesona5_av400/initramfs/ramfslist-32-ext2"
```

## buildroot/buildroot/configs/a5_av400_a64_release_defconfig
```kconfig
#----------------------------------------------------------#
#include "arch_a64_10.2_10.2.config"

#----------------------------------------------------------#
#include "a5_av400.config"
#include "flash_emmc.config"
### if you want to use ext fs, change to #include "rootfs_extfs.config"
### if you want to use erofs, change to #include "rootfs_erofs.config"
#include "rootfs_squashfs.config"
BR2_TARGET_ROOTFS_INITRAMFS_LIST="board/amlogic/mesona5_av400/initramfs/ramfslist-64-ext2"
BR2_TARGET_RECOVERY_INITRAMFS_NEED_64="board/amlogic/common/ota/ota-a5/ramfslist-recovery-need-64"

BR2_PACKAGE_AVS_SDK=n
BR2_AVS_CLIENT_API=n
BR2_PACKAGE_STRACE=n
```

## buildroot/buildroot/configs/a5_av400_spk_a6432_release_defconfig
```kconfig
#----------------------------------------------------------#
#include "arch_a6432_10.3_7.3.1.config"

#----------------------------------------------------------#
#include "a5_av400_spk.config"
#include "flash_emmc.config"
#include "rootfs_squashfs.config"
BR2_TARGET_ROOTFS_INITRAMFS_LIST="board/amlogic/mesona5_av400_spk/initramfs/ramfslist-32-ext2"
```

## buildroot/buildroot/configs/a5_av409_a6432_release_defconfig
```kconfig
#----------------------------------------------------------#
#include "arch_a6432_10.3_7.3.1.config"

#----------------------------------------------------------#
#include "a5_av409.config"
#include "flash_emmc.config"
BR2_TARGET_ROOTFS_EXT2_SIZE="1024M"
BR2_TARGET_ROOTFS_INITRAMFS_LIST="board/amlogic/mesona5_av409/initramfs/ramfslist-32-ext2"
```

## buildroot/buildroot/configs/axg_s400-emmc_a6432_k54_release_defconfig
```kconfig
#
# Copyright (c) 2022 Amlogic, Inc. All rights reserved.
# This source code is subject to the terms and conditions
# defined in the file 'LICENSE' which is part of this source code package.
# Description: axg s400-emmc kernel5.4 config file
#
#----------------------------------------------------------#
#include "arch_a6432_10.2_10.3.config"

#----------------------------------------------------------#
#include "a113_s400_k54.config"
#include "flash_emmc.config"
BR2_TARGET_ROOTFS_INITRAMFS_LIST="board/amlogic/common/initramfs/initramfs-54/ramfslist-32-ext2"
BR2_LINUX_KERNEL_INTREE_DTS_NAME="axg_s400_emmc"

### If tdk 3.18 is already enabled, please enable the following command
### BR2_PACKAGE_UBOOT_EXTRA_ARGS="--bl32 ./bl32/bl32_3.18/bin/axg/bl32.img"
```

## buildroot/buildroot/configs/axg_s400_sbr_a6432_k54_release_defconfig
```kconfig
#
# Copyright (c) 2022 Amlogic, Inc. All rights reserved.
# This source code is subject to the terms and conditions
# defined in the file 'LICENSE' which is part of this source code package.
# Description: axg s400 soundbar kernel5.4 config file
#
#----------------------------------------------------------#
#include "arch_a6432_10.2_10.3.config"

#----------------------------------------------------------#
#include "a113_s400_SBR_k54.config"
#include "flash_nand_2k.config"
BR2_TARGET_ROOTFS_INITRAMFS_LIST="board/amlogic/common/initramfs/initramfs-54/ramfslist-32-ubi-release"

### If tdk 3.18 is already enabled, please enable the following command
### BR2_PACKAGE_UBOOT_EXTRA_ARGS="--bl32 ./bl32/bl32_3.18/bin/axg/bl32.nand.img"
```

## buildroot/buildroot/configs/c1_ae400-base_a64_release_defconfig
```kconfig
#----------------------------------------------------------#
# Architecture
BR2_aarch64=y
#-------------------------Toolchain-------------------------------#
BR2_TOOLCHAIN_EXTERNAL=y
BR2_TOOLCHAIN_EXTERNAL_PREINSTALLED=y
BR2_TOOLCHAIN_EXTERNAL_LINARO_AARCH64_7DOT3_201805_PREINSTALLED=y
BR2_TOOLCHAIN_EXTERNAL_PATH="$(TOPDIR)/../toolchain/gcc/linux-x86/aarch64/gcc-linaro-7.3.1-2018.05-x86_64_aarch64-linux-gnu"

BR2_TOOLCHAIN_EXTRA_LIBS="libthread_db libpcprofile libnss_nisplus libnss_nis libnss_hesiod libnss_db libnss_compat libmemusage libcidn libSegFault libBrokenLocale"

BR2_KERNEL_TOOLCHAIN_PATH="$(TOPDIR)/../toolchain/gcc/linux-x86/aarch64/gcc-linaro-7.3.1-2018.05-x86_64_aarch64-linux-gnu"
BR2_KERNEL_TOOLCHAIN_LINARO_AARCH64_201805=y

#----------------------------------------------------------#
# Mirrors and Download locations
BR2_BACKUP_SITE="http://sources.buildroot.net"
BR2_DEPRECATED=y


# CPU Architecture
BR2_ARM_ENABLE_NEON=y
BR2_ARM_ENABLE_VFP=y
BR2_ARM_FPU_NEON=y
#BR2_cortex_a9=y
BR2_cortex_a35=y

#Kernel Config
BR2_LINUX_KERNEL=y
BR2_LINUX_KERNEL_CUSTOM_LOCAL_VERSION_VALUE="amlogic-4.19-dev"
BR2_LINUX_KERNEL_CUSTOM_LOCAL=y
BR2_LINUX_KERNEL_CUSTOM_LOCAL_PATH="$(TOPDIR)/../kernel/aml-4.19"
BR2_LINUX_KERNEL_DEFCONFIG="meson64_a64_smarthome"
BR2_LINUX_KERNEL_IMAGE_LOADADDR="0x1008000"
BR2_LINUX_KERNEL_PATCH="amlogic-4.19"
BR2_LINUX_KERNEL_DTS_SUPPORT=y
BR2_LINUX_KERNEL_USE_INTREE_DTS=y
BR2_LINUX_KERNEL_AMLOGIC_DTD=y
BR2_LINUX_KERNEL_ANDROID_FORMAT=y
BR2_LINUX_KERNEL_IMAGE=y
BR2_LINUX_KERNEL_IMAGE_NOGZIP=y
BR2_LINUX_KERNEL_INTREE_DTS_NAME="meson-c1-c308x-ae400"
BR2_TARGET_BOARD_PLATFORM="mesonc1"

# Kernel Additional Config
BR2_PACKAGE_AML_CUSTOMIZE_KERNEL=y
BR2_PACKAGE_AML_CUSTOMIZE_KERNEL_ENABLE_OPT_LIST="CONFIG_NTFS_FS CONFIG_FUSE_FS CONFIG_NFS_FS CONFIG_NFS_V2 CONFIG_NFS_V3 CONFIG_NFS_V4 CONFIG_NFS_COMMON"


#Uboot Config
BR2_TARGET_UBOOT=y
BR2_TARGET_UBOOT_CUSTOM_LOCAL=y
BR2_TARGET_UBOOT_CUSTOM_LOCAL_VERSION_VALUE="2019"
BR2_TARGET_UBOOT_CUSTOM_LOCAL_LOCATION="$(TOPDIR)/../bootloader/uboot-repo"
BR2_TARGET_UBOOT_PATCH=""
BR2_TARGET_UBOOT_AMLOGIC_REPO=y
BR2_TARGET_UBOOT_PLATFORM="c1"
BR2_TARGET_UBOOT_BOARDNAME="c1_ae400"

BR2_ROOTFS_OVERLAY="board/amlogic/mesonc1_ae400/rootfs/"
BR2_ROOTFS_COMMON_OVERLAY="board/amlogic/common/rootfs/rootfs-419/"
BR2_ROOTFS_UPGRADE_DIR="board/amlogic/common/upgrade/upgrade-c1-base/"
BR2_ROOTFS_UPGRADE_DIR_OVERLAY="board/amlogic/mesonc1_ae400/upgrade/"
BR2_ROOTFS_POST_BUILD_SCRIPT="$(TOPDIR)/board/amlogic/mesonc1_ae400/post_build_base.sh"


#Rootfs Config
BR2_TARGET_ROOTFS_CPIO=y
BR2_TARGET_ROOTFS_CPIO_UIMAGE=y
BR2_TARGET_ROOTFS_TAR_GZIP=y
BR2_ROOTFS_DEVICE_CREATION_DYNAMIC_EUDEV=y
BR2_PACKAGE_HAS_UDEV=y
BR2_PACKAGE_PROVIDES_UDEV="eudev"
BR2_PACKAGE_EUDEV=y


#----------------------------------------------------------#
#BR2_PACKAGE_EUDEV_ENABLE_HWDB=y
##BR2_PACKAGE_MTDEV=y
##BR2_PACKAGE_LIBEVDEV=y
##BR2_PACKAGE_NETPLUG=y
##BR2_PACKAGE_DHCPCD=y
BR2_SYSTEM_DHCP="eth0"
#Public Package
##BR2_PACKAGE_UTIL_LINUX_BINARIES=y
BR2_PACKAGE_BUSYBOX_SHOW_OTHERS=y
BR2_PACKAGE_BUSYBOX_CONFIG="board/amlogic/mesonc1_ae400/busybox.config"
BR2_TARGET_GENERIC_ROOT_PASSWD="123456"
BR2_PACKAGE_AML_AAA=y

BR2_TARGET_USBTOOL_AMLOGIC=y
BR2_PACKAGE_AML_UBOOTENV=y
BR2_PACKAGE_ZLIB=y
#----------------------------------------------------------#
#
#EMMC Config
#
##BR2_PACKAGE_E2FSPROGS=y
##BR2_PACKAGE_E2FSPROGS_FSCK=y

BR2_TARGET_ROOTFS_EXT2=y
BR2_TARGET_ROOTFS_EXT2_4=y
BR2_TARGET_ROOTFS_EXT2_SIZE="2048M"
BR2_TARGET_ROOTFS_INITRAMFS_LIST="board/amlogic/mesonc1_ae400/initramfs/ramfslist-64-base"

#----------------------------------------------------------#
BR2_PACKAGE_AML_SOC_BOARD_NAME="AE400"
BR2_PACKAGE_AML_SOC_FAMILY_NAME="C1"
```

## buildroot/buildroot/configs/c1_ae400_a64_k515_release_defconfig
```kconfig
#----------------------------------------------------------#
#include "arch_a64_10.2.config"

#----------------------------------------------------------#
#include "c1_ae400_k515.config"
#include "flash_emmc.config"
BR2_TARGET_ROOTFS_INITRAMFS_LIST="board/amlogic/mesonc1_ae400_k515/initramfs/ramfslist-64"
BR2_LINUX_KERNEL_MODULES_SEQUENCE_LIST="board/amlogic/mesonc1_ae400_k515/modules_sequence_list"
```

## buildroot/buildroot/configs/c1_ae402-nand_a64_release_defconfig
```kconfig
#----------------------------------------------------------#
#include "arch_a64_7.3.1.config"

#----------------------------------------------------------#
#include "c1_ae402.config"
#include "flash_nand_4k.config"
BR2_TARGET_ROOTFS_INITRAMFS_LIST="board/amlogic/mesonc1_ae402/initramfs/ramfslist-64-ubi-release"
```

## buildroot/buildroot/configs/c2_af400-nand_a64_release_defconfig
```kconfig
#----------------------------------------------------------#
#include "arch_a64_7.3.1.config"

#----------------------------------------------------------#
#include "c2_af400.config"
###include "flash_nand_4k.config"
#include "flash_nand_2k.config"
BR2_PACKAGE_AML_RTOS=n
BR2_TARGET_ROOTFS_INITRAMFS_LIST="board/amlogic/mesonc2_af400/initramfs/ramfslist-64-ubi-release"
BR2_LINUX_KERNEL_INTREE_DTS_NAME="meson-c2-c305x-af400-nand"
```

## buildroot/buildroot/configs/c2_af400_a6432_release_defconfig
```kconfig
#----------------------------------------------------------#
#include "arch_a6432_7.3.1.config"

#----------------------------------------------------------#
#include "c2_af400.config"
#include "flash_emmc.config"
BR2_TARGET_ROOTFS_INITRAMFS_LIST="board/amlogic/mesonc2_af400/initramfs/ramfslist-32"
```

## buildroot/buildroot/configs/c2_af400_a64_k510_release_defconfig
```kconfig
#----------------------------------------------------------#
#include "arch_a64_10.2.config"

#----------------------------------------------------------#
#include "c2_af400_k510.config"
#include "flash_emmc.config"
BR2_TARGET_ROOTFS_INITRAMFS_LIST="board/amlogic/mesonc2_af400_k510/initramfs/ramfslist-64"
```

## buildroot/buildroot/configs/c2_af400_a64_release_defconfig
```kconfig
#----------------------------------------------------------#
#include "arch_a64_7.3.1.config"

#----------------------------------------------------------#
#include "c2_af400.config"
#include "flash_emmc.config"
BR2_TARGET_ROOTFS_INITRAMFS_LIST="board/amlogic/mesonc2_af400/initramfs/ramfslist-64"
```

## buildroot/buildroot/configs/c2_af401_a64_release_defconfig
```kconfig
#----------------------------------------------------------#
#include "arch_a64_7.3.1.config"

#----------------------------------------------------------#
#include "c2_af401.config"
#include "flash_emmc.config"
BR2_TARGET_ROOTFS_INITRAMFS_LIST="board/amlogic/mesonc2_af401/initramfs/ramfslist-64"
```
