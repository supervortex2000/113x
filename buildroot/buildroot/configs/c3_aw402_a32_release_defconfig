## buildroot/buildroot/configs/c3_pxp_a32_release_defconfig
```kconfig
BR2_arm=y
BR2_cortex_a35=y
BR2_ARM_FPU_NEON=y
BR2_KERNEL_TOOLCHAIN_ARM_ARMV8_202107=y
BR2_KERNEL_TOOLCHAIN_PATH="$(TOPDIR)/../toolchain/gcc/linux-x86/arm/gcc-arm-10.3-2021.07-x86_64-arm-none-linux-gnueabihf"
BR2_TOOLCHAIN_EXTERNAL=y
BR2_TOOLCHAIN_EXTERNAL_LINARO_ARM_7DOT3_201805_PREINSTALLED=y
BR2_TOOLCHAIN_EXTERNAL_PREINSTALLED=y
BR2_TOOLCHAIN_EXTERNAL_PATH="$(TOPDIR)/../toolchain/gcc/linux-x86/arm/gcc-linaro-7.3.1-2018.05-x86_64_arm-linux-gnueabihf"
BR2_ROOTFS_DEVICE_CREATION_DYNAMIC_EUDEV=y
BR2_TARGET_GENERIC_ROOT_PASSWD="123456"
BR2_SYSTEM_DHCP="eth0"
BR2_TARGET_TZ_INFO=y
BR2_TARGET_LOCALTIME="Asia/Shanghai"
BR2_ROOTFS_COMMON_OVERLAY="board/amlogic/common/rootfs/rootfs-515/"
BR2_ROOTFS_UPGRADE_DIR="board/amlogic/common/upgrade/upgrade-c3-no-fastboot-gpt"
BR2_RECOVERY_OTA_DIR="board/amlogic/common/ota/ota-c3/"
BR2_ROOTFS_UPGRADE_DIR_OVERLAY="board/amlogic/mesonc3_pxp_k515/upgrade/"
BR2_ROOTFS_OVERLAY="board/amlogic/mesonc3_pxp_k515/rootfs/"
BR2_ROOTFS_POST_BUILD_SCRIPT="$(TOPDIR)/board/amlogic/mesonc3_pxp_k515/post_build.sh"
BR2_LINUX_KERNEL=y
BR2_LINUX_KERNEL_COMMON_DRIVERS="common_drivers"
BR2_LINUX_KERNEL_CUSTOM_LOCAL=y
BR2_LINUX_KERNEL_CUSTOM_LOCAL_PATH="$(TOPDIR)/../kernel/aml-5.15"
BR2_LINUX_KERNEL_CUSTOM_LOCAL_VERSION_VALUE="amlogic-5.15-dev"
BR2_LINUX_KERNEL_PATCH="amlogic-5.15"
BR2_LINUX_KERNEL_DEFCONFIG="meson64_a32_smarthome"
BR2_TARGET_BOARD_PLATFORM="mesonc3"
BR2_LINUX_KERNEL_UIMAGE=y
BR2_LINUX_KERNEL_IMAGE_LOADADDR="0x1008000"
BR2_LINUX_KERNEL_DTS_SUPPORT=y
BR2_LINUX_KERNEL_INTREE_DTS_NAME="c3_pxp"
BR2_LINUX_KERNEL_AMLOGIC_DTD=y
BR2_LINUX_KERNEL_ANDROID_FORMAT=y
BR2_PACKAGE_AML_AAA=y
BR2_PACKAGE_AML_COMMONLIB=y
BR2_PACKAGE_AML_CUSTOMIZE_KERNEL=y
BR2_PACKAGE_AML_CUSTOMIZE_KERNEL_ENABLE_OPT_LIST="CONFIG_NTFS_FS CONFIG_FUSE_FS CONFIG_NFS_FS CONFIG_NFS_V2 CONFIG_NFS_V3 CONFIG_NFS_V4 CONFIG_NFS_COMMON"
BR2_PACKAGE_AML_SOC_FAMILY_NAME="C2"
BR2_PACKAGE_AML_SOC_BOARD_NAME="AF400"
BR2_PACKAGE_AML_SOC_USE_MULTIENC=y
BR2_PACKAGE_AML_USB_CONFIG=y
BR2_PACKAGE_ADB_RNDIS=y
BR2_PACKAGE_AML_UTIL=y
#BR2_PACKAGE_REMOTECFG=y
BR2_PACKAGE_AML_BOOTLOADER_MESSAGE=y
BR2_PACKAGE_AML_UBOOTENV=y
#BR2_PACKAGE_BRCMAP6XXX_LOCAL=y
#BR2_PACKAGE_BRCMAP6XXX_LOCAL_PATH="$(TOPDIR)/../hardware/aml-4.19/wifi/broadcom/drivers/ap6xxx"
#BR2_PACKAGE_BRCMAP6XXX_SDIO_VERSION="bcmdhd.100.10.315.x"
BR2_PACKAGE_DHD_PRIV=y
BR2_PACKAGE_RTK8189FTV_LOCAL=y
BR2_PACKAGE_RTK8189FTV_LOCAL_PATH="$(TOPDIR)/../hardware/aml-4.19/wifi/realtek/drivers/8189ftv"
BR2_PACKAGE_RTK8188FTV_LOCAL=y
BR2_PACKAGE_RTK8188FTV_LOCAL_PATH="$(TOPDIR)/../hardware/aml-4.19/wifi/realtek/drivers/8188ftv"
BR2_PACKAGE_WIFI_FW=y
BR2_PACKAGE_WIFI_CUSTOM_GIT_VERSION="p-amlogic"
BR2_PACKAGE_WIFI_FW_LOCAL=y
BR2_PACKAGE_WIFI_FW_CUSTOM_LOCAL_PATH="$(TOPDIR)/../hardware/aml-4.19/amlogic/wifi"
BR2_PACKAGE_WIFI_FW_WIFI_MODULE="AP6398"
BR2_PACKAGE_MTK7661_LOCAL=y
BR2_PACKAGE_MTK7661_LOCAL_PATH="$(TOPDIR)/../hardware/aml-4.19/wifi/mtk/drivers/mt7661"
BR2_PACKAGE_AMAUDIO=y
BR2_PACKAGE_AML_LIBGDC_LOCAL_PATH="$(TOPDIR)/../hardware/aml-4.9/amlogic/libgdc"
BR2_PACKAGE_AML_LIBGE2D_LOCAL_PATH="$(TOPDIR)/../hardware/aml-4.9/amlogic/libge2d"
BR2_PACKAGE_AML_LIBION_LOCAL_PATH="$(TOPDIR)/../hardware/aml-4.9/amlogic/libion"
BR2_PACKAGE_LIBMULTIENC_LOCAL_PATH="$(TOPDIR)/../hardware/aml-4.9/amlogic/libencoder/multiEnc"
#BR2_PACKAGE_MEDIA_MODULES=y
#BR2_PACKAGE_MEDIA_MODLUES_VERSION="amlogic-5.15-dev"
#BR2_PACKAGE_MEDIA_MODULES_LOCAL=y
#BR2_PACKAGE_MEDIA_MODULES_LOCAL_PATH="$(TOPDIR)/../hardware/aml-5.15/amlogic/media_modules"
BR2_PACKAGE_AML_NN_DETECT_LIBRARY=y
BR2_PACKAGE_AML_NN_DETECT_MODEL=y
#BR2_PACKAGE_ARM_ISP=y
#BR2_PACKAGE_ARM_ISP_VERSION="amlogic-4.19-dev"
#BR2_PACKAGE_ARM_ISP_LOCAL=y
#BR2_PACKAGE_ARM_ISP_LOCAL_PATH="$(TOPDIR)/../hardware/aml-4.19/amlogic/arm_isp"
BR2_PACKAGE_ONVIF_PREBUILT=y
BR2_PACKAGE_ONVIF_GENERATE_PREBUILT=y
BR2_PACKAGE_ONVIF_SRVD=y
BR2_PACKAGE_IPC_WEBUI=y
BR2_PACKAGE_IPC_SDK_BUILD_EXAMPLE=y
BR2_PACKAGE_IPC_REFAPP=y
BR2_PACKAGE_AML_NN_DNCNN=y
BR2_PACKAGE_WEB_UI_WIFI=y
BR2_PACKAGE_NPU=y
BR2_PACKAGE_NPU_LOCAL=y
BR2_PACKAGE_NPU_LOCAL_PATH="$(TOPDIR)/../hardware/aml-4.19/npu/nanoq"
BR2_PACKAGE_NPU_NBG_IMAGE="c2_c305x_model.img"
BR2_PACKAGE_ALSA_UTILS=y
BR2_PACKAGE_ALSA_UTILS_ALSACONF=y
BR2_PACKAGE_ALSA_UTILS_ALSALOOP=y
BR2_PACKAGE_ALSA_UTILS_ALSATPLG=y
BR2_PACKAGE_ALSA_UTILS_AMIXER=y
BR2_PACKAGE_ALSA_UTILS_APLAY=y
BR2_PACKAGE_ALSA_UTILS_BAT=y
BR2_PACKAGE_ALSA_UTILS_IECSET=y
BR2_PACKAGE_ALSA_UTILS_SPEAKER_TEST=y
BR2_PACKAGE_FAAD2=y
BR2_PACKAGE_GST1_PLUGINS_BASE_PLUGIN_VIDEOCONVERT=y
BR2_PACKAGE_GST1_PLUGINS_BASE_PLUGIN_SUBPARSE=y
BR2_PACKAGE_GST1_PLUGINS_BASE_PLUGIN_VIDEORATE=y
BR2_PACKAGE_GST1_PLUGINS_BASE_PLUGIN_OGG=y
BR2_PACKAGE_GST1_PLUGINS_GOOD_PLUGIN_ALPHA=y
BR2_PACKAGE_GST1_PLUGINS_GOOD_PLUGIN_APETAG=y
BR2_PACKAGE_GST1_PLUGINS_GOOD_PLUGIN_AUDIOPARSERS=y
BR2_PACKAGE_GST1_PLUGINS_GOOD_PLUGIN_AUPARSE=y
BR2_PACKAGE_GST1_PLUGINS_GOOD_PLUGIN_AUTODETECT=y
BR2_PACKAGE_GST1_PLUGINS_GOOD_PLUGIN_DEINTERLACE=y
BR2_PACKAGE_GST1_PLUGINS_GOOD_PLUGIN_FLV=y
BR2_PACKAGE_GST1_PLUGINS_GOOD_PLUGIN_ICYDEMUX=y
BR2_PACKAGE_GST1_PLUGINS_GOOD_PLUGIN_ID3DEMUX=y
BR2_PACKAGE_GST1_PLUGINS_GOOD_PLUGIN_MATROSKA=y
BR2_PACKAGE_GST1_PLUGINS_GOOD_PLUGIN_RTSP=y
BR2_PACKAGE_GST1_PLUGINS_GOOD_PLUGIN_VIDEOFILTER=y
BR2_PACKAGE_GST1_PLUGINS_GOOD_PLUGIN_V4L2=y
BR2_PACKAGE_GST1_PLUGINS_GOOD_PLUGIN_SOUPHTTPSRC=y
BR2_PACKAGE_GST1_PLUGINS_GOOD_PLUGIN_TAGLIB=y
BR2_PACKAGE_GST1_PLUGINS_BAD=y
BR2_PACKAGE_GST1_PLUGINS_BAD_PLUGIN_AIFF=y
BR2_PACKAGE_GST1_PLUGINS_BAD_PLUGIN_AUTOCONVERT=y
BR2_PACKAGE_GST1_PLUGINS_BAD_PLUGIN_ID3TAG=y
BR2_PACKAGE_GST1_PLUGINS_BAD_PLUGIN_INTERLACE=y
BR2_PACKAGE_GST1_PLUGINS_BAD_PLUGIN_IVFPARSE=y
BR2_PACKAGE_GST1_PLUGINS_BAD_PLUGIN_MPEGDEMUX=y
BR2_PACKAGE_GST1_PLUGINS_BAD_PLUGIN_MPEGTSDEMUX=y
BR2_PACKAGE_GST1_PLUGINS_BAD_PLUGIN_PCAPPARSE=y
BR2_PACKAGE_GST1_PLUGINS_BAD_PLUGIN_RAWPARSE=y
BR2_PACKAGE_GST1_PLUGINS_BAD_PLUGIN_SMOOTH=y
BR2_PACKAGE_GST1_PLUGINS_BAD_PLUGIN_VIDEOFILTERS=y
BR2_PACKAGE_GST1_PLUGINS_BAD_PLUGIN_VIDEOPARSERS=y
BR2_PACKAGE_GST1_PLUGINS_BAD_PLUGIN_BZ2=y
BR2_PACKAGE_GST1_PLUGINS_BAD_PLUGIN_CURL=y
BR2_PACKAGE_GST1_PLUGINS_BAD_PLUGIN_DASH=y
BR2_PACKAGE_GST1_PLUGINS_BAD_PLUGIN_HLS=y
BR2_PACKAGE_GST1_PLUGINS_UGLY=y
BR2_PACKAGE_GST1_PLUGINS_UGLY_PLUGIN_ASFDEMUX=y
BR2_PACKAGE_GST1_PLUGINS_UGLY_PLUGIN_REALMEDIA=y
BR2_PACKAGE_WAVPACK=y
BR2_PACKAGE_GDB=y
BR2_PACKAGE_GDB_SERVER=y
BR2_PACKAGE_GDB_DEBUGGER=y
BR2_PACKAGE_IOZONE=y
BR2_PACKAGE_MEMSTAT=y
BR2_PACKAGE_STRACE=y
BR2_PACKAGE_E2FSPROGS=y
BR2_PACKAGE_EXFAT=y
BR2_PACKAGE_EXFAT_UTILS=y
BR2_PACKAGE_NTFS_3G=y
BR2_PACKAGE_DIRECTFB=y
BR2_PACKAGE_FBDUMP=y
BR2_PACKAGE_DBUS=y
BR2_PACKAGE_LIBMAD=y
BR2_PACKAGE_LIBSAMPLERATE=y
BR2_PACKAGE_LIBJPEG=y
BR2_PACKAGE_MTDEV=y
BR2_PACKAGE_LIBXSLT=y
BR2_PACKAGE_NTP=y
BR2_PACKAGE_FFTW=y
BR2_PACKAGE_FFTW_FAST=y
BR2_PACKAGE_LIBEVDEV=y
BR2_PACKAGE_LIBPTHREAD_STUBS=y
BR2_PACKAGE_LINUX_PAM=y
BR2_PACKAGE_BOA=y
BR2_PACKAGE_DHCPCD=y
BR2_PACKAGE_DNSMASQ=y
BR2_PACKAGE_DNSMASQ_DNSSEC=y
BR2_PACKAGE_DNSMASQ_IDN=y
BR2_PACKAGE_DNSMASQ_CONNTRACK=y
BR2_PACKAGE_DROPBEAR=y
BR2_PACKAGE_HOSTAPD=y
BR2_PACKAGE_HOSTAPD_EAP=y
BR2_PACKAGE_HOSTAPD_WPS=y
BR2_PACKAGE_IW=y
BR2_PACKAGE_NETPLUG=y
BR2_PACKAGE_NETSNMP=y
BR2_PACKAGE_OPENSSH=y
BR2_PACKAGE_RSYNC=y
BR2_PACKAGE_WPA_SUPPLICANT=y
BR2_PACKAGE_WPA_SUPPLICANT_CLI=y
BR2_PACKAGE_ANDROID_TOOLS=y
BR2_PACKAGE_HTOP=y
BR2_PACKAGE_PROCRANK_LINUX=y
BR2_PACKAGE_SWUPDATE=y
BR2_PACKAGE_UTIL_LINUX_BINARIES=y
BR2_TARGET_ROOTFS_CPIO=y
BR2_TARGET_ROOTFS_INITRAMFS_LIST="board/amlogic/mesonc3_pxp_k515/initramfs/ramfslist-32"
BR2_TARGET_ROOTFS_CPIO_UIMAGE=y
BR2_TARGET_ROOTFS_EXT2=y
BR2_TARGET_ROOTFS_EXT2_4=y
BR2_TARGET_ROOTFS_EXT2_SIZE="2048M"
BR2_TARGET_ROOTFS_TAR_GZIP=y
BR2_TARGET_UBOOT=y
BR2_TARGET_UBOOT_BOARDNAME="c2_af400"
BR2_TARGET_UBOOT_CUSTOM_LOCAL=y
BR2_TARGET_UBOOT_CUSTOM_LOCAL_VERSION_VALUE="2019"
BR2_TARGET_UBOOT_CUSTOM_LOCAL_LOCATION="$(TOPDIR)/../bootloader/uboot-repo"
BR2_TARGET_UBOOT_AMLOGIC_REPO=y
BR2_TARGET_UBOOT_PLATFORM="c2"
BR2_TARGET_USBTOOL_AMLOGIC=y
BR2_TARGET_UBOOT_AMLOGIC_BOOTARGS="root=/dev/system rootfstype=ext4 init=/sbin/init kernel_version=upstream"
```

## buildroot/buildroot/configs/m8b_m102_a32_release_defconfig
```kconfig
#----------------------------------------------------------#
#include "arch_a32_6.3.1.config"

#----------------------------------------------------------#
#BR2_LINUX_KERNEL_USE_DEFCONFIG=n
#BR2_LINUX_KERNEL_USE_CUSTOM_CONFIG=y
#BR2_LINUX_KERNEL_CUSTOM_CONFIG_FILE="$(TOPDIR)/../kernel/aml-4.9-q-m805/arch/arm/configs/meson32_m805_defconfig"
#include "m8b_m102.config"
BR2_TARGET_ROOTFS_INITRAMFS_LIST="board/amlogic/mesonm8b_m102/initramfs/ramfslist-32-ubi-release"
```

## buildroot/buildroot/configs/s4_ap222-nand_a6432_release_defconfig
```kconfig
#----------------------------------------------------------#
#include "arch_a6432_6.3.1.config"

#----------------------------------------------------------#
#include "s4_ap222.config"
#include "flash_nand_4k.config"

BR2_PACKAGE_AML_RTOS=n
BR2_TARGET_ROOTFS_INITRAMFS_LIST="board/amlogic/mesons4_ap222/initramfs/ramfslist-32-ubi-release"
BR2_LINUX_KERNEL_INTREE_DTS_NAME="s4_s905y4_ap222_linux-nand"

# Kernel Customized Config
BR2_PACKAGE_AML_CUSTOMIZE_KERNEL=y
BR2_PACKAGE_AML_CUSTOMIZE_KERNEL_ENABLE_OPT_LIST="CONFIG_MTD_UBI CONFIG_UBIFS_FS"
BR2_PACKAGE_AML_CUSTOMIZE_KERNEL_SET_OPT_LIST="CONFIG_MTD_NAND_MESON=y CONFIG_MTD_RESV_MESON=y"

# Test Plan
BR2_PACKAGE_TEST_TOOLS=y
```

## buildroot/buildroot/configs/s4_ap222_a64_release_defconfig
```kconfig
#----------------------------------------------------------#
#include "arch_a64_6.3.1.config"

#----------------------------------------------------------#
#include "s4_ap222.config"
#include "flash_emmc.config"
BR2_TARGET_ROOTFS_INITRAMFS_LIST="board/amlogic/mesons4_ap222/initramfs/ramfslist-64"

BR2_TARGET_ROOTFS_EXT2_SIZE="1024M"
```

## buildroot/buildroot/configs/s4d_ap232_a64_release_defconfig
```kconfig
#----------------------------------------------------------#
#include "arch_a64_6.3.1.config"

#----------------------------------------------------------#
#include "s4d_ap232.config"
#include "flash_emmc.config"
BR2_TARGET_ROOTFS_INITRAMFS_LIST="board/amlogic/mesons4d_ap232/initramfs/ramfslist-64"

BR2_TARGET_ROOTFS_EXT2_SIZE="1024M"
```

## buildroot/buildroot/configs/s5_ax201_a64_release_defconfig
```kconfig
#----------------------------------------------------------#
#include "arch_a64_7.3.1.config"

#----------------------------------------------------------#
#include "s5_ax201.config"
#include "flash_emmc.config"
BR2_TARGET_ROOTFS_INITRAMFS_LIST="board/amlogic/mesons5_ax201/initramfs/ramfslist-64"

BR2_TARGET_ROOTFS_EXT2_SIZE="1024M"

BR2_PACKAGE_VCCKTEST=y
```

## buildroot/buildroot/configs/sc2_ah212_a64_ohw_release_defconfig
```kconfig
BR2_BACKUP_SITE="http://sources.buildroot.net"
BR2_DEPRECATED=y

BR2_aarch64=y
BR2_cortex_a9=y
BR2_ARM_ENABLE_NEON=y
BR2_ARM_ENABLE_VFP=y
BR2_ARM_FPU_NEON=y

BR2_TARGET_ROOTFS_CPIO=y
BR2_TARGET_ROOTFS_CPIO_GZIP=y
BR2_TARGET_ROOTFS_CPIO_UIMAGE=y
BR2_TARGET_ROOTFS_EXT2=y
BR2_TARGET_ROOTFS_EXT2_4=y
BR2_TARGET_ROOTFS_EXT2_SIZE="1024M"
BR2_TARGET_ROOTFS_INITRAMFS_LIST="board/amlogic/mesonsc2_ah212/initramfs/ramfslist-64"
BR2_TARGET_ROOTFS_TAR_GZIP=y

BR2_TARGET_UBOOT=y
BR2_TARGET_UBOOT_AMLOGIC_REPO=y
BR2_TARGET_UBOOT_BOARDNAME="sc2_ah212"
BR2_TARGET_UBOOT_CUSTOM_LOCAL=y
BR2_TARGET_UBOOT_CUSTOM_LOCAL_LOCATION="$(TOPDIR)/../bootloader/uboot-repo"
BR2_TARGET_UBOOT_CUSTOM_LOCAL_VERSION_VALUE="next-2019-dev"
BR2_TARGET_UBOOT_PATCH=""
BR2_TARGET_UBOOT_PLATFORM="sc2"
BR2_TARGET_USBTOOL_AMLOGIC=y

BR2_TOOLCHAIN_EXTERNAL=y
BR2_TOOLCHAIN_EXTERNAL_LINARO_AARCH64_6DOT2_201702_PREINSTALLED=y
BR2_TOOLCHAIN_EXTERNAL_PATH="$(TOPDIR)/../toolchain/gcc/linux-x86/aarch64/gcc-linaro-6.3.1-2017.02-x86_64_aarch64-linux-gnu"
BR2_TOOLCHAIN_EXTERNAL_PREINSTALLED=y

BR2_KERNEL_TOOLCHAIN_LINARO_AARCH64_201702=y
BR2_KERNEL_TOOLCHAIN_PATH="$(TOPDIR)/../toolchain/gcc/linux-x86/aarch64/gcc-linaro-6.3.1-2017.02-x86_64_aarch64-linux-gnu"

BR2_LINUX_KERNEL=y
BR2_LINUX_KERNEL_AMLOGIC_DTD=y
BR2_LINUX_KERNEL_ANDROID_FORMAT=y
BR2_LINUX_KERNEL_CUSTOM_LOCAL=y
BR2_LINUX_KERNEL_CUSTOM_LOCAL_PATH="$(TOPDIR)/../kernel/aml-5.4"
BR2_LINUX_KERNEL_CUSTOM_LOCAL_VERSION_VALUE="amlogic-5.4-dev"
BR2_LINUX_KERNEL_DEFCONFIG="meson64_a64_R"
BR2_LINUX_KERNEL_DTS_SUPPORT=y
BR2_LINUX_KERNEL_GKI=y
BR2_LINUX_KERNEL_GKI_CONFIG="meson64_gki_module_config" 
BR2_LINUX_KERNEL_IMAGE=y
BR2_LINUX_KERNEL_IMAGE_LOADADDR="0x1008000"
BR2_LINUX_KERNEL_INTREE_DTS_NAME="sc2_s905x4_ah212_linux"
BR2_LINUX_KERNEL_PATCH="amlogic-5.4"
BR2_LINUX_KERNEL_USE_INTREE_DTS=y

BR2_PACKAGE_ADB_RNDIS=y
BR2_PACKAGE_AML_AAA=y
BR2_PACKAGE_AML_BOOTLOADER_MESSAGE=y
BR2_PACKAGE_AML_COMMONLIB=y
BR2_PACKAGE_AML_SOC_BOARD_NAME="AH212"
BR2_PACKAGE_AML_SOC_CHIP_NAME="S905X4"
BR2_PACKAGE_AML_SOC_FAMILY_NAME="SC2"
BR2_PACKAGE_AML_UBOOTENV=y
BR2_PACKAGE_AML_USB_CONFIG=y
BR2_PACKAGE_AML_UTIL=y
BR2_PACKAGE_ANDROID_TOOLS=y
BR2_PACKAGE_ANDROID_TOOLS_ADBD=y
BR2_PACKAGE_ANDROID_TOOLS_FASTBOOT_GOOD_KERNEL_HEADERS=y
BR2_PACKAGE_BOOST=y
BR2_PACKAGE_BOOST_FILESYSTEM=y
BR2_PACKAGE_BUSYBOX_SHOW_OTHERS=y
BR2_PACKAGE_CAIRO_SCRIPT=y
BR2_PACKAGE_CJSON=y
BR2_PACKAGE_DHCPCD=y
BR2_PACKAGE_DROPBEAR=y
BR2_PACKAGE_DROPBEAR_CLIENT=y
BR2_PACKAGE_DROPBEAR_SMALL=y
BR2_PACKAGE_E2FSPROGS=y
BR2_PACKAGE_E2FSPROGS=y
BR2_PACKAGE_E2FSPROGS_FSCK=y
BR2_PACKAGE_GDB=y
BR2_PACKAGE_GDB_DEBUGGER=y
BR2_PACKAGE_GDB_SERVER=y
BR2_PACKAGE_GRPC=y
BR2_PACKAGE_HOST_GDB=y
BR2_PACKAGE_HTOP=y
BR2_PACKAGE_ICU=y
BR2_PACKAGE_IOZONE=y
BR2_PACKAGE_LEVELDB=y
BR2_PACKAGE_LIBBINDER=y
BR2_PACKAGE_LIBFUSE=n
BR2_PACKAGE_LIBID3TAG=y
BR2_PACKAGE_LIBJPEG=y
BR2_PACKAGE_LIBMAD=y
BR2_PACKAGE_LIBXSLT=y
BR2_PACKAGE_LINUX_PAM=y
BR2_PACKAGE_LOGCAT=y
BR2_PACKAGE_LOGWRAPPER=y
BR2_PACKAGE_LSOF=y
BR2_PACKAGE_MEMSTAT=y
BR2_PACKAGE_NETPLUG=y
BR2_PACKAGE_NTFS_3G=y
BR2_PACKAGE_NTP=y
BR2_PACKAGE_NTP_NTPD=y
BR2_PACKAGE_NTP_NTPDATE=y
BR2_PACKAGE_OPENSSL=y
BR2_PACKAGE_OPENSSL_BIN=y
BR2_PACKAGE_OPENSSL_ENGINES=y
BR2_PACKAGE_PCRE_16=y
BR2_PACKAGE_PROCRANK_LINUX=y
BR2_PACKAGE_SNAPPY=y
BR2_PACKAGE_STRACE=y
#BR2_PACKAGE_TDK=y
#BR2_PACKAGE_TDK_LOCAL_PATH="$(TOPDIR)/../vendor/amlogic/tdk-3.8"
#BR2_PACKAGE_TDK_VERSION="3.8"
BR2_PACKAGE_TSLIB=y
BR2_PACKAGE_UTIL_LINUX_BINARIES=y
BR2_PACKAGE_VIM=y
BR2_ROOTFS_COMMON_OVERLAY="board/amlogic/common/rootfs/rootfs-54/"
BR2_ROOTFS_DEVICE_CREATION_DYNAMIC_EUDEV=y
BR2_ROOTFS_OVERLAY="board/amlogic/mesonsc2_ah212/rootfs/"
BR2_ROOTFS_POST_BUILD_SCRIPT="$(TOPDIR)/board/amlogic/mesonsc2_ah212/post_build.sh"
BR2_ROOTFS_UPGRADE_DIR="board/amlogic/common/upgrade/upgrade-sc2"
BR2_ROOTFS_UPGRADE_DIR_OVERLAY="board/amlogic/mesonsc2_ah212/upgrade/"
BR2_SYSTEM_DHCP="eth0"
BR2_TARGET_BOARD_PLATFORM="meson8"
BR2_TARGET_GENERIC_ROOT_PASSWD="123456"
```

## buildroot/buildroot/configs/sc2_ah212_k54_a64_release_defconfig
```kconfig
#----------------------------------------------------------#
#include "arch_a64_6.3.1.config"

#----------------------------------------------------------#
#include "sc2_ah212_k54.config"
BR2_TARGET_ROOTFS_INITRAMFS_LIST="board/amlogic/mesonsc2_ah212/initramfs/ramfslist-64"

BR2_PACKAGE_COBALT=n
```

## buildroot/buildroot/configs/sc2_ah212_rdk_a6432_release_defconfig
```kconfig
#----------------------------------------------------------#
#include "arch_a6432_6.3.1.config"

#----------------------------------------------------------#
#include "sc2_ah212_rdk.config"
BR2_TARGET_ROOTFS_INITRAMFS_LIST="board/amlogic/mesonsc2_ah212/initramfs/ramfslist-32"
```

## buildroot/buildroot/configs/sc2_ah219_a6432_release_defconfig
```kconfig
#----------------------------------------------------------#
#include "arch_a6432_6.3.1.config"

#----------------------------------------------------------#
#include "sc2_ah219.config"
BR2_TARGET_ROOTFS_INITRAMFS_LIST="board/amlogic/mesonsc2_ah219/initramfs/ramfslist-32"
```
