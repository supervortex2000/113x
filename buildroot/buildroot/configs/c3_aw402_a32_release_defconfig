## buildroot/buildroot/configs/sm1_ac200_nvr_a64_release_defconfig
```kconfig
#----------------------------------------------------------#
#include "arch_a64_6.3.1.config"

#----------------------------------------------------------#
#include "sm1_ac200_nvr.config"
BR2_TARGET_ROOTFS_INITRAMFS_LIST="board/amlogic/mesonsm1_ac200/initramfs/ramfslist-64"
```

## buildroot/buildroot/configs/t3_ar301_a64_release_defconfig
```kconfig
#----------------------------------------------------------#
#include "arch_a64_6.3.1.config"

#----------------------------------------------------------#
#include "t3_ar301.config"
BR2_TARGET_ROOTFS_INITRAMFS_LIST="board/amlogic/mesont3_ar301/initramfs/ramfslist-64"

BR2_PACKAGE_COBALT=n
```

## buildroot/buildroot/configs/t3_t965d4_a64_release_defconfig
```kconfig
#----------------------------------------------------------#
#include "arch_a64_6.3.1.config"

#----------------------------------------------------------#
#include "t3_t965d4.config"
BR2_TARGET_ROOTFS_INITRAMFS_LIST="board/amlogic/mesont3_t965d4/initramfs/ramfslist-64"

BR2_PACKAGE_COBALT=n
```

## buildroot/buildroot/configs/t5_ak301_roku_a32_release_defconfig
```kconfig
#----------------------------------------------------------#
#include "arch_a32_6.3.1.config"

#----------------------------------------------------------#
#include "t5_ak301_roku.config"

#----------------------------------------------------------#
BR2_TARGET_ROOTFS_INITRAMFS_LIST="board/amlogic/mesont5_ak301/initramfs/ramfslist-32-roku"
BR2_ROOTFS_UPGRADE_DIR="board/amlogic/common/upgrade/upgrade-t5/"

#BR2_PACKAGE_RTK8821CU=y
#BR2_PACKAGE_RTK8821CU_LOCAL=y
#BR2_PACKAGE_RTK8821CU_STANDALONE=y
#BR2_PACKAGE_RTK8821CU_GIT_VERSION="buildroot"
#BR2_PACKAGE_RTK8821CU_LOCAL_PATH="$(TOPDIR)/../hardware/aml-4.9/wifi/realtek/drivers/8821cu"
```

## buildroot/buildroot/configs/t5d_am301_a6432_release_defconfig
```kconfig
#----------------------------------------------------------#
#include "arch_a6432_6.3.1.config"

#----------------------------------------------------------#
#include "t5d_am301.config"
BR2_LINUX_KERNEL_DEFCONFIG="meson64"
BR2_LINUX_KERNEL_UIMAGE=n
BR2_LINUX_KERNEL_IMAGE=y

#include "flash_emmc.config"
BR2_TARGET_ROOTFS_EXT2_SIZE="1024M"
BR2_TARGET_ROOTFS_INITRAMFS_LIST="board/amlogic/mesont5d_am301/initramfs/ramfslist-32"
```
