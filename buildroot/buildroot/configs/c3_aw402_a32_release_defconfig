## buildroot/buildroot/configs/c3_aw402_a32_release_defconfig
```kconfig
#----------------------------------------------------------#
#include "arch_a32_10.3.config"

#----------------------------------------------------------#
#include "c3_aw401.config"
#
#include "arm_rtos_sdk.config"

BR2_LINUX_KERNEL_INTREE_DTS_NAME="c3_c302x_aw402_128m"
BR2_TARGET_UBOOT_BOARDNAME="c3_aw402"
BR2_ROOTFS_UPGRADE_DIR="board/amlogic/common/upgrade/upgrade-c3-doorbell"
BR2_PACKAGE_AML_ARM_RTOS_SDK_BUILD_OPTION="arm64 c3 aw402_c302x fastboot"
#include "flash_nand_2k.config"
BR2_TARGET_ROOTFS_INITRAMFS_LIST="board/amlogic/mesonc3_aw402/initramfs/ramfslist-32-ubi-release"
BR2_LINUX_KERNEL_DEFCONFIG="meson64_a32_C3_mini"
BR2_PACKAGE_AML_CUSTOMIZE_KERNEL_SET_OPT_LIST="CONFIG_FUSE_FS=n CONFIG_NTFS_FS=n CONFIG_OVERLAY_FS=n"
BR2_LINUX_KERNEL_MODULES_SEQUENCE_LIST="board/amlogic/mesonc3_aw402/modules_sequence_list"
BR2_ROOTFS_OVERLAY="board/amlogic/mesonc3_aw402/rootfs/"

BR2_PACKAGE_BUSYBOX_CONFIG="board/amlogic/mesonc3_aw402/busybox.config"
#w1 & broadcom wifi
BR2_PACKAGE_DHD_PRIV=y
BR2_PACKAGE_AML_WIFI=y
BR2_PACKAGE_AML_BT=y
BR2_PACKAGE_WIFI_FW_WIFI_MODULE="AP6201BM"
BR2_PACKAGE_BRCMAP6XXX=y
BR2_PACKAGE_AML_BRCM_BSA=y
BR2_SYSTEM_DHCP="wlan0"
BR2_PACKAGE_BRCMAP6XXX_LOCAL_PATH="$(TOPDIR)/../hardware/aml-5.15/wifi/broadcom/drivers/ap6xxx"


#BLUEZ
BR2_PACKAGE_BLUEZ5_UTILS=y
BR2_PACKAGE_BLUEZ5_UTILS_OBEX=y
BR2_PACKAGE_BLUEZ5_UTILS_CLIENT=y
BR2_PACKAGE_BLUEZ_ALSA=y
BR2_PACKAGE_ALSA_LIB=y
BR2_PACKAGE_FDK_AAC=y

BR2_LINUX_KERNEL_GZIP=y
```

## buildroot/buildroot/configs/c3_aw402_refapp_a32_release_defconfig
```kconfig
#----------------------------------------------------------#
#include "arch_a32_10.3.config"

#----------------------------------------------------------#
#include "c3_aw401.config"
#
#include "arm_rtos_sdk.config"

BR2_LINUX_KERNEL_INTREE_DTS_NAME="c3_c302x_aw402_128m"
BR2_TARGET_UBOOT_BOARDNAME="c3_aw402"
BR2_ROOTFS_UPGRADE_DIR="board/amlogic/common/upgrade/upgrade-c3-doorbell"
BR2_PACKAGE_AML_ARM_RTOS_SDK_BUILD_OPTION="arm64 c3 aw402_c302x fastboot"
#include "flash_nand_2k.config"
BR2_TARGET_ROOTFS_INITRAMFS_LIST="board/amlogic/mesonc3_aw402/initramfs/ramfslist-32-ubi-release"
BR2_LINUX_KERNEL_DEFCONFIG="meson64_a32_C3_mini"
BR2_PACKAGE_AML_CUSTOMIZE_KERNEL_SET_OPT_LIST="CONFIG_FUSE_FS=n CONFIG_NTFS_FS=n CONFIG_OVERLAY_FS=n"
BR2_LINUX_KERNEL_MODULES_SEQUENCE_LIST="board/amlogic/mesonc3_aw402/modules_sequence_list"
BR2_ROOTFS_OVERLAY="board/amlogic/mesonc3_aw402/rootfs/"

BR2_PACKAGE_BUSYBOX_CONFIG="board/amlogic/mesonc3_aw402/busybox.config"
#w1 & broadcom wifi
BR2_PACKAGE_DHD_PRIV=y
BR2_PACKAGE_AML_WIFI=n
BR2_PACKAGE_AML_BT=n
BR2_PACKAGE_WIFI_FW_WIFI_MODULE="AP6201BM"
BR2_PACKAGE_BRCMAP6XXX=y
BR2_PACKAGE_AML_BRCM_BSA=y
BR2_SYSTEM_DHCP="wlan0"

#BLUEZ
BR2_PACKAGE_BLUEZ5_UTILS=n
BR2_PACKAGE_BLUEZ5_UTILS_OBEX=n
BR2_PACKAGE_BLUEZ5_UTILS_CLIENT=n
BR2_PACKAGE_BLUEZ_ALSA=y
BR2_PACKAGE_ALSA_LIB=y
BR2_PACKAGE_FDK_AAC=y

BR2_LINUX_KERNEL_GZIP=y

#JPEG
BR2_PACKAGE_JPEG=y
BR2_PACKAGE_LIBJPEG=y
BR2_PACKAGE_HAS_JPEG=y
BR2_PACKAGE_PROVIDES_JPEG="libjpeg"
BR2_PACKAGE_LIBPNG=y

#quirc
BR2_PACKAGE_QUIRC=y

BR2_PACKAGE_IPC_REFERENCE=y
BR2_IPC_REFERENCE_DOORBELL=y
```

## buildroot/buildroot/configs/c3_aw409-emmc_a32_release_defconfig
```kconfig
#----------------------------------------------------------#
#include "arch_a32_10.3.config"

#----------------------------------------------------------#
#include "c3_aw401.config"
BR2_LINUX_KERNEL_INTREE_DTS_NAME="c3_c302x_aw409-emmc_256m c3_c302x_aw409-emmc_128m"
BR2_TARGET_UBOOT_BOARDNAME="c3_aw409"
#include "flash_emmc.config"
BR2_TARGET_ROOTFS_INITRAMFS_LIST="board/amlogic/mesonc3_aw409/initramfs/ramfslist-32-ext2"
BR2_LINUX_KERNEL_DEFCONFIG="meson64_a32_C3_mini"
```

## buildroot/buildroot/configs/c3_aw409_a32_release_defconfig
```kconfig
#----------------------------------------------------------#
#include "arch_a32_10.3.config"

#----------------------------------------------------------#
#include "c3_aw401.config"
BR2_LINUX_KERNEL_INTREE_DTS_NAME="c3_c302x_aw409_256m c3_c302x_aw409_128m"
BR2_TARGET_UBOOT_BOARDNAME="c3_aw409"
#include "flash_nand_2k.config"
BR2_TARGET_ROOTFS_INITRAMFS_LIST="board/amlogic/mesonc3_aw409/initramfs/ramfslist-32-ubi-release"
BR2_LINUX_KERNEL_DEFCONFIG="meson64_a32_C3_mini"
```

## buildroot/buildroot/configs/c3_aw409_lsb_a32_release_defconfig
```kconfig
#----------------------------------------------------------#
#include "arch_a32_10.3.config"

#----------------------------------------------------------#
#include "c3_aw401_lsb.config"
BR2_LINUX_KERNEL_INTREE_DTS_NAME="c3_c302x_aw409_256m_lsb"
BR2_TARGET_UBOOT_BOARDNAME="c3_aw409"
#include "flash_nand_2k.config"
BR2_TARGET_ROOTFS_INITRAMFS_LIST="board/amlogic/mesonc3_aw409/initramfs/ramfslist-32-ubi-release"
```

## buildroot/buildroot/configs/c3_aw409_refapp_a32_release_defconfig
```kconfig
#----------------------------------------------------------#
#include "arch_a32_10.3.config"

#----------------------------------------------------------#
#include "c3_aw401.config"

BR2_PACKAGE_FBDUMP=n
BR2_PACKAGE_IOZONE=n
BR2_PACKAGE_DIRECTFB=n
BR2_PACKAGE_DIRECTFB_EXAMPLES=n
BR2_PACKAGE_CAIRO=n
BR2_PACKAGE_LIBCONFIG=n
BR2_PACKAGE_LIBCURL=n
BR2_PACKAGE_FLEX=n
BR2_PACKAGE_NTFS_3G=n
BR2_PACKAGE_PIXMAN=n
BR2_PACKAGE_SPEEXDSP=n
BR2_PACKAGE_LIBSVG=n
BR2_PACKAGE_LIBSVG_CAIRO=n

BR2_PACKAGE_LIBMAD=n
BR2_PACKAGE_LIBPTHREAD_STUBS=n
BR2_PACKAGE_LIBXSLT=n
BR2_PACKAGE_NETSNMP=n
BR2_PACKAGE_OPENSSH=n
BR2_PACKAGE_POPT=n
BR2_PACKAGE_RSYNC=n

BR2_PACKAGE_BLUEZ5_UTILS=n
BR2_PACKAGE_BLUEZ5_UTILS_OBEX=n
BR2_PACKAGE_BLUEZ5_UTILS_CLIENT=n
BR2_PACKAGE_BLUEZ_ALSA=n
BR2_PACKAGE_ALSA_LIB=n

BR2_PACKAGE_ADB_RNDIS=n
BR2_PACKAGE_ANDROID_TOOLS=n
BR2_PACKAGE_ANDROID_TOOLS_ADBD=n
BR2_PACKAGE_ANDROID_TOOLS_FASTBOOT_GOOD_KERNEL_HEADERS=n

BR2_PACKAGE_NTP=n
BR2_PACKAGE_NTP_NTPD=n
BR2_PACKAGE_NTP_NTPDATE=n

BR2_PACKAGE_WAVPACK=n
BR2_PACKAGE_FLEX=n
BR2_PACKAGE_AMAUDIO=n

BR2_PACKAGE_GDB=n
BR2_PACKAGE_GDB_SERVER=n
BR2_PACKAGE_GDB_DEBUGGER=n

BR2_PACKAGE_READLINE=y
BR2_PACKAGE_FONTCONFIG=y
BR2_PACKAGE_JSON_GLIB=y
BR2_PACKAGE_LIBGLIB2=y

#JPEG
BR2_PACKAGE_JPEG=y
BR2_PACKAGE_HAS_JPEG=y
BR2_PACKAGE_JPEG_TURBO=y
BR2_PACKAGE_PROVIDES_JPEG="jpeg-turbo"

BR2_PACKAGE_FDK_AAC=y

#quirc
BR2_PACKAGE_QUIRC=y

#refapp
BR2_PACKAGE_SAMPLE=n
BR2_PACKAGE_TOOL=n
BR2_TOOLCHAIN_EXTERNAL_OPENMP=y
BR2_TOOLCHAIN_HAS_OPENMP=y
BR2_PACKAGE_IPC_REFERENCE=y

BR2_LINUX_KERNEL_INTREE_DTS_NAME="c3_c302x_aw409_256m c3_c302x_aw409_128m"
BR2_TARGET_UBOOT_BOARDNAME="c3_aw409"
#include "flash_nand_2k.config"
BR2_TARGET_ROOTFS_INITRAMFS_LIST="board/amlogic/mesonc3_aw409/initramfs/ramfslist-32-ubi-release"
BR2_LINUX_KERNEL_DEFCONFIG="meson64_a32_C3_mini"
```

## buildroot/buildroot/configs/c3_aw419_doorbell_a32_release_defconfig
```kconfig
#----------------------------------------------------------#
#include "arch_a32_10.3.config"

#----------------------------------------------------------#
#include "c3_aw401.config"
#
#include "arm_rtos_sdk.config"
BR2_LINUX_KERNEL_INTREE_DTS_NAME="c3_c308l_aw419"
BR2_TARGET_UBOOT_BOARDNAME="c3_aw419"

BR2_ROOTFS_UPGRADE_DIR="board/amlogic/common/upgrade/upgrade-c3-doorbell"

BR2_PACKAGE_AML_ARM_RTOS_SDK_BUILD_OPTION="arm64 c3 aw419_c308l fastboot"

#include "flash_nand_2k.config"
BR2_TARGET_ROOTFS_INITRAMFS_LIST="board/amlogic/mesonc3_aw401/initramfs/ramfslist-32-ubi-release"
```

## buildroot/buildroot/configs/c3_aw419_refapp_a32_release_defconfig
```kconfig
#----------------------------------------------------------#
#include "arch_a32_10.3.config"

#----------------------------------------------------------#
#include "c3_aw401.config"

BR2_PACKAGE_JSON_GLIB=y

#JPEG
BR2_PACKAGE_JPEG=y
BR2_PACKAGE_HAS_JPEG=y
BR2_PACKAGE_JPEG_TURBO=y
BR2_PACKAGE_PROVIDES_JPEG="jpeg-turbo"

BR2_PACKAGE_LIBMAD=n
BR2_PACKAGE_LIBPTHREAD_STUBS=n
BR2_PACKAGE_LIBXSLT=n
BR2_PACKAGE_NETSNMP=n
BR2_PACKAGE_OPENSSH=n
BR2_PACKAGE_POPT=n
BR2_PACKAGE_RSYNC=n

BR2_PACKAGE_LIBGLIB2=n

#quirc
BR2_PACKAGE_QUIRC=y

#refapp
BR2_TOOLCHAIN_HAS_OPENMP=y
BR2_TOOLCHAIN_EXTERNAL_OPENMP=y
BR2_PACKAGE_IPC_REFERENCE=y

BR2_LINUX_KERNEL_INTREE_DTS_NAME="c3_c308l_aw419"
BR2_TARGET_UBOOT_BOARDNAME="c3_aw419"

#include "flash_nand_2k.config"
BR2_TARGET_ROOTFS_INITRAMFS_LIST="board/amlogic/mesonc3_aw401/initramfs/ramfslist-32-ubi-release"
```

## buildroot/buildroot/configs/c3_aw429_a32_release_defconfig
```kconfig
#----------------------------------------------------------#
#include "arch_a32_10.3.config"

#----------------------------------------------------------#
#include "c3_aw401.config"
BR2_LINUX_KERNEL_INTREE_DTS_NAME="c3_c308l_aw429_256m c3_c308l_aw429_128m"
BR2_TARGET_UBOOT_BOARDNAME="c3_aw429"
#include "flash_nand_2k.config"
BR2_TARGET_ROOTFS_INITRAMFS_LIST="board/amlogic/mesonc3_aw401/initramfs/ramfslist-32-ubi-release"
```

## buildroot/buildroot/configs/c3_pxp-new_a32_release_defconfig
```kconfig
#----------------------------------------------------------#
#include "arch_a32_10.3.config"

#----------------------------------------------------------#
#include "c3_pxp.config"
#include "flash_emmc.config"
BR2_TARGET_ROOTFS_INITRAMFS_LIST="board/amlogic/mesonc3_pxp_k515/initramfs/ramfslist-32"
```
