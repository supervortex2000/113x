## buildroot/buildroot/configs/t5d_am301_nand_a6432_release_defconfig
```kconfig
#----------------------------------------------------------#
#include "arch_a6432_6.3.1.config"

#----------------------------------------------------------#
#include "t5d_am301.config"
BR2_LINUX_KERNEL_DEFCONFIG="meson64"
BR2_LINUX_KERNEL_UIMAGE=n
BR2_LINUX_KERNEL_IMAGE=y

BR2_LINUX_KERNEL_INTREE_DTS_NAME="t5d_t950d4_am301_nand_drm_1.5g"
BR2_PACKAGE_LINUX_PAM=n

#include "flash_nand_4k.config"
BR2_ROOTFS_UPGRADE_DIR="board/amlogic/common/upgrade/upgrade-t5d-nand/"
BR2_TARGET_ROOTFS_INITRAMFS_LIST="board/amlogic/common/initramfs/initramfs-49/ramfslist-32-ubi-release"

BR2_PACKAGE_COBALT=n
```

## buildroot/buildroot/configs/t5d_am311_rdk_a32_release_defconfig
```kconfig
#----------------------------------------------------------#
#include "arch_a32_6.3.1.config"

#----------------------------------------------------------#
#include "t5d_am311_rdk.config"
BR2_LINUX_KERNEL_DEFCONFIG="meson64_a32"
BR2_LINUX_KERNEL_UIMAGE=y
BR2_LINUX_KERNEL_ZIMAGE=n

#include "flash_emmc.config"
BR2_TARGET_ROOTFS_EXT2_SIZE="1024M"
BR2_TARGET_ROOTFS_INITRAMFS_LIST="board/amlogic/mesont5d_am311/initramfs/ramfslist-32"
```

## buildroot/buildroot/configs/t5w_at301_a32_release_defconfig
```kconfig
#----------------------------------------------------------#
#include "arch_a32_6.3.1.config"

#----------------------------------------------------------#
#include "t5w_at301_k54.config"
#include "flash_emmc.config"

BR2_TARGET_ROOTFS_INITRAMFS_LIST="board/amlogic/mesont5w_at301/initramfs/ramfslist-32"

BR2_PACKAGE_COBALT=n
BR2_TARGET_ROOTFS_EXT2_SIZE="1024M"


####"arch_a32_10.3.config"
```

## buildroot/buildroot/configs/t5w_at301_a6432_release_defconfig
```kconfig
#----------------------------------------------------------#
#include "arch_a6432_6.3.1.config"

#----------------------------------------------------------#
#include "t5w_at301.config"
#include "flash_emmc.config"

BR2_TARGET_ROOTFS_INITRAMFS_LIST="board/amlogic/mesont5w_at301/initramfs/ramfslist-32"

BR2_PACKAGE_COBALT=n
BR2_TARGET_ROOTFS_EXT2_SIZE="1024M"
```

## buildroot/buildroot/configs/t5w_at301_a64_release_defconfig
```kconfig
#----------------------------------------------------------#
#include "arch_a64_6.3.1.config"

#----------------------------------------------------------#
#include "t5w_at301.config"
#include "flash_emmc.config"

BR2_TARGET_ROOTFS_INITRAMFS_LIST="board/amlogic/mesont5w_at301/initramfs/ramfslist-64"

BR2_PACKAGE_COBALT=n
BR2_TARGET_ROOTFS_EXT2_SIZE="1024M"
```

## buildroot/buildroot/configs/t5w_at301_roku_release_defconfig
```kconfig
#----------------------------------------------------------#
#include "arch_a32_6.3.1.config"

#----------------------------------------------------------#
#include "t5w_at301_roku.config"
#include "flash_emmc.config"

#BR2_TARGET_ROOTFS_INITRAMFS_LIST="board/amlogic/mesont5w_at301/initramfs/ramfslist-32"
BR2_TARGET_ROOTFS_INITRAMFS_LIST="board/amlogic/mesont5w_at301/initramfs/ramfslist-32-ubi-roku-release"

BR2_PACKAGE_COBALT=n
BR2_TARGET_ROOTFS_EXT2_SIZE="1024M"
```

## buildroot/buildroot/configs/t7_an400_a6432_release_defconfig
```kconfig
#----------------------------------------------------------#
#include "arch_a6432_6.3.1.config"

#----------------------------------------------------------#
#include "t7_an400.config"
BR2_TARGET_ROOTFS_INITRAMFS_LIST="board/amlogic/mesont7_an400/initramfs/ramfslist-32"

BR2_PACKAGE_COBALT=n
```

## buildroot/buildroot/configs/t7_an400_a64_release_defconfig
```kconfig
#----------------------------------------------------------#
#include "arch_a64_6.3.1.config"

#----------------------------------------------------------#
#include "t7_an400.config"
BR2_TARGET_ROOTFS_INITRAMFS_LIST="board/amlogic/mesont7_an400/initramfs/ramfslist-64"

BR2_PACKAGE_COBALT=n
```

## buildroot/buildroot/configs/tm2_ab301-nand_a32_release_defconfig
```kconfig
#----------------------------------------------------------#
#include "arch_a32_6.3.1.config"

#----------------------------------------------------------#
#include "tm2_ab301.config"
#include "flash_nand_4k.config"
BR2_TARGET_ROOTFS_INITRAMFS_LIST="board/amlogic/mesontm2_ab301/initramfs/ramfslist-32"
BR2_LINUX_KERNEL_INTREE_DTS_NAME="tm2_t962x3_ab301-nand_drm_buildroot tm2_revb_t962x3_ab301-nand_drm_buildroot"
```

## buildroot/buildroot/configs/tm2_ab311-nand_a32_release_defconfig
```kconfig
#----------------------------------------------------------#
#include "arch_a32_6.3.1.config"

#----------------------------------------------------------#
#include "tm2_ab311.config"
#include "flash_nand_4k.config"
BR2_TARGET_ROOTFS_INITRAMFS_LIST="board/amlogic/mesontm2_ab311/initramfs/ramfslist-32"
BR2_LINUX_KERNEL_INTREE_DTS_NAME="tm2_t962e2_ab311-nand_drm_buildroot tm2_revb_t962e2_ab311-nand_drm_buildroot"
```

## buildroot/buildroot/configs/tm2_ab311_a6432_release_defconfig
```kconfig
#----------------------------------------------------------#
#include "arch_a6432_6.3.1.config"

#----------------------------------------------------------#
#include "tm2_ab311.config"
BR2_LINUX_KERNEL_DEFCONFIG="meson64"
BR2_LINUX_KERNEL_UIMAGE=n
BR2_LINUX_KERNEL_IMAGE=y
BR2_TARGET_ROOTFS_INITRAMFS_LIST="board/amlogic/mesontm2_ab311/initramfs/ramfslist-32"
```

## buildroot/buildroot/configs/tm2_ab311_roku_a32_release_defconfig
```kconfig
#----------------------------------------------------------#
#include "arch_a32_6.3.1.config"

#----------------------------------------------------------#
#include "tm2_ab311_roku.config"

#----------------------------------------------------------#
BR2_TARGET_ROOTFS_INITRAMFS_LIST="board/amlogic/mesontm2_ab311/initramfs/ramfslist-32-roku"
BR2_ROOTFS_UPGRADE_DIR="board/amlogic/common/upgrade/upgrade-tm2-tv/"
```

## buildroot/buildroot/configs/tm2_t312_nand_roku_a32_release_defconfig
```kconfig
#----------------------------------------------------------#
#include "arch_a32_6.3.1.config"

#----------------------------------------------------------#
#include "tm2_t312_roku.config"

BR2_TARGET_ROOTFS_EXT2=n
BR2_TARGET_ROOTFS_EXT2_4=n
#include "flash_nand_4k.config"

#----------------------------------------------------------#
BR2_TARGET_ROOTFS_INITRAMFS_LIST="board/amlogic/mesontm2_t312/initramfs/ramfslist-32-ubi-roku-release"
BR2_ROOTFS_UPGRADE_DIR="board/amlogic/common/upgrade/upgrade-tm2-tv-nand/"

BR2_PACKAGE_RTK8821CU=y
BR2_PACKAGE_RTK8821CU_LOCAL=y
BR2_PACKAGE_RTK8821CU_STANDALONE=y
BR2_PACKAGE_RTK8821CU_GIT_VERSION="buildroot"
BR2_PACKAGE_RTK8821CU_LOCAL_PATH="$(TOPDIR)/../hardware/aml-4.9/wifi/realtek/drivers/8821cu"
```

## buildroot/buildroot/configs/tm2_t501_a32_release_defconfig
```kconfig
#----------------------------------------------------------#
#include "arch_a32_6.3.1.config"

#----------------------------------------------------------#
#include "tm2_t501.config"
BR2_TARGET_ROOTFS_INITRAMFS_LIST="board/amlogic/mesontm2_t501/initramfs/ramfslist-32"
```

## buildroot/buildroot/package/amlogic/Config.in
```kconfig
menu "amlogic"

#Shared
    source "package/amlogic/aml-aaa/Config.in"
    source "package/amlogic/aml-commonlib/Config.in"
    source "package/amlogic/aml-customer/Config.in"
    source "package/amlogic/aml-share/Config.in"
    source "package/amlogic/aml-uboot-customer/Config.in"
    source "package/amlogic/aml-usb-config/Config.in"
    source "package/amlogic/aml-util/Config.in"
    source "package/amlogic/remotecfg/Config.in"
    source "package/amlogic/system-control/Config.in"
    source "package/amlogic/fota/Config.in"

    source "package/amlogic/liblog/Config.in"
    source "package/amlogic/logcat/Config.in"
    source "package/amlogic/logwrapper/Config.in"
    source "package/amlogic/netcheck/Config.in"

#Testing
    source "package/amlogic/aml-bootloader-message/Config.in"
    source "package/amlogic/aml-pdm-mic-test/Config.in"
    source "package/amlogic/aml-thermal/Config.in"
    source "package/amlogic/aml-ubootenv/Config.in"
    source "package/amlogic/amlogic-test/Config.in"
    source "package/amlogic/test-tools/Config.in"
    source "package/amlogic/vccktest/Config.in"
    source "package/amlogic/spi_led/Config.in"

#GFX
    source "package/amlogic/aml-minigbm/Config.in"
    source "package/amlogic/aml-minigbmtest/Config.in"
    source "package/amlogic/drm-tests/Config.in"
    source "package/amlogic/meson-display/Config.in"
    source "package/amlogic/meson-mali/Config.in"
    source "package/amlogic/ump-userspace-drv/Config.in"
    source "package/amlogic/libdrm-meson/Config.in"

#WiFi/BT/Network
    source "package/amlogic/aml-brcm-bsa/Config.in"
    source "package/amlogic/aml-cypress-bsa/Config.in"
    source "package/amlogic/bluez-alsa/Config.in"
    source "package/amlogic/bluez5-utils/Config.in"
    source "package/amlogic/broadcom/Config.in"
    source "package/amlogic/bt-setup/Config.in"
    source "package/amlogic/qualcomm/Config.in"
    source "package/amlogic/realtek/Config.in"
    source "package/amlogic/wifi-fw/Config.in"
    source "package/amlogic/mdnsresponder/Config.in"
    source "package/amlogic/mtk/Config.in"
    source "package/amlogic/aml-wifibt/Config.in"
    source "package/amlogic/icomm/Config.in"

#Audio
    source "package/amlogic/airplay2/Config.in"
    source "package/amlogic/aml-audio-player/Config.in"
    source "package/amlogic/aml-soundai/Config.in"
    source "package/amlogic/aml-speaker-process/Config.in"
    source "package/amlogic/amr/Config.in"
    source "package/amlogic/assistant-sdk/Config.in"
    source "package/amlogic/audioservice/Config.in"
    source "package/amlogic/aml_halHdmicec/Config.in"
    source "package/amlogic/apl-client-library/Config.in"
    source "package/amlogic/apl-core-library/Config.in"
    source "package/amlogic/avs-sdk/Config.in"
    source "package/amlogic/libpeer/Config.in"
    source "package/amlogic/softhsmv2/Config.in"
    source "package/amlogic/opensc/Config.in"
    source "package/amlogic/ass-sdk/Config.in"
    source "package/amlogic/g711/Config.in"
    source "package/amlogic/ledring/Config.in"
    source "package/amlogic/librespot-sync/Config.in"
    source "package/amlogic/librespot/Config.in"
    source "package/amlogic/libtotem/Config.in"
    source "package/amlogic/platinum/Config.in"
    source "package/amlogic/shairport/Config.in"
    source "package/amlogic/hal-audio-service/Config.in"
    source "package/amlogic/aml-amaudioutils/Config.in"
    source "package/amlogic/aml-audio-hal/Config.in"
    source "package/amlogic/dtv-audio-utils/Config.in"
    source "package/amlogic/libaudioeffect/Config.in"
    source "package/amlogic/load_eq_drc/Config.in"
    source "package/amlogic/cast-lite/Config.in"

#Media
    source "package/amlogic/multimedia/Config.in"
    source "package/amlogic/aml-libgdc/Config.in"
    source "package/amlogic/aml-libge2d/Config.in"
    source "package/amlogic/aml-libion/Config.in"
    source "package/amlogic/aml-libs-nf/Config.in"
    source "package/amlogic/libmultienc/Config.in"
    source "package/amlogic/libvpcodec/Config.in"
    source "package/amlogic/libvphevcodec/Config.in"
    source "package/amlogic/media-modules/Config.in"

#IPC
    source "package/amlogic/aml-nn-detect-library/Config.in"
    source "package/amlogic/aml-nn-aiaudio-library/Config.in"
    source "package/amlogic/arm-isp/Config.in"
    source "package/amlogic/ipc/Config.in"
    source "package/amlogic/uvc-gadget/Config.in"
    source "package/amlogic/slt/Config.in"
    source "package/amlogic/aml-nn-dncnn/Config.in"

#DoorBell
    source "package/amlogic/doorbell/Config.in"

#TV
    source "package/amlogic/aml-tvserver/Config.in"
    source "package/amlogic/aml-dvb/Config.in"
    source "package/amlogic/aml-zvbi/Config.in"
    source "package/amlogic/tuner/Config.in"
    source "package/amlogic/v4l2-uvm-vdin-test/Config.in"
    source "package/amlogic/aml-dtvdemod/Config.in"
#PQ
    source "package/amlogic/aml-pqserver/Config.in"
    source "package/amlogic/video-algorithm/Config.in"

#RTOS
    source "package/amlogic/aml-rtos/Config.in"
    source "package/amlogic/aml-dsp-util/Config.in"
    source "package/amlogic/aml-hifi-rtos-sdk/Config.in"
    source "package/amlogic/aml-arm-rtos-sdk/Config.in"

#Browser
    source "package/amlogic/aml-browser-toolchains/Config.in"
    source "package/amlogic/aml-launcher/Config.in"
    source "package/amlogic/chromium/Config.in"
    source "package/amlogic/cobalt/Config.in"
    source "package/amlogic/libwpe/Config.in"
    source "package/amlogic/web-ui-wifi/Config.in"
    source "package/amlogic/wpe-launcher/Config.in"
    source "package/amlogic/wpe/Config.in"

#Crypto

    source "package/amlogic/aml-af-alg/Config.in"
    source "package/amlogic/aml-bdk/Config.in"
    source "package/amlogic/aml-hdcp/Config.in"
    source "package/amlogic/aml-provision/Config.in"
    source "package/amlogic/tdk/Config.in"
    source "package/amlogic/tdk-driver/Config.in"

#Linux
    source "package/amlogic/aml-nand/Config.in"
    source "package/amlogic/aml-pmu/Config.in"
    source "package/amlogic/aml-touch/Config.in"
    source "package/amlogic/aml-tvin/Config.in"
    source "package/amlogic/gpu/Config.in"
    source "package/amlogic/npu/Config.in"
    source "package/amlogic/acenna_npu/Config.in"

#RDK
    source "package/amlogic/aamp/Config.in"
    source "package/amlogic/aampabr/Config.in"
    source "package/amlogic/westeros/Config.in"

#Misc
    source "package/amlogic/dueros/Config.in"
    source "package/amlogic/helloworld/Config.in"
    #source "package/amlogic/gst-example/Config.in"
    source "package/amlogic/lvgl-app/Config.in"
#Binder
    source "package/amlogic/libbinder/Config.in"

#GST plugins
    source "package/amlogic/gst-plugin-aml-asink/Config.in"
    source "package/amlogic/gst-plugin-aml-vsink/Config.in"
    source "package/amlogic/gst-plugin-aml-picsink/Config.in"

    source "package/amlogic/gst1-plugins-tsplayer/Config.in"

#Boot animation
    source "package/amlogic/boot-animation/Config.in"

#QT demo
    source "package/amlogic/aml-qt-demo/Config.in"

#UAC patches
    source "package/amlogic/aml-uac/Config.in"

#Sraf_browser_sdk
    source "package/amlogic/sraf-browser-sdk/Config.in"
    
#swupdate ui
    source "package/amlogic/aml-swupdate-ui/Config.in"

#aml libjpeg test
    source "package/amlogic/aml-libjpeg-test/Config.in"

#lightweight codec library
    source "package/amlogic/ffmpeg-aml/Config.in"

#AIoT Matter
    source "package/amlogic/connectedhomeip/Config.in"

#lvmedia_tsplayer src
    source "package/amlogic/lvmedia_tsplayer/Config.in"

#lvmediasdk
    source "package/amlogic/lvmediasdk/Config.in"
endmenu
```

## buildroot/buildroot/package/amlogic/acenna_npu/Config.in
```kconfig
config BR2_PACKAGE_ACENNA_NPU
	bool "amlogic amazon npu driver git repo"
	depends on BR2_LINUX_KERNEL	
	help
	  The git of amlogic npu driver git repo
config BR2_PACKAGE_ACENNA_NPU_VERSION
	string "amlogic amazon npu branch" 
	depends on BR2_PACKAGE_ACENNA_NPU
	help
	  the branch of amlogic amazon npu driver

config BR2_PACKAGE_ACENNA_NPU_GIT_URL
	string "amlogic amazon npu driver git repo url"
	depends on BR2_PACKAGE_ACENNA_NPU
	help
	  the URL of amlogic acenna npu driver git repo

config BR2_PACKAGE_ACENNA_NPU_CUSTOM_TARBALL_LOCATION
	string "amlogic amazon npu driver tarball url"
	depends on BR2_PACKAGE_ACENNA_NPU
	help
	  the URL of amlogic amazon npu driver

config BR2_PACKAGE_ACENNA_NPU_LOCAL
	bool "amlogic acenna npu driver local"
	depends on BR2_PACKAGE_ACENNA_NPU
	help
		acenna npu local

config BR2_PACKAGE_ACENNA_NPU_LOCAL_PATH
	string "amlogic acenna npu local path"
	depends on BR2_PACKAGE_ACENNA_NPU_LOCAL
	depends on BR2_PACKAGE_ACENNA_NPU
	help
		acenna npu local path
```

## buildroot/buildroot/package/amlogic/aml-amaudioutils/Config.in
```kconfig
config BR2_PACKAGE_AML_AMAUDIOUTILS
        bool "aml_amaudioutils"
        select BR2_PACKAGE_AML_COMMONLIB
        select BR2_PACKAGE_LIBLOG
        select BR2_PACKAGE_BOOST
        help
          Audio HAL utilities
```
