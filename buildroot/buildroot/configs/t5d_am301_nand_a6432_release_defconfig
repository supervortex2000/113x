## buildroot/buildroot/package/amlogic/aml-arm-rtos-sdk/Config.in
```kconfig
#
# Copyright (c) 2014 Amlogic, Inc. All rights reserved.
# This source code is subject to the terms and conditions defined in the file 'LICENSE' which is part of this source code package.
# Description: Config file
#

config BR2_PACKAGE_AML_ARM_RTOS_SDK
    bool "AML ARM RTOS SDK"
    help
      Amlogic ARM RTOS SDK
      New Architecture

config BR2_PACKAGE_AML_ARM_RTOS_SDK_LOCAL_PATH
    string "amlogic arm RTOS SDK local path"
    depends on BR2_PACKAGE_AML_ARM_RTOS_SDK
    help
      aml arm rtos sdk local path

config BR2_PACKAGE_AML_ARM_RTOS_SDK_PREBUILT_PATH
    string "amlogic ARM RTOS SDK prebuilt path"
    depends on BR2_PACKAGE_AML_ARM_RTOS_SDK
    help
      aml arm rtos sdk prebuilt path

config BR2_PACKAGE_AML_ARM_RTOS_SDK_BUILD_OPTION
    string "AML ARM RTOS SDK DSPA build option"
    depends on BR2_PACKAGE_AML_ARM_RTOS_SDK
    help
      AML ARM RTOS SDK build option
```

## buildroot/buildroot/package/amlogic/aml-audio-hal/Config.in
```kconfig
config BR2_PACKAGE_AML_AUDIO_HAL
        bool "aml_audio_hal"
        select BR2_PACKAGE_AML_AMAUDIOUTILS
        select BR2_PACKAGE_TINYALSA
        select BR2_PACKAGE_ANDROID_TOOLS
        select BR2_PACKAGE_EXPAT
        depends on BR2_PACKAGE_MEDIAHAL_SDK_MEDIASYNC
        help
          Audio HAL ported from Android audio HAL stack

config BR2_PACKAGE_AML_AUDIO_HAL_EQ_DRC
        bool "enable_eq_drc"
	depends on BR2_PACKAGE_AML_AUDIO_HAL
	help
	  Enable DQ/DRC in audio HAL

config BR2_PACKAGE_AML_AUDIO_HAL_DVB
        bool "enable_audio_dvb"
	depends on BR2_PACKAGE_AML_AUDIO_HAL
	select BR2_PACKAGE_AML_DVB
	select BR2_PACKAGE_LIBPLAYER
	help
	  DVB audio tunnel support in audio HAL


config BR2_PACKAGE_AML_AUDIO_HAL_MSYNC
	bool "aml_audio_hal_msync"
	depends on BR2_PACKAGE_AML_AUDIO_HAL
	default y
	help
		Enable MSYNC
```

## buildroot/buildroot/package/amlogic/aml-commonlib/Config.in
```kconfig
menuconfig BR2_PACKAGE_AML_COMMONLIB
	bool "amlogic common library"
	help
	  aml common library

if BR2_PACKAGE_AML_COMMONLIB

config BR2_PACKAGE_AML_LOG
	bool "aml log library"
	default n
	help
	  enable aml log library

config BR2_PACKAGE_AML_SOCKETIPC
	bool "aml socket ipc library"
	default n
	help
	  enable aml socket ipc library

config BR2_PACKAGE_AML_AUDIO_CLOCK_SYNC
	bool "aml_audio_clock_sync"
	help
		Fine tune MCLK to change the soft locker diff value to prevent underrun
endif
```

## buildroot/buildroot/package/amlogic/aml-dsp-util/Config.in
```kconfig
config BR2_PACKAGE_AML_DSP_UTIL
    bool "aml_dsp_util"
    help
        amlogic DSP utility

config BR2_PACKAGE_AML_DSP_UTIL_AUDIO_BRIDGE
    bool "amlogic dsp auido bridge"
    depends on BR2_PACKAGE_AML_DSP_UTIL
    help
        aml dsp auido bridge
```

## buildroot/buildroot/package/amlogic/aml-dtvdemod/Config.in
```kconfig
config BR2_PACKAGE_AML_DTVDEMOD
	bool "t2 demod firmware"
	help
	  t2 demod firmware
```

## buildroot/buildroot/package/amlogic/aml-dvb/Config.in
```kconfig
config BR2_PACKAGE_AML_DVB
    select BR2_PACKAGE_AML_ZVBI
    select BR2_PACKAGE_LIBPLAYER
    select BR2_PACKAGE_SQLITE
    bool "aml dvb libs"
    help
        aml dvb libs
```

## buildroot/buildroot/package/amlogic/aml-hifi-rtos-sdk/Config.in
```kconfig
#
# Copyright (c) 2014 Amlogic, Inc. All rights reserved.
# This source code is subject to the terms and conditions defined in the file 'LICENSE' which is part of this source code package.
# Description: Config file
#

config BR2_PACKAGE_AML_HIFI_RTOS_SDK
    bool "AML HIFI RTOS SDK"
    select BR2_PACKAGE_AML_DSP_UTIL
    help
      Amlogic HIFI RTOS SDK
      New Architecture

config BR2_PACKAGE_AML_HIFI_RTOS_SDK_LOCAL_PATH
    string "amlogic hifi RTOS SDK local path"
    depends on BR2_PACKAGE_AML_HIFI_RTOS_SDK
    help
      aml hifi rtos sdk local path

config BR2_PACKAGE_AML_HIFI_RTOS_SDK_PREBUILT_PATH
    string "amlogic HIFI RTOS SDK prebuilt path"
    depends on BR2_PACKAGE_AML_HIFI_RTOS_SDK
    help
      aml hifi rtos sdk prebuilt path

config BR2_PACKAGE_AML_HIFI_RTOS_SDK_DSPA_BUILD_OPTION
    string "AML HIFI RTOS SDK DSPA build option"
    depends on BR2_PACKAGE_AML_HIFI_RTOS_SDK
    help
      AML HIFI RTOS SDK DSPA build option

config BR2_PACKAGE_AML_HIFI_RTOS_SDK_DSPA_INSTALL
    bool "AML HIFI RTOS SDK DSPA INSTALL to /usr/dsp"
    depends on BR2_PACKAGE_AML_HIFI_RTOS_SDK
    help
      Whether we install dspA bin to /usr/dsp folder

config BR2_PACKAGE_AML_HIFI_RTOS_SDK_DSPA_AUTOLOAD
    bool "Auto load DSP_A RTOS image"
    depends on BR2_PACKAGE_AML_HIFI_RTOS_SDK_DSPA_INSTALL
    help
      Auto load DSP_A RTOS image

config BR2_PACKAGE_AML_HIFI_RTOS_SDK_DSPB_BUILD_OPTION
    string "AML HIFI RTOS SDK DSPB build option"
    depends on BR2_PACKAGE_AML_HIFI_RTOS_SDK
    help
      AML HIFI RTOS SDK DSPB build option

config BR2_PACKAGE_AML_HIFI_RTOS_SDK_DSPB_INSTALL
    bool "AML RTOS DSPB INSTALL to /usr/dsp"
    depends on BR2_PACKAGE_AML_HIFI_RTOS_SDK
    help
      Whether we install dspB bin to /usr/dsp folder

config BR2_PACKAGE_AML_HIFI_RTOS_SDK_DSPB_AUTOLOAD
    bool "Auto load DSP_B RTOS image"
    depends on BR2_PACKAGE_AML_HIFI_RTOS_SDK_DSPB_INSTALL
    help
      Auto load DSP_B RTOS image
```

## buildroot/buildroot/package/amlogic/aml-libjpeg-test/Config.in
```kconfig
config BR2_PACKAGE_AML_LIBJPEG_TEST
  bool "aml libjpeg test"
  help
    aml libjpeg test application
```
