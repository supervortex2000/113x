## buildroot/buildroot/package/amlogic/aml-nn-aiaudio-library/Config.in
```kconfig
config BR2_PACKAGE_AML_NN_AIAUDIO_LIBRARY
    bool "aml nn_audio library"
    help
        Support nn audio library
    depends on BR2_PACKAGE_NPU

if BR2_PACKAGE_AML_NN_AIAUDIO_LIBRARY
menu "model sopport"
source "package/amlogic/aml-nn-aiaudio-library/aml-nn-aiaudio/Config.in"
source "package/amlogic/aml-nn-aiaudio-library/aml-nn-aiaudio-demo/Config.in"
source "package/amlogic/aml-nn-aiaudio-library/aml-nn-aiaudio-model/Config.in"
endmenu
endif
```

## buildroot/buildroot/package/amlogic/aml-nn-aiaudio-library/aml-nn-aiaudio-demo/Config.in
```kconfig
config BR2_PACKAGE_AML_NN_AIAUDIO_DEMO
    bool "aml nn_aiaudio demo library"
    depends on BR2_PACKAGE_NPU
    depends on BR2_PACKAGE_AML_NN_AIAUDIO
    select BR2_PACKAGE_AML_NN_AIAUDIO_MODEL
    help
        Support nn_audio base library
```

## buildroot/buildroot/package/amlogic/aml-nn-aiaudio-library/aml-nn-aiaudio-model/Config.in
```kconfig
config BR2_PACKAGE_AML_NN_AIAUDIO_MODEL
    bool "aml nn_aiaudio model library"
    help
        Support detect model
```

## buildroot/buildroot/package/amlogic/aml-nn-aiaudio-library/aml-nn-aiaudio/Config.in
```kconfig
config BR2_PACKAGE_AML_NN_AIAUDIO
    bool "aml nn_audio"
    depends on BR2_PACKAGE_NPU
    help
        Support nn_audio base library

if BR2_PACKAGE_AML_NN_AIAUDIO
source "package/amlogic/aml-nn-aiaudio-library/aml-nn-aiaudio-model/Config.in"
source "package/amlogic/aml-nn-aiaudio-library/aml-nn-aiaudio-demo/Config.in"
endif
```

## buildroot/buildroot/package/amlogic/aml-nn-detect-library/aml-nn-detect/Config.in
```kconfig
config BR2_PACKAGE_AML_NN_DETECT
    bool "aml nn_detect"
    depends on BR2_PACKAGE_NPU
    help
        Support nn detection base library

if BR2_PACKAGE_AML_NN_DETECT
source "package/amlogic/aml-nn-detect-library/aml-nn-detect-model/Config.in"
endif
```

## buildroot/buildroot/package/amlogic/aml-nn-dncnn/Config.in
```kconfig
config BR2_PACKAGE_AML_NN_DNCNN
    bool " aml nn dncnn"
    help
        Test program for NN
    depends on BR2_PACKAGE_NPU
```

## buildroot/buildroot/package/amlogic/aml-pqserver/Config.in
```kconfig
config BR2_PACKAGE_AML_PQSERVER
    bool "aml_pqserver"
    help
      amlogic pq library and bin.

      http://openlinux.amlogic.com

if BR2_PACKAGE_AML_PQSERVER

config BR2_PACKAGE_AML_PQSERVER_USE_LIBBINDER
    bool "aml_pqserver_use_binder"
    default n
    select BR2_PACKAGE_LIBBINDER
    select BR2_PACKAGE_LIBLOG
    help
       This option will define TV_IPC_TYPE to TV_BINDER
       or TV_DBUS, which will define in the mk.

endif
```

## buildroot/buildroot/package/amlogic/aml-qt-demo/Config.in
```kconfig
menu "aml-qt-demo"
source "package/amlogic/aml-qt-demo/aml-qt-camera/Config.in"
source "package/amlogic/aml-qt-demo/aml-qt-launcher/Config.in"
endmenu
```

## buildroot/buildroot/package/amlogic/aml-qt-demo/aml-qt-camera/Config.in
```kconfig
config BR2_PACKAGE_AML_QT_CAMERA
    bool "aml-qt-camera"
    select BR2_PACKAGE_QT5BASE
    select BR2_PACKAGE_QT5MULTIMEDIA
    help
      qt camera demo application based on qt5
```

## buildroot/buildroot/package/amlogic/aml-qt-demo/aml-qt-launcher/Config.in
```kconfig
config BR2_PACKAGE_AML_QT_LAUNCHER
    bool "aml-qt-launcher"
    select BR2_PACKAGE_QT5BASE
    select BR2_PACKAGE_QT5MULTIMEDIA
    help
      When bootup, start QT launcher demo directly without boot animation
```

## buildroot/buildroot/package/amlogic/aml-swupdate-ui/Config.in
```kconfig
config BR2_PACKAGE_AML_SWUPDATE_UI
    bool  "swupdate ui"
    default n
    help
        display the process of recovery.
```

## buildroot/buildroot/package/amlogic/aml-tvserver/Config.in
```kconfig
config BR2_PACKAGE_AML_TVSERVER
    bool "aml_tvserver"
    select BR2_PACKAGE_HAL_AUDIO_SERVICE
    select BR2_PACKAGE_LIBBINDER
    select BR2_PACKAGE_LIBLOG
    select BR2_PACKAGE_TUNER
    help
      amlogic tv library and bin.

      http://openlinux.amlogic.com
```

## buildroot/buildroot/package/amlogic/aml-uac/Config.in
```kconfig
config BR2_PACKAGE_AML_UAC
    bool "aml-uac"
    default n
    help
       support uac function
```

## buildroot/buildroot/package/amlogic/aml-wifibt/Config.in
```kconfig
source "package/amlogic/aml-wifibt/aml-wifi/Config.in"
source "package/amlogic/aml-wifibt/aml-bt/Config.in"
```

## buildroot/buildroot/package/amlogic/aml-wifibt/aml-bt/Config.in
```kconfig
config BR2_PACKAGE_AML_BT
	bool "aml bt for bluez"
	depends on BR2_LINUX_KERNEL
	help
	aml bt

config BR2_PACKAGE_AML_BT_LOCAL_PATH
	string "aml bt codes local path"
	depends on BR2_PACKAGE_AML_BT
	help
		aml bt codes local path

source "package/amlogic/aml-wifibt/aml-bt/aml-bt-ct/Config.in"
```

## buildroot/buildroot/package/amlogic/aml-wifibt/aml-bt/aml-bt-ct/Config.in
```kconfig
config BR2_PACKAGE_AML_BT_CT
	bool "aml bt conduction test tool"
	depends on BR2_PACKAGE_AML_BT
	default y
	help
	aml bt conduction test tool
```

## buildroot/buildroot/package/amlogic/aml-wifibt/aml-wifi/Config.in
```kconfig
config BR2_PACKAGE_AML_WIFI
	bool "aml_wifi"
	depends on BR2_LINUX_KERNEL
	help
	  aml_wifi driver

config BR2_PACKAGE_AML_WIFI_LOCAL
	bool "aml_wifi local"
	help
		aml_wifi local

config BR2_PACKAGE_AML_WIFI_STANDALONE
	bool "standalone kernel module"
	depends on BR2_PACKAGE_AML_WIFI
	help
	  compile ko directly

config BR2_PACKAGE_AML_WIFI_GIT_VERSION
	string "aml_wifi branch"
	depends on BR2_PACKAGE_AML_WIFI
	help
		Branch for aml_wifi

config BR2_PACKAGE_AML_WIFI_LOCAL_PATH
	string "aml_wifi local path"
	depends on BR2_PACKAGE_AML_WIFI_LOCAL
	help
		aml_wifi local path

config BR2_PACKAGE_AML_WIFI_GIT_REPO_URL
	string "aml_wifi git"
	depends on BR2_PACKAGE_AML_WIFI
	help
		aml_wifi git


config BR2_PACKAGE_AML_WIFI_W1U
	bool "aml_wifi w1u"
	depends on BR2_LINUX_KERNEL
	help
	  aml_wifi w1u driver

config BR2_PACKAGE_AML_WIFI_W1U_LOCAL
	bool "aml_wifi w1u local"
	help
		aml_wifi w1u local

config BR2_PACKAGE_AML_WIFI_W1U_STANDALONE
	bool "standalone kernel module"
	depends on BR2_PACKAGE_AML_WIFI_W1U
	help
	  compile ko directly

config BR2_PACKAGE_AML_WIFI_W1U_GIT_VERSION
	string "aml_wifi branch"
	depends on BR2_PACKAGE_AML_WIFI_W1U
	help
		Branch for aml_wifi

config BR2_PACKAGE_AML_WIFI_W1U_LOCAL_PATH
	string "aml_wifi local path"
	depends on BR2_PACKAGE_AML_WIFI_W1U_LOCAL
	help
		aml_wifi w1u local path

config BR2_PACKAGE_AML_WIFI_W1U_GIT_REPO_URL
    string "aml_wifi w1u git"
    depends on BR2_PACKAGE_AML_WIFI_W1U
    help
        aml_wifi w1u git


config BR2_PACKAGE_AML_WIFI_W2
	bool "aml_wifi w2"
	depends on BR2_LINUX_KERNEL
	help
	  aml_wifi w2 driver

config BR2_PACKAGE_AML_WIFI_W2_LOCAL
	bool "aml_wifi w2 local"
	help
		aml_wifi w2 local

config BR2_PACKAGE_AML_WIFI_W2_STANDALONE
	bool "standalone kernel module"
	depends on BR2_PACKAGE_AML_WIFI_W2
	help
	  compile ko directly

config BR2_PACKAGE_AML_WIFI_W2_GIT_VERSION
	string "aml_wifi branch"
	depends on BR2_PACKAGE_AML_WIFI_W2
	help
		Branch for aml_wifi w2

config BR2_PACKAGE_AML_WIFI_W2_LOCAL_PATH
	string "aml_wifi local path"
	depends on BR2_PACKAGE_AML_WIFI_W2_LOCAL
	help
		aml_wifi w2 local path

config BR2_PACKAGE_AML_WIFI_W2_GIT_REPO_URL
	string "aml_wifi w2 git"
	depends on BR2_PACKAGE_AML_WIFI_W2
	help
		aml_wifi w2 git
```

## buildroot/buildroot/package/amlogic/aml_halHdmicec/Config.in
```kconfig
config BR2_PACKAGE_AML_HALHDMICEC
	bool  "Enable Amlogic Hdmi CEC hal"
	select  BR2_PACKAGE_RSYSLOG
	default n
```

## buildroot/buildroot/package/amlogic/aml_systemd/Config.in
```kconfig
config BR2_PACKAGE_AML_SYSTEMD
	bool "aml_systemd"
	help
	  systemd for miracast
```

## buildroot/buildroot/package/amlogic/apl-client-library/Config.in
```kconfig
config BR2_PACKAGE_APL_CLIENT_LIBRARY
	bool "apl client library"
	help
      The APL Client Library provides communication between APLViewhostWeb and apl-core-library
```

## buildroot/buildroot/package/amlogic/apl-core-library/Config.in
```kconfig
config BR2_PACKAGE_APL_CORE_LIBRARY
	bool "apl core library"
	help
	  The rendering of screen layouts at runtime for the Alexa Presentation Language is controlled by the APL Core Library
```

## buildroot/buildroot/package/amlogic/ass-sdk/Config.in
```kconfig
config BR2_PACKAGE_ASS_SDK
	bool "ass-sdk"
	select BR2_PACKAGE_NODEJS_ARCH_SUPPORTS
	select BR2_PACKAGE_NODEJS
	select BR2_PACKAGE_NODEJS_NPM
#       select BR2_PACKAGE_NODEJS_MODULES_ADDITIONAL
#       select BR2_PACKAGE_NODEJS_MODULES_ADDITIONAL_DEPS
	select BR2_PACKAGE_WEBSOCKETPP
	select BR2_PACKAGE_APL_CLIENT_LIBRARY
	select BR2_PACKAGE_APL_CORE_LIBRARY
	help
		The Alexa Smart Screen SDK extends the AVS Device SDK to support development for screen-based Alexa Built-in products. The Smart Screen SDK enables device makers to build screen-based products that complement Alexa voice responses with rich visual experiences.

		https://developer.amazon.com/en-US/docs/alexa/alexa-smart-screen-sdk/overview.html
```

## buildroot/buildroot/package/amlogic/audioservice/Config.in
```kconfig
menuconfig BR2_PACKAGE_AUDIOSERVICE
	bool  "aml audioservice"
	select  BR2_PACKAGE_DBUS
	select  BR2_PACKAGE_DBUS_GLIB
	select  BR2_PACKAGE_CJSON
	select  BR2_PACKAGE_RSYSLOG
	select  BR2_PACKAGE_AML_COMMONLIB
        help
		demo app to show

if BR2_PACKAGE_AUDIOSERVICE

config BR2_PACKAGE_AUDIOSERVICE_PULSEAUDIO
	bool  "Enable audioservice with PulseAudio"
	select  BR2_PACKAGE_PULSEAUDIO
	select  BR2_PACKAGE_PULSEAUDIO_DAEMON
	default n

config BR2_PACKAGE_AUDIOSERVICE_HALAUDIO
	bool  "Enable audioservice with HalAudio"
	select  BR2_PACKAGE_AML_HALAUDIO
	default n

config BR2_PACKAGE_AUDIOSERVICE_FFMPEG
	bool  "Enable audioservice with ffmpeg"
	select  BR2_PACKAGE_FFMPEG_AML
	default n

config BR2_PACKAGE_AUDIOSERVICE_RESAMPLE
	bool  "Enable audioservice with Resample"
	default n

config BR2_PACKAGE_AUDIOSERVICE_ASR
	bool  "Enable audioservice client asr uartcmd"
	default n

config BR2_PACKAGE_AUDIOSERVICE_PYTHON
	bool  "Enable audioservice python client"
	select  BR2_PACKAGE_DBUS_PYTHON
	select  BR2_PACKAGE_PYTHON_PYEXPAT
	select  BR2_PACKAGE_PYTHON
	select  BR2_PACKAGE_PYTHON_GOBJECT
  default n

config BR2_PACKAGE_AUDIOSERVICE_S400_SBR
	bool  "Amlogic SoundBar Refernece platform"
	default n
	help
	  It's for dynamic control MCLK and SCLK.

config BR2_PACKAGE_AUDIOSERVICE_S410_SBR
	bool  "S410 SoundBar Refernece platform"
	default n
	help
	  It's for dynamic control MCLK and SCLK.

config BR2_PACKAGE_AUDIOSERVICE_AV400_SBR
	bool  "Amlogic SoundBar Refernece platform"
	default n
	help
	  It's for dynamic control MCLK and SCLK.

config BR2_PACKAGE_AUDIOSERVICE_AB311_SBR
	bool  "Amlogic SoundBar Refernece platform"
	default n
	help
	  It's for dynamic control MCLK and SCLK.

config BR2_PACKAGE_AUDIOSERVICE_CONFIG_FILE
	string "set the audioservice configuration file"
	default "default_audioservice_s400_sb.conf"
	help
		It selects which default_audioservice.conf

config BR2_PACKAGE_AUDIOSERVICE_EXTERNAL_M6350
	bool "Enable external M6350 device"
	default n
	help
		Enable external input handle m6350

config BR2_PACKAGE_AUDIOSERVICE_EXTERNAL_962E
	bool "Enable 962E device"
	default n
	help
		Enable 962E
config BR2_PACKAGE_AUDIOSERVICE_EXTERNAL_M031
	bool "Enable external M031 device"
	default n
	help
		Enable external input handle mcu031
config BR2_PACKAGE_AUDIOSERVICE_EXTERNAL_ADV7674
	bool "Enable external ADV7674 device"
	default n
	help
		Enable external input handle ADV7674

config BR2_PACKAGE_AUDIOSERVICE_STRESSTEST
	bool "Enable stress test"
	default n

config BR2_PACKAGE_AUDIOSERVICE_USBPLAYER
	bool  "Enable usb Player in homeapp"
	select BR2_PACKAGE_FFMPEG_AML
	select  BR2_PACKAGE_AML_AUDIO_PLAYER
	default n

config BR2_PACKAGE_AUDIOSERVICE_AIRPLAY
	bool  "Enable airplay client in homeapp"
	select BR2_PACKAGE_AIRPLAY2
	default n

config BR2_PACKAGE_AUDIOSERVICE_CAST_LITE
	bool  "Enable cast lite client in homeapp"
	select BR2_PACKAGE_CAST_LITE
	default n

config BR2_PACKAGE_AUDIOSERVICE_LINE_IN_LOCAL
	bool  "Enable line in local in homeapp"
	default n

config BR2_PACKAGE_AUDIOSERVICE_AMLUART
	bool  "Enable AMLUART client in homeapp"
	default n

config BR2_PACKAGE_DOLBY_ATMOS_VERSION_1_7
    bool "dolby atmos version v1.7"
    default n
    select BR2_PACKAGE_DOLBY_ATMOS_RELEASE
    help
        dolby atmos version v1.7

config BR2_PACKAGE_AUDIOSERVICE_DISPLAY_LED_ENABLE
    bool "Enable display led"
    default n
    help
		Enable display led

config BR2_PACKAGE_AUDIOSERVICE_DISPLAY_LCD_ENABLE
    bool "Enable display lcd"
    default n
    help
		Enable display lcd

config BR2_PACKAGE_AUDIOSERVICE_DISPLAY_SPEAK_ENABLE
    bool "Enable display speak"
    default n
    help
		Enable display speak

config BR2_PACKAGE_AUDIOSERVICE_INPUT_VAD_ENABLE
    bool "Enable input vad"
    default n
    help
		Enable input vad

config BR2_PACKAGE_AUDIOSERVICE_KEY_BLE_CONFIG_ENABLE
    bool "Enable key bt config"
    default n
    help
		Enable key ble config

config BR2_PACKAGE_AUDIOSERVICE_INPUT_BT_ENABLE
    bool "Enable input bt"
    default n
    help
		Enable input bt

config BR2_PACKAGE_AUDIOSERVICE_HAL_HDMI_CEC_ENABLE
    bool "Enable hal hdmi cec"
    default n
    help
		Enable hal hdmi cec

config BR2_PACKAGE_AUDIOSERVICE_HOMEAPP_CONFIG_FILE
	string "set the homeapp configuration file"
	help
		It selects which default_homeapp.conf

endif
```

## buildroot/buildroot/package/amlogic/avs-sdk/Config.in
```kconfig
config BR2_PACKAGE_AVS_SDK
	bool "avs-sdk"
	select BR2_PACKAGE_LIBGMIME
	select BR2_PACKAGE_LIBTOTEM
	select BR2_PACKAGE_LIBCURL
	select BR2_PACKAGE_NGHTTP2
	select BR2_PACKAGE_OPENSSL
	select BR2_PACKAGE_SQLITE
	select BR2_PACKAGE_GSTREAMER1
	select BR2_PACKAGE_GST1_PLUGINS_BASE
	select BR2_PACKAGE_PKGCONF
	select BR2_PACKAGE_LEDRING
	select BR2_PACKAGE_DBUS
	help
		The Alexa Voice Service (AVS) enables developers to integrate Alexa directly
	   	into their products, bringing the
		convenience of voice control to any connected device. AVS provides developers
	   	with access to a suite of resources
		to quickly and easily build Alexa-enabled products, including APIs, hardware
	   	development kits, software development kits, and documentation.

config BR2_AVS_DSPC_AEC_WWE
    bool "Enable both DSPC_AEC and DSPC_WWE, as they are merged together."
	default n

config BR2_AVS_AMAZON_WWE
        bool "enable amazon wwe"

config BR2_AVS_RDSPC
        bool "enable RDSPC AFE"

config BR2_PACKAGE_DISPLAYCARD_AML_IMP
        bool "enable avs displaycard ."
        default n

config BR2_AVS_CLIENT_API
	select BR2_PACKAGE_AML_LOG
        bool "enable client api support"

config BR2_PACKAGE_AVS_SDK_SITE
    string "avs sdk path"
    default "$(TOPDIR)/../multimedia/avs"

config AVS_NOT_BUILD_SAMPLEAPP
    bool "not build avs sampleapp"
    default n

config BR2_AVS_AMLOGIC_DSP
    bool "use amlogic dsp ace and wwe"
    default n

config BR2_AVS_ASP_DSPC_AEC
    bool "use ASP, which includes DSPC_AEC"
    default n

config BR2_AVS_BLUETOOTH_ENABLE
    bool "enable avs bluetooth"
    default n
```

## buildroot/buildroot/package/amlogic/boot-animation/Config.in
```kconfig
config BR2_PACKAGE_BOOT_ANIMATION
    bool "boot-animation"
    select BR2_PACKAGE_GST1_PLUGINS_BAD_PLUGIN_VIDEOPARSERS
    select BR2_PACKAGE_GST1_PLUGINS_BASE_PLUGIN_VIDEOCONVERT
    select BR2_PACKAGE_GST1_PLUGINS_BASE_PLUGIN_VIDEOSCALE
    depends on BR2_PACKAGE_GSTREAMER1 && BR2_PACKAGE_GST1_PLUGINS_TSPLAYER && BR2_PACKAGE_GST1_LIBAV
    help
      boot animation!
      see http://www.amlogic.com for more on this software
```
