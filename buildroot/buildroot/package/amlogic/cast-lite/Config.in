## buildroot/buildroot/package/amlogic/cast-lite/Config.in
```kconfig
config BR2_PACKAGE_CAST_LITE
	bool "cast lite"

	select BR2_PACKAGE_FFMPEG_AML
	select BR2_PACKAGE_ALSA_LIB
	select BR2_PACKAGE_LIBNSS
	select BR2_PACKAGE_LIBNSPR
	select BR2_PACKAGE_AML_SOCKETIPC

	help
	  cast lite sdk
```

## buildroot/buildroot/package/amlogic/connectedhomeip/Config.in
```kconfig
menuconfig BR2_PACKAGE_CONNECTEDHOMEIP
	bool  "Amlogic Matter"
    help
	  It`s for Matter
```

## buildroot/buildroot/package/amlogic/doorbell/Config.in
```kconfig
config BR2_PACKAGE_DOORBELL
    bool "doorbell"
    help
    doorbell application
```

## buildroot/buildroot/package/amlogic/dtv-audio-utils/Config.in
```kconfig
config BR2_PACKAGE_DTV_AUDIO_UTILS
    bool "dtv_audio_utils"
    select BR2_PACKAGE_LIBLOG
    select BR2_PACKAGE_LIBBINDER
    select BR2_PACKAGE_AML_AMAUDIOUTILS
    help
        dtv_audio_utils
```

## buildroot/buildroot/package/amlogic/gst-plugin-aml-asink/Config.in
```kconfig
config BR2_PACKAGE_GST_PLUGIN_AML_ASINK
    bool "gst-plugin-aml-asink"
    depends on BR2_PACKAGE_HAL_AUDIO_SERVICE && BR2_PACKAGE_GSTREAMER1
    help
        gstreamer plugin for audio HAL

if BR2_PACKAGE_GST_PLUGIN_AML_ASINK

  config BR2_PACKAGE_GST_PLUGIN_AML_ASINK_XRUN
    bool "Enable xrun detection"
    default n
    help
        Enable xrun detection, which can let cobalt get correct current time

endif #BR2_PACKAGE_GST_PLUGIN_AML_ASINK
```

## buildroot/buildroot/package/amlogic/gst-plugin-aml-picsink/Config.in
```kconfig
config BR2_PACKAGE_GST_PLUGIN_AML_PICSINK
    bool "gst-plugin-aml-picsink"
    depends on BR2_PACKAGE_LIBIMAGEPLAYER
    help
        gstreamer plugin for pic decoder
```

## buildroot/buildroot/package/amlogic/gst-plugin-aml-vsink/Config.in
```kconfig
config BR2_PACKAGE_GST_PLUGIN_AML_VSINK
    bool "gst-plugin-aml-vsink"
    depends on BR2_PACKAGE_LIBDRM && BR2_PACKAGE_GSTREAMER1 && BR2_PACKAGE_AVSYNC_LIB && BR2_PACKAGE_LIBDRM_MESON && BR2_PACKAGE_GST_PLUGIN_AML_ASINK
    help
        gstreamer plugin for video layer rendering only
```

## buildroot/buildroot/package/amlogic/gst1-plugins-tsplayer/Config.in
```kconfig
menuconfig BR2_PACKAGE_GST1_PLUGINS_TSPLAYER
    bool "gst1-plugins-tsplayer"
    depends on BR2_PACKAGE_GSTREAMER1
    depends on BR2_PACKAGE_GST1_PLUGINS_BASE
    depends on BR2_PACKAGE_MEDIAHAL_SDK_TSPLAYER
    help
        Amlogic GStreamer1 plugins 1.0 based on tsplayer.

if BR2_PACKAGE_GST1_PLUGINS_TSPLAYER
    config BR2_PACKAGE_GST1_PLUGINS_TSPLAYER_DEFAULT
        bool "gst1-plugins-tsplayer amltspasink,amltspvsink"
        default y
        help
            Amlogic default GStreamer1 plugins 1.0 based on tsplayer.
            amltspasink, amltspvsink.
    config BR2_PACKAGE_GST1_PLUGINS_TSPLAYER_TEST_TOOLS
        bool "gst1-plugins-tsplayer-test-tools"
        default y
        depends on BR2_PACKAGE_GST1_PLUGINS_TSPLAYER_DEFAULT
        help
            test tools for amltspvsink and amltspasink.
endif
```

## buildroot/buildroot/package/amlogic/hal-audio-service/Config.in
```kconfig
config BR2_PACKAGE_HAL_AUDIO_SERVICE
    bool "hal_audio_service"
    depends on BR2_PACKAGE_LIBLOG && BR2_PACKAGE_GRPC && BR2_PACKAGE_BOOST && BR2_PACKAGE_BOOST_SYSTEM && BR2_PACKAGE_BOOST_FILESYSTEM && BR2_PACKAGE_BOOST && BR2_PACKAGE_BOOST_SYSTEM && BR2_PACKAGE_BOOST_FILESYSTEM && BR2_PACKAGE_GRPC
    help
      Audio HAL server and client API
```

## buildroot/buildroot/package/amlogic/icomm/sv6158/Config.in
```kconfig
config BR2_PACKAGE_SV6158
	bool "sv6158"
	depends on BR2_LINUX_KERNEL
	help
	  sv6158 driver

config BR2_PACKAGE_SV6158_GIT_VERSION
	string "sv6158 git branch"
	depends on BR2_PACKAGE_SV6158
	help
		git branch for sv6158

config BR2_PACKAGE_SV6158_GIT_REPO_URL
	string "sv6158 git URL"
	depends on BR2_PACKAGE_SV6158
	help
		sv6158 git URL

config BR2_PACKAGE_SV6158_LOCAL
	bool "sv6158 local"
	help
		build sv6158 from local source code

config BR2_PACKAGE_SV6158_LOCAL_PATH
	string "sv6158 local path"
	depends on BR2_PACKAGE_SV6158_LOCAL
	help
		sv6158 local source path

config BR2_PACKAGE_SV6158_STANDALONE
	bool "standalone kernel module"
	depends on BR2_PACKAGE_SV6158
	help
	  compile ko directly
```

## buildroot/buildroot/package/amlogic/ipc/Config.in
```kconfig
menu "ip camera"
source "package/amlogic/ipc/onvif_prebuilt/Config.in"
source "package/amlogic/ipc/onvif-srvd/Config.in"
source "package/amlogic/ipc/onvif-wsdd/Config.in"
source "package/amlogic/ipc/onvif-rtsp/Config.in"
source "package/amlogic/ipc/ipc-property/Config.in"
source "package/amlogic/ipc/ipc-webui/Config.in"
source "package/amlogic/ipc/ipc-autocap/Config.in"
source "package/amlogic/ipc/gst-amlion-allocator/Config.in"
source "package/amlogic/ipc/gst-plugin-amlimgcap/Config.in"
source "package/amlogic/ipc/gst-plugin-amloverlay/Config.in"
source "package/amlogic/ipc/gst-plugin-amlvconv/Config.in"
source "package/amlogic/ipc/gst-plugin-amlgdc/Config.in"
source "package/amlogic/ipc/gst-plugin-amlvenc/Config.in"
source "package/amlogic/ipc/gst-plugin-amlnn/Config.in"
source "package/amlogic/ipc/ptz_control/Config.in"
source "package/amlogic/ipc/gst-plugin-amlwebstreamserversink/Config.in"
source "package/amlogic/ipc/ipc-sdk/Config.in"
source "package/amlogic/ipc/ipc-refapp/Config.in"
source "package/amlogic/ipc/ipc-system-service/Config.in"
source "package/amlogic/ipc/ipc-ircut-module/Config.in"
source "package/amlogic/ipc/ipc-wifi-qr-connect/Config.in"
source "package/amlogic/ipc/quirc/Config.in"
source "package/amlogic/ipc/ipc-webstream-server/Config.in"
source "package/amlogic/ipc/ipc-rtsp-server/Config.in"
source "package/amlogic/ipc/ipc-mp4muxer/Config.in"
source "package/amlogic/ipc/webrtc-apm/Config.in"
source "package/amlogic/ipc/ipc-sqe/Config.in"
source "package/amlogic/ipc/mbp/Config.in"
source "package/amlogic/ipc/ipc-reference/Config.in"
endmenu
```

## buildroot/buildroot/package/amlogic/ipc/ipc-ircut-module/Config.in
```kconfig
config BR2_PACKAGE_IPC_IRCUT_MODULE
	bool "ircut kernel driver"
	depends on BR2_LINUX_KERNEL
	help
	  ircut module kernel driver
```

## buildroot/buildroot/package/amlogic/ipc/ipc-mp4muxer/Config.in
```kconfig
config BR2_PACKAGE_IPC_MP4MUXER
	bool "ipc mp4muxer"
	select BR2_PACKAGE_IPC_SDK
	help
	  ipc mp4muxer library
```

## buildroot/buildroot/package/amlogic/ipc/ipc-qlink-client/Config.in
```kconfig
config BR2_PACKAGE_IPC_QLINK_CLIENT
	bool "ipc qlink client app"
	select BR2_PACKAGE_IPC_PROPERTY
	select BR2_PACKAGE_CJSON
	select BR2_PACKAGE_OPENSSL
	help
	  ipc reference qlink client application
```

## buildroot/buildroot/package/amlogic/ipc/ipc-refapp/Config.in
```kconfig
config BR2_PACKAGE_IPC_REFAPP
	bool "ipc reference app"
	select BR2_PACKAGE_AML_NN_DETECT
	select BR2_PACKAGE_SQLITE
	select BR2_PACKAGE_LIBJPEG
	select BR2_PACKAGE_IPC_SDK
	select BR2_PACKAGE_IPC_PROPERTY
	select BR2_PACKAGE_LIBGPIOD
	select BR2_PACKAGE_LIBGPIOD_TOOLS
	select BR2_PACKAGE_IPC_IRCUT_MODULE
	select BR2_PACKAGE_IPC_WEBSTREAM_SERVER
	select BR2_PACKAGE_IPC_RTSP_SERVER
	select BR2_PACKAGE_IPC_MP4MUXER
	help
	  ipc reference application
```

## buildroot/buildroot/package/amlogic/ipc/ipc-reference/Config.in
```kconfig
config BR2_PACKAGE_IPC_REFERENCE
	bool "ipc reference"
	depends on BR2_PACKAGE_MBI
	depends on BR2_PACKAGE_SENSOR
	select BR2_PACKAGE_OPENCV3
	select BR2_PACKAGE_OPENCV3_LIB_IMGCODECS
	select BR2_PACKAGE_OPENCV3_LIB_IMGPROC
	select BR2_PACKAGE_OPENCV3_WITH_JPEG
    help
      c3 reference application

if BR2_PACKAGE_IPC_REFERENCE

config BR2_IPC_REFERENCE_DOORBELL
	bool "c3 ipc doorbell demo"
	help
	  c3 ipc doorbell demo application

endif
```

## buildroot/buildroot/package/amlogic/ipc/ipc-rtsp-server/Config.in
```kconfig
config BR2_PACKAGE_IPC_RTSP_SERVER
	bool "ipc rtsp server"
	select BR2_PACKAGE_IPC_SDK
	help
	  ipc rtsp server library
```

## buildroot/buildroot/package/amlogic/ipc/ipc-sdk/Config.in
```kconfig
menu "ipc sdk"
config BR2_PACKAGE_IPC_SDK
	bool "ipc sdk"
	select BR2_PACKAGE_JPEG
	select BR2_PACKAGE_LIBJPEG
	select BR2_PACKAGE_LIBPNG
	select BR2_PACKAGE_ALSA_LIB
	select BR2_PACKAGE_FDK_AAC
	select BR2_PACKAGE_FREETYPE
	select BR2_PACKAGE_SPEEXDSP
	select BR2_PACKAGE_AML_LIBGE2D
	select BR2_PACKAGE_AML_LIBGDC
	select BR2_PACKAGE_AML_LIBION
	select BR2_PACKAGE_LIBVPCODEC if !BR2_PACKAGE_AML_SOC_USE_MULTIENC
	select BR2_PACKAGE_LIBVPHEVCODEC if !BR2_PACKAGE_AML_SOC_USE_MULTIENC
	select BR2_PACKAGE_LIBMULTIENC if BR2_PACKAGE_AML_SOC_USE_MULTIENC
	select BR2_PACKAGE_LIBGPIOD
	select BR2_PACKAGE_LIBGPIOD_TOOLS
	select BR2_PACKAGE_LIBFUSE
	select BR2_PACKAGE_IPC_SQE
	help
	  ipc sdk

config BR2_PACKAGE_IPC_SDK_BUILD_EXAMPLE
	bool "build with examples"
    select BR2_PACKAGE_GSTREAMER1
    select BR2_PACKAGE_GST1_RTSP_SERVER
    select BR2_PACKAGE_GST1_PLUGINS_BASE_PLUGIN_APP
    select BR2_PACKAGE_LIBWEBSOCKETS
    select BR2_PACKAGE_AML_NN_DETECT
	default n
	help
	  build with examples

config BR2_PACKAGE_IPC_SDK_BUILD_V4L_DEC
	bool "build v4l decoder component"
	default y

config BR2_PACKAGE_IPC_SDK_BUILD_VO_EGL
	bool "build voegl component"
	depends on BR2_PACKAGE_MESON_MALI && BR2_PACKAGE_LIBDRM

endmenu
```

## buildroot/buildroot/package/amlogic/ipc/ipc-sqe/Config.in
```kconfig
config BR2_PACKAGE_IPC_SQE
    bool "ipc sound quality enhancement api library"
    select  BR2_PACKAGE_WEBRTC_APM	
    help
        Support ipc sound quality enhancemnt api library
```

## buildroot/buildroot/package/amlogic/ipc/ipc-webstream-server/Config.in
```kconfig
config BR2_PACKAGE_IPC_WEBSTREAM_SERVER
	bool "ipc webstream server"
	select BR2_PACKAGE_IPC_SDK
	select BR2_PACKAGE_LIBWEBSOCKETS
	help
	  ipc webstream server library
```

## buildroot/buildroot/package/amlogic/ipc/ipc-wifi-qr-connect/Config.in
```kconfig
config BR2_PACKAGE_IPC_WIFI_QR_CONNECT
	bool "ipc wifi qr connect"
	select BR2_PACKAGE_QUIRC
	select BR2_PACKAGE_LIBJPEG
	select BR2_PACKAGE_LIBPNG
	help
	  config and connect wifi with qr code
```

## buildroot/buildroot/package/amlogic/ipc/mbp/Config.in
```kconfig
menu "mbp"
source "package/amlogic/ipc/mbp/osal/Config.in"
source "package/amlogic/ipc/mbp/pmz/Config.in"
source "package/amlogic/ipc/mbp/mbd/Config.in"
source "package/amlogic/ipc/mbp/mbi/Config.in"
source "package/amlogic/ipc/mbp/sample/Config.in"
source "package/amlogic/ipc/mbp/sensor/Config.in"
source "package/amlogic/ipc/mbp/tool/Config.in"
endmenu
```

## buildroot/buildroot/package/amlogic/ipc/mbp/mbd/Config.in
```kconfig
menu "mbd"
source "package/amlogic/ipc/mbp/mbd/mbd-base/Config.in"
source "package/amlogic/ipc/mbp/mbd/mbd-cve/Config.in"
source "package/amlogic/ipc/mbp/mbd/mbd-ge2d/Config.in"
source "package/amlogic/ipc/mbp/mbd/mbd-region/Config.in"
source "package/amlogic/ipc/mbp/mbd/mbd-venc/Config.in"
source "package/amlogic/ipc/mbp/mbd/mbd-vpu/Config.in"
source "package/amlogic/ipc/mbp/mbd/mbd-adla/Config.in"
source "package/amlogic/ipc/mbp/mbd/mbd-dewarp/Config.in"
source "package/amlogic/ipc/mbp/mbd/mbd-camera/Config.in"
source "package/amlogic/ipc/mbp/mbd/mbd-audio/Config.in"
source "package/amlogic/ipc/mbp/mbd/mbd-ppu/Config.in"
endmenu
```

## buildroot/buildroot/package/amlogic/ipc/mbp/mbd/mbd-adla/Config.in
```kconfig
config BR2_PACKAGE_MBD_ADLA
	bool "mbd adla"
	depends on BR2_PACKAGE_LINUX_OSAL
	depends on BR2_PACKAGE_PMZ
	depends on BR2_PACKAGE_MBD_BASE
	help
		ipc mbd adla driver
```
