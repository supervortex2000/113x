## buildroot/buildroot/package/amlogic/ipc/mbp/mbd/mbd-base/Config.in
```kconfig
config BR2_PACKAGE_MBD_BASE
	bool "mbd base"
	depends on BR2_PACKAGE_LINUX_OSAL
	depends on BR2_PACKAGE_PMZ
	help
		ipc mbd base driver
```

## buildroot/buildroot/package/amlogic/ipc/mbp/mbd/mbd-camera/Config.in
```kconfig
config BR2_PACKAGE_MBD_CAMERA
	bool "mbd camera"
	depends on BR2_PACKAGE_LINUX_OSAL
	depends on BR2_PACKAGE_PMZ
	depends on BR2_PACKAGE_MBD_BASE
	depends on BR2_PACKAGE_MBD_DEWARP
	help
		ipc mbd camera driver
```

## buildroot/buildroot/package/amlogic/ipc/mbp/mbd/mbd-cve/Config.in
```kconfig
config BR2_PACKAGE_MBD_CVE
	bool "cve driver"
	depends on BR2_PACKAGE_MBD_BASE
	help
		ipc mbd cve driver
```

## buildroot/buildroot/package/amlogic/ipc/mbp/mbd/mbd-dewarp/Config.in
```kconfig
config BR2_PACKAGE_MBD_DEWARP
	bool "mbd dewarp"
	depends on BR2_PACKAGE_LINUX_OSAL
	depends on BR2_PACKAGE_PMZ
	depends on BR2_PACKAGE_MBD_BASE

	help
		ipc mbd dewarp driver
```

## buildroot/buildroot/package/amlogic/ipc/mbp/mbd/mbd-ge2d/Config.in
```kconfig
config BR2_PACKAGE_MBD_GE2D
	bool "mbd ge2d"
	depends on BR2_PACKAGE_LINUX_OSAL
	depends on BR2_PACKAGE_PMZ
	depends on BR2_PACKAGE_MBD_BASE
	help
		ipc mbd ge2d driver
```

## buildroot/buildroot/package/amlogic/ipc/mbp/mbd/mbd-ppu/Config.in
```kconfig
config BR2_PACKAGE_MBD_PPU
	bool "mbd ppu"
	depends on BR2_PACKAGE_LINUX_OSAL
	depends on BR2_PACKAGE_PMZ
	depends on BR2_PACKAGE_MBD_BASE
	help
		ipc mbd ppu driver
```

## buildroot/buildroot/package/amlogic/ipc/mbp/mbd/mbd-region/Config.in
```kconfig
config BR2_PACKAGE_MBD_REGION
	bool "mbd region"
	depends on BR2_PACKAGE_LINUX_OSAL
	depends on BR2_PACKAGE_PMZ
	depends on BR2_PACKAGE_MBD_BASE
	help
		ipc mbd region driver
```

## buildroot/buildroot/package/amlogic/ipc/mbp/mbd/mbd-venc/Config.in
```kconfig
config BR2_PACKAGE_MBD_VENC
	bool "venc driver"
	depends on BR2_PACKAGE_MBD_BASE
	help
		ipc mbd venc driver
```

## buildroot/buildroot/package/amlogic/ipc/mbp/mbd/mbd-vpu/Config.in
```kconfig
config BR2_PACKAGE_MBD_VPU
	bool "mbd vpu"
	depends on BR2_PACKAGE_LINUX_OSAL
	depends on BR2_PACKAGE_MBD_BASE
	help
		ipc mbd vpu driver
```

## buildroot/buildroot/package/amlogic/ipc/mbp/mbi/Config.in
```kconfig
menu "mbi"
config BR2_PACKAGE_MBI
	bool "mbi"
    depends on BR2_PACKAGE_MBD_DEWARP
    depends on BR2_PACKAGE_MBD_GE2D
    depends on BR2_PACKAGE_MBD_REGION
    depends on BR2_PACKAGE_MBD_BASE
    depends on BR2_PACKAGE_MBD_CVE
    depends on BR2_PACKAGE_PMZ
    depends on BR2_PACKAGE_MBD_CAMERA
    depends on BR2_PACKAGE_MBD_PPU
	help
	  media business interface
endmenu
```

## buildroot/buildroot/package/amlogic/ipc/mbp/mbp_cva/Config.in
```kconfig
menu "cvs"
config BR2_PACKAGE_SAMPLE
	bool "cvs"
    depends on BR2_PACKAGE_MBI
	help
	   cvs
endmenu
```

## buildroot/buildroot/package/amlogic/ipc/mbp/osal/linux-osal/Config.in
```kconfig
config BR2_PACKAGE_LINUX_OSAL
	bool "linux-osal"
	depends on BR2_LINUX_KERNEL
	help
	  linux osal driver
```

## buildroot/buildroot/package/amlogic/ipc/mbp/pmz/Config.in
```kconfig
config BR2_PACKAGE_PMZ
	bool "mbp pmz"
	depends on BR2_PACKAGE_LINUX_OSAL
	help
	  mbp pmz driver
```

## buildroot/buildroot/package/amlogic/ipc/mbp/sample/Config.in
```kconfig
menu "sample"
config BR2_PACKAGE_SAMPLE
	bool "mbi sample"
    depends on BR2_PACKAGE_MBI
    depends on BR2_PACKAGE_SENSOR
	help
	   sample
endmenu
```

## buildroot/buildroot/package/amlogic/ipc/mbp/sensor/Config.in
```kconfig
config BR2_PACKAGE_SENSOR
	bool "sensor"
    depends on BR2_PACKAGE_MBD_BASE
    depends on BR2_PACKAGE_PMZ
    depends on BR2_PACKAGE_MBD_CAMERA
    depends on BR2_PACKAGE_MBI
    help
	  media business interface sensor
```

## buildroot/buildroot/package/amlogic/ipc/mbp/tool/Config.in
```kconfig
config BR2_PACKAGE_TOOL
	bool "tool"
    depends on BR2_PACKAGE_MBI
	help
	  C3 tools
```

## buildroot/buildroot/package/amlogic/ipc/onvif-wsdd/Config.in
```kconfig
config BR2_PACKAGE_ONVIF_WSDD
  bool "onvif wsdd package"
  select BR2_PACKAGE_IPC_PROPERTY
  help
     onvif wsdd server
```

## buildroot/buildroot/package/amlogic/ipc/webrtc-apm/Config.in
```kconfig
config BR2_PACKAGE_WEBRTC_APM
    bool "Webrtc audio processing module library"
    default n
    help
        Support webrtc Audio processing module library
```

## buildroot/buildroot/package/amlogic/libaudioeffect/Config.in
```kconfig
config BR2_PACKAGE_LIBAUDIOEFFECT
        bool "libaudioeffect"
        select BR2_PACKAGE_AML_AMAUDIOUTILS
        help
          Audio Effect Library
```

## buildroot/buildroot/package/amlogic/libbinder/Config.in
```kconfig
config BR2_PACKAGE_LIBBINDER
    bool "aml commomlib libbinder"
    depends on BR2_LINUX_KERNEL
    select BR2_PACKAGE_LIBLOG
    help
        Enable libbinder for ipc using
```

## buildroot/buildroot/package/amlogic/libdrm-meson/Config.in
```kconfig
config BR2_PACKAGE_LIBDRM_MESON
        bool "libdrm_meson"
	select BR2_PACKAGE_LIBDRM
        help
          libdrm_meson library, provide alloc buf and post buf api.
```

## buildroot/buildroot/package/amlogic/libpeer/Config.in
```kconfig
config BR2_PACKAGE_LIBPEER
	bool "libpeer"
	select BR2_PACKAGE_OPENSSL
	help
		libpeer.

config BR2_PACKAGE_LIBPEER_SITE
    string "libpeer path"
    default "$(TOPDIR)/../multimedia/libpeer"
```

## buildroot/buildroot/package/amlogic/load_eq_drc/Config.in
```kconfig
config BR2_PACKAGE_LOAD_EQ_DRC
    bool "LOAD_EQ_DRC"
    help
      Load EQ&DRC params
```

## buildroot/buildroot/package/amlogic/lvgl-app/Config.in
```kconfig
config BR2_PACKAGE_LVGL_APP
    bool "lvgl app"
    help
      Use lvgl to build GUI application.
config BR2_PACKAGE_LVGL_DEMOS
    bool "lvgl demos"
    select BR2_PACKAGE_LVGL_APP
    help
      Enable lvgl demos.
```
