## buildroot/buildroot/package/amlogic/lvmedia_tsplayer/Config.in
```kconfig
config BR2_PACKAGE_LVMEDIA_TSPLAYER
    bool "lvmedia_tsplayer"
    help
        lvmedia_tsplayer src
```

## buildroot/buildroot/package/amlogic/mtk/mtk7661/Config.in
```kconfig
config BR2_PACKAGE_MTK7661
	bool "mt7661"
	depends on BR2_LINUX_KERNEL
	help
	  mt7661 driver

config BR2_PACKAGE_MTK7661_GIT_VERSION
	string "mt7661 branch"
	depends on BR2_PACKAGE_MTK7661
	help
		Branch for mt7661

config BR2_PACKAGE_MTK7661_GIT_REPO_URL
	string "mt7661 git"
	depends on BR2_PACKAGE_MTK7661
	help
		mt7661 git

config BR2_PACKAGE_MTK7661_LOCAL
	bool "mt7661 local"
	help
		mt7661 local

config BR2_PACKAGE_MTK7661_LOCAL_PATH
	string "mt7661 local path"
	depends on BR2_PACKAGE_MTK7661_LOCAL
	help
		mt7661 local path

config BR2_PACKAGE_MTK7661_STANDALONE
	bool "standalone kernel module"
	depends on BR2_PACKAGE_MTK7661
	help
	  compile ko directly
```

## buildroot/buildroot/package/amlogic/multimedia/Config.in
```kconfig
menu "Audio and video applications"
source "package/amlogic/multimedia/alsa-plugins/Config.in"
source "package/amlogic/multimedia/X-amaudio/Config.in"
source "package/amlogic/multimedia/X-audiocapture/Config.in"
source "package/amlogic/multimedia/X-mediasupport/Config.in"
source "package/amlogic/multimedia/dolby-atmos-release/Config.in"
source "package/amlogic/multimedia/dolby-ms12-release/Config.in"
source "package/amlogic/multimedia/dts-release/Config.in"
source "package/amlogic/multimedia/v4l2-uvm-test/Config.in"
source "package/amlogic/multimedia/avsync-lib/Config.in"

# Gstreamer 0.10.x & Plugins
source "package/amlogic/multimedia/X-gst-fluendo-mpegdemux/Config.in"
source "package/amlogic/multimedia/X-gst-aml-plugins/Config.in"
source "package/amlogic/multimedia/gst-aml-plugins1/Config.in"
source "package/amlogic/multimedia/gst-aml-drm-plugins1/Config.in"
source "package/amlogic/multimedia/gst-aml-drmbufferpool1/Config.in"
source "package/amlogic/multimedia/X-gst-app/Config.in"

source "package/amlogic/multimedia/libplayer/Config.in"
source "package/amlogic/multimedia/X-wifidisplay/Config.in"
source "package/amlogic/multimedia/mediahal-sdk/Config.in"
#source "package/amlogic/multimedia/test_tool/spdif_in_dd_decoder/Config.in"

# secure video firmware load
source "package/amlogic/multimedia/secfirmload/Config.in"

# hal audio
source "package/amlogic/multimedia/aml-halaudio/Config.in"
source "package/amlogic/multimedia/audio_effects/Config.in"

# drm prebuild
source "package/amlogic/multimedia/widevine-bin/Config.in"
source "package/amlogic/multimedia/playready-bin/Config.in"
source "package/amlogic/multimedia/libsecmem-bin/Config.in"
source "package/amlogic/multimedia/youtubesign-bin/Config.in"
source "package/amlogic/multimedia/libwfd_hdcp-bin/Config.in"
source "package/amlogic/multimedia/cleartvp-bin/Config.in"
source "package/amlogic/multimedia/netflix-ta-bin/Config.in"
endmenu
```

## buildroot/buildroot/package/amlogic/multimedia/audio_effects/Config.in
```kconfig
config BR2_PACKAGE_AUDIO_EFFECTS
    bool "AML_EQ_DRC_EFFECTS"
    help
     AML_EQ_DRC_EFFECTS
```

## buildroot/buildroot/package/amlogic/multimedia/dolby-atmos-release/Config.in
```kconfig
config BR2_PACKAGE_DOLBY_ATMOS_RELEASE
	bool "dolby-atmos-release"
	help
	  Dolby Atmos Release
```

## buildroot/buildroot/package/amlogic/multimedia/dolby-ms12-release/Config.in
```kconfig
config BR2_PACKAGE_DOLBY_MS12_RELEASE
	bool "dolby_ms12_release"
	help
	  Dolby MS12 release
```

## buildroot/buildroot/package/amlogic/multimedia/libplayer/Config.in
```kconfig
config BR2_PACKAGE_LIBPLAYER
        bool "libplayer"
        select BR2_PACKAGE_ALSA_LIB
        select BR2_PACKAGE_ZLIB
        select BR2_PACKAGE_LIBCURL
        select BR2_PACKAGE_DTV_AUDIO_UTILS
        help
          amlogic media player library.

          http://openlinux.amlogic.com

config BR2_PACKAGE_LIBPLAYER_BASE_LIBS
	bool "libplayer_player"
	default n
	depends on BR2_PACKAGE_LIBPLAYER
	help
	  only enable libplayer building for base libs
```

## buildroot/buildroot/package/amlogic/multimedia/libsecmem-bin/Config.in
```kconfig
config BR2_PACKAGE_LIBSECMEM_BIN
        bool "libsecmem"
        select BR2_PACKAGE_TDK
        select BR2_PACKAGE_MEDIAHAL_SDK
        select BR2_PACKAGE_MEDIAHAL_SDK_RESMAN
        help
          libsecmem files.

          http://openlinux.amlogic.com
```

## buildroot/buildroot/package/amlogic/multimedia/mediahal-sdk/Config.in
```kconfig
menuconfig BR2_PACKAGE_MEDIAHAL_SDK
	bool "mediahal_sdk"
	help
	    amlogic mediahal_sdk library.
	    http://openlinux.amlogic.com

if BR2_PACKAGE_MEDIAHAL_SDK

config BR2_PACKAGE_MEDIAHAL_SDK_RESMAN
	bool "resman"
	help
	  resource manager

config BR2_PACKAGE_MEDIAHAL_SDK_VIDEODEC
	bool "videodec"
	select BR2_PACKAGE_LIBEVENT
	help
	  videodec

config BR2_PACKAGE_MEDIAHAL_SDK_MEDIASYNC
	bool "mediasync"
	help
	  mediasync

config BR2_PACKAGE_MEDIAHAL_SDK_TSPLAYER
	bool "tsplayer"
	select BR2_PACKAGE_MEDIAHAL_SDK_RESMAN
	select BR2_PACKAGE_MEDIAHAL_SDK_VIDEODEC
	select BR2_PACKAGE_MEDIAHAL_SDK_MEDIASYNC
	help
	  tsplayer

endif
```

## buildroot/buildroot/package/amlogic/multimedia/netflix-ta-bin/Config.in
```kconfig
config BR2_PACKAGE_NETFLIX_TA_BIN
        bool "netflix_ta"
        select BR2_PACKAGE_TDK
        help
          netflix ta.

          http://openlinux.amlogic.com
```

## buildroot/buildroot/package/amlogic/multimedia/playready-bin/Config.in
```kconfig
config BR2_PACKAGE_PLAYREADY_BIN
        bool "playready prebuilt"
        select BR2_PACKAGE_TDK
        help
          playready prebuilt files.

config BR2_PACKAGE_PLAYREADY_BIN_VERSION
        string "playready prebuild version"
        default ""
        help
          playready prebuilt version
```

## buildroot/buildroot/package/amlogic/opensc/Config.in
```kconfig
config BR2_PACKAGE_OPENSC
	bool "OPENSC"
	select BR2_PACKAGE_OPENSSL
	help
		OPENSC.

config BR2_PACKAGE_OPENSC_SITE
    string "OpenSC path"
    default "$(TOPDIR)/../multimedia/OpenSC"
```

## buildroot/buildroot/package/amlogic/realtek/rtk8188ftv/Config.in
```kconfig
config BR2_PACKAGE_RTK8188FTV
	bool "rtk8188ftv"
	depends on BR2_LINUX_KERNEL	
	help
	  rtk8188ftv driver

config BR2_PACKAGE_RTK8188FTV_GIT_VERSION
	string "rtk8188ftv branch"
	depends on BR2_PACKAGE_RTK8188FTV
	help
		Branch for rtk8188ftv

config BR2_PACKAGE_RTK8188FTV_GIT_REPO_URL
	string "rtk8188ftv git"
	depends on BR2_PACKAGE_RTK8188FTV
	help
		rtk8188ftv git

config BR2_PACKAGE_RTK8188FTV_LOCAL
	bool "rtk8188ftv local"
	help
		rtk8188ftv local

config BR2_PACKAGE_RTK8188FTV_LOCAL_PATH
	string "rtk8188ftv local path"
	depends on BR2_PACKAGE_RTK8188FTV_LOCAL
	help
		rtk8188ftv local path

config BR2_PACKAGE_RTK8188FTV_STANDALONE
	bool "standalone kernel module"
	depends on BR2_PACKAGE_RTK8188FTV
	help
	  compile ko directly
```

## buildroot/buildroot/package/amlogic/realtek/rtk8188gtv/Config.in
```kconfig
config BR2_PACKAGE_RTK8188GTV
	bool "rtk8188gtv"
	depends on BR2_LINUX_KERNEL
	help
	  rtk8188gtv driver

config BR2_PACKAGE_RTK8188GTV_GIT_VERSION
	string "rtk8188gtv branch"
	depends on BR2_PACKAGE_RTK8188GTV
	help
		Branch for rtk8188gtv

config BR2_PACKAGE_RTK8188GTV_GIT_REPO_URL
	string "rtk8188gtv git"
	depends on BR2_PACKAGE_RTK8188GTV
	help
		rtk8188gtv git

config BR2_PACKAGE_RTK8188GTV_LOCAL
	bool "rtk8188gtv local"
	help
		rtk8188gtv local

config BR2_PACKAGE_RTK8188GTV_LOCAL_PATH
	string "rtk8188gtv local path"
	depends on BR2_PACKAGE_RTK8188GTV_LOCAL
	help
		rtk8188gtv local path

config BR2_PACKAGE_RTK8188GTV_STANDALONE
	bool "standalone kernel module"
	depends on BR2_PACKAGE_RTK8188GTV
	help
	  compile ko directly
```

## buildroot/buildroot/package/amlogic/realtek/rtk8723du/Config.in
```kconfig
config BR2_PACKAGE_RTK8723DU
	bool "rtk8723DU"
	depends on BR2_LINUX_KERNEL
	help
	  rtk8723DU driver

config BR2_PACKAGE_RTK8723DU_GIT_VERSION
	string "rtk8723DU branch"
	depends on BR2_PACKAGE_RTK8723DU
	help
		Branch for rtk8723DU

config BR2_PACKAGE_RTK8723DU_GIT_REPO_URL
	string "rtk8723DU git"
	depends on BR2_PACKAGE_RTK8723DU
	help
		rtk8723DU git

config BR2_PACKAGE_RTK8723DU_LOCAL
	bool "rtk8723DU local"
	help
		rtk8723DU local

config BR2_PACKAGE_RTK8723DU_LOCAL_PATH
	string "rtk8723DU local path"
	depends on BR2_PACKAGE_RTK8723DU_LOCAL
	help
		rtk8723DU local path

config BR2_PACKAGE_RTK8723DU_STANDALONE
	bool "standalone kernel module"
	depends on BR2_PACKAGE_RTK8723DU
	help
	  compile ko directly
```

## buildroot/buildroot/package/amlogic/realtek/rtk8821cu/Config.in
```kconfig
config BR2_PACKAGE_RTK8821CU
	bool "rtk8821cu"
	depends on BR2_LINUX_KERNEL
	help
	  rtk8821cu driver

config BR2_PACKAGE_RTK8821CU_GIT_VERSION
	string "rtk8821cu branch"
	depends on BR2_PACKAGE_RTK8821CU
	help
	  Branch for rtk8821cu

config BR2_PACKAGE_RTK8821CU_GIT_REPO_URL
	string "rtk8821cu git"
	depends on BR2_PACKAGE_RTK8821CU
	help
		rtk8821cu git

config BR2_PACKAGE_RTK8821CU_LOCAL
	bool "rtk8821cu local"
	help
		rtk8821cu local

config BR2_PACKAGE_RTK8821CU_LOCAL_PATH
	string "rtk8821cu local path"
	depends on BR2_PACKAGE_RTK8821CU_LOCAL
	help
		rtk8821cu local path

config BR2_PACKAGE_RTK8821CU_STANDALONE
	bool "standalone kernel module"
	depends on BR2_PACKAGE_RTK8821CU
	help
	  compile ko directly
```

## buildroot/buildroot/package/amlogic/realtek/rtk8822cu/Config.in
```kconfig
config BR2_PACKAGE_RTK8822CU
	bool "rtk8822cu"
	depends on BR2_LINUX_KERNEL
	help
	  rtk8822cu driver

config BR2_PACKAGE_RTK8822CU_GIT_VERSION
	string "rtk8822cu branch"
	depends on BR2_PACKAGE_RTK8822CU
	help
	  Branch for rtk8822cu

config BR2_PACKAGE_RTK8822CU_GIT_REPO_URL
	string "rtk8822cu git"
	depends on BR2_PACKAGE_RTK8822CU
	help
		rtk8822cu git

config BR2_PACKAGE_RTK8822CU_LOCAL
	bool "rtk8822cu local"
	help
		rtk8822cu local

config BR2_PACKAGE_RTK8822CU_LOCAL_PATH
	string "rtk8822cu local path"
	depends on BR2_PACKAGE_RTK8822CU_LOCAL
	help
		rtk8822cu local path

config BR2_PACKAGE_RTK8822CU_STANDALONE
	bool "standalone kernel module"
	depends on BR2_PACKAGE_RTK8822CU
	help
	  compile ko directly
```

## buildroot/buildroot/package/amlogic/softhsmv2/Config.in
```kconfig
config BR2_PACKAGE_SOFTHSMV2
	bool "softhsmv2"
	select BR2_PACKAGE_OPENSSL
	help
		SOFTHSMV2.

config BR2_PACKAGE_SOFTHSMV2_SITE
    string "softhsmv2 path"
    default "$(TOPDIR)/../multimedia/SoftHSMv2"
```

## buildroot/buildroot/package/amlogic/spi_led/Config.in
```kconfig
config BR2_PACKAGE_SPI_LED
    bool "spi_led"
    help
	  SPI LED testing utility (using spidev driver).

	  This package builds and installs the userspace 'spi_led'
	  command. It is up to the user to ensure that the kernel
	  configuration has all suitable options enabled to allow a
	  proper operation of 'spi_led'.

	  The version used is based on your toolchain headers version,
	  if it's older than 3.15 then 3.0 is used, otherwise 3.15
	  is used.
	  This means you won't have quad-pumped SPI support if your
	  toolchain is too old.

	  https://www.kernel.org/doc/html/latest/spi/index.html
```

## buildroot/buildroot/package/amlogic/sraf-browser-sdk/Config.in
```kconfig
config BR2_PACKAGE_SRAF_BROWSER_SDK
	bool  "sraf_browser_sdk"
	help
        Sraf_Browser
```

## buildroot/buildroot/package/amlogic/tdk-driver/Config.in
```kconfig
config BR2_PACKAGE_TDK_DRIVER
	bool "tdk driver"
	depends on BR2_PACKAGE_TDK
	help
	  tdk driver
```

## buildroot/buildroot/package/amlogic/tdk/Config.in
```kconfig
config BR2_PACKAGE_TDK
	bool "tdk driver and lib"
	depends on BR2_LINUX_KERNEL
    select BR2_PACKAGE_TDK_DRIVER
	help
	  tdk driver and lib

config BR2_PACKAGE_TDK_GIT_VERSION
	string "tdk driver and lib branch"
	depends on BR2_PACKAGE_TDK
	help
		Branch for tdk driver and lib git

config BR2_PACKAGE_TDK_GIT_REPO_URL
	string "tdk driver and lib git"
	depends on BR2_PACKAGE_TDK
	help
		tdk driver and lib git

config BR2_PACKAGE_TDK_LOCAL_PATH
	string "tdk driver and lib local path"
	depends on BR2_PACKAGE_TDK
	help
		tdk driver and lib local path

config BR2_PACKAGE_TDK_VERSION
	string "TDK Version, 2.4 or 3.8"
	depends on BR2_PACKAGE_TDK
	default "2.4"
	help
		Current TDK Version
```
