## buildroot/buildroot/package/amlogic/test-tools/Config.in
```kconfig
config BR2_PACKAGE_TEST_TOOLS
	bool  "test tools"
	help
		function test for cpu & ddr & nand & emmc & usb & gpio & IR & wifi...

config BR2_PACKAGE_SOUNDBAR_TEST
	bool  "soundbar test"
	depends on BR2_PACKAGE_TEST_TOOLS
	default n
	help
		function test for soundbar
```

## buildroot/buildroot/package/amlogic/tuner/Config.in
```kconfig
config BR2_PACKAGE_TUNER
	bool "tuner driver git repo"
	depends on BR2_LINUX_KERNEL	
	help
	  The git of tuner driver git repo

config BR2_PACKAGE_TUNER_GIT_VERSION
	string "tuner branch" 
	depends on BR2_PACKAGE_TUNER
	help
	  the branch of tuner driver

config BR2_PACKAGE_TUNER_GIT_URL
	string "tuner driver git repo url"
	depends on BR2_PACKAGE_TUNER
	help
	  the URL of tuner driver git repo

config BR2_PACKAGE_TUNER_LOCAL
	bool "tuner driver local"
	depends on BR2_PACKAGE_TUNER
	help
		tuner local

config BR2_PACKAGE_TUNER_LOCAL_PATH
	string "tuner local path"
	depends on BR2_PACKAGE_TUNER_LOCAL
	depends on BR2_PACKAGE_TUNER
	help
		tuner local path

config BR2_PACKAGE_TUNER_STANDALONE
	bool "standalone kernel module"
	depends on BR2_PACKAGE_TUNER
	help
	  compile ko directly
```

## buildroot/buildroot/package/amlogic/v4l2-uvm-vdin-test/Config.in
```kconfig
config BR2_PACKAGE_V4L2_UVM_VDIN_TEST
        bool "v4l2_uvm_vdin_test"
        select BR2_PACKAGE_LIBDRM
        select BR2_PACKAGE_FFMPEG
        select BR2_PACKAGE_AV_SYNC_LIB
        select BR2_PACKAGE_AML_TVSERVER
        help
          Test application for v4l2 decoder using DRM-GEM UVM buffer.
          http://openlinux.amlogic.com
```

## buildroot/buildroot/package/amlogic/video-algorithm/Config.in
```kconfig
menuconfig BR2_PACKAGE_VIDEO_ALGORITHM
	bool "amlogic video algorithm driver"
	help
	  aml video algorithm driver

if BR2_PACKAGE_VIDEO_ALGORITHM

config BR2_PACKAGE_VIDEO_ALGORITHM_DNLP
	bool "aml video algorithm dnlp driver"
	default n
	help
	  enable aml video algorithm dnlp driver

config BR2_PACKAGE_VIDEO_ALGORITHM_DHR10_TMO
	bool "aml video algorithm hdr10_tmo driver"
	default n
	help
	  enable aml video algorithm hdr10_tmo driver

config BR2_PACKAGE_VIDEO_ALGORITHM_CABC_AAD
	bool "aml video algorithm cabc_aad driver"
	default n
	help
	  enable aml video algorithm cabc_aad driver

config BR2_PACKAGE_VIDEO_ALGORITHM_LDIM
	bool "aml video algorithm ldim driver"
	default n
	help
	  enable aml video algorithm ldim driver

endif
```

## buildroot/buildroot/package/amlogic/video-encoder/Config.in
```kconfig
config BR2_PACKAGE_C3_VIDEO_ENCODER
	bool "c3 IPC video encoder git repo"
	depends on BR2_LINUX_KERNEL	
	help
	  The git of C3 IPC video encoder git repo

config BR2_PACKAGE_C3_VIDEO_ENCODER_VERSION
	string "C3 IPC video encoder branch" 
	depends on BR2_PACKAGE_C3_VIDEO_ENCODER
	help
	  the branch of C3 IPC video encoder

config BR2_PACKAGE_C3_VIDEO_ENCODER_GIT_VERSION
        string "C3 IPC video encoder branch"
        depends on BR2_PACKAGE_C3_VIDEO_ENCODER
        help
          Branch for C3 video encoder

config BR2_PACKAGE_C3_VIDEO_ENCODER_GIT_REPO_URL
        string "C3 IPC video encoder git"
        depends on BR2_PACKAGE_C3_VIDEO_ENCODER
        help
          C3 video encoder git

config BR2_PACKAGE_C3_VIDEO_ENCODER_LOCAL
        bool "c3 video encoder local"
        help
          C3 video encoder local

config BR2_PACKAGE_C3_VIDEO_ENCODER_LOCAL_PATH
        string "c3 video encoder local path"
        depends on BR2_PACKAGE_C3_VIDEO_ENCODER_LOCAL
        help
          C3 video encoder local path
```

## buildroot/buildroot/package/amlogic/westeros-rawsink/Config.in
```kconfig
config BR2_PACKAGE_WESTEROS_RAWSINK
	bool "westeros-rawsink"
	select BR2_PACKAGE_WAYLAND
	select BR2_PACKAGE_WAYLAND_PROTOCOLS
	help
	  http://wayland.freedesktop.org/
```

## buildroot/buildroot/package/amlogic/wpe/Config.in
```kconfig
# WPE Framework
source "package/amlogic/wpe/wpeframework/Config.in"

# WPE Framework Generators
source "package/amlogic/wpe/wpeframework-tools/Config.in"

# WPE WebKit
source "package/amlogic/wpe/wpewebkit/Config.in"

if BR2_PACKAGE_WPEWEBKIT
#source "package/amlogic/wpe/wpebackend/Config.in"
source "package/amlogic/wpe/wpebackend-rdk/Config.in"
source "package/amlogic/wpe/wpelauncher/Config.in"
endif
source "package/amlogic/wpe/rdkservices/Config.in"
source "package/amlogic/wpe/rdkshell/Config.in"





source "package/amlogic/aml_systemd/Config.in"
#source "package/amlogic/wpe/iarmbus/Config.in"
#source "package/amlogic/wpe/devicesettings-hal-headers/Config.in"
#source "package/amlogic/wpe/devicesettings-hal-llama/Config.in"
#source "package/amlogic/wpe/devicesettings/Config.in"
#source "package/amlogic/wpe/iarmmgrs-hal-headers/Config.in"
#source "package/amlogic/wpe/iarmmgrs-hal-llama/Config.in"
#source "package/amlogic/wpe/iarmmgrs/Config.in"
#source "package/amlogic/wpe/hdmicec-header/Config.in"
#source "package/amlogic/wpe/hdmicec-hal-llama/Config.in"
#source "package/amlogic/wpe/hdmicec/Config.in"
#source "package/amlogic/wpe/rfc/Config.in"
#source "package/amlogic/wpe/fpdriverlib/Config.in"
#source "package/amlogic/wpe/log4c/Config.in"
#source "package/amlogic/wpe/tr69hostif-headers/Config.in"
#source "package/amlogic/wpe/trower-base64/Config.in"
#source "package/amlogic/wpe/wdmp-c/Config.in"
#source "package/amlogic/wpe/rdk-logger/Config.in"
#source "package/amlogic/wpe/log4c/Config.in"

# RDK Cobalt and Cobalt Plugin
source "package/amlogic/wpe/rdkcobalt/Config.in"
source "package/amlogic/wpe/rdkcobalt-plugin/Config.in"
source "package/amlogic/wpe/wpeframework-cdmi/Config.in"
```

## buildroot/buildroot/package/amlogic/wpe/audiocapturemgr/Config.in
```kconfig
config BR2_PACKAGE_AUDIOCAPTUREMGR
	bool "audiocapturemgr"
	help
	   rdk audiocapturemgr
```

## buildroot/buildroot/package/amlogic/wpe/devicesettings-hal-amlogic/Config.in
```kconfig
menuconfig BR2_PACKAGE_DEVICESETTINGS-HAL-AMLOGIC
	bool "devicesettings-hal-amlogic"
	help
	   rdk devicesettings-hal-amlogic.
```

## buildroot/buildroot/package/amlogic/wpe/devicesettings-hal-headers/Config.in
```kconfig
menuconfig BR2_PACKAGE_DEVICESETTINGS_HAL_HEADERS
	bool "devicesettings-hal-headers"
	help
	   rdk devicesettings-hal-headers.
```

## buildroot/buildroot/package/amlogic/wpe/devicesettings-hal-llama/Config.in
```kconfig
menuconfig BR2_PACKAGE_DEVICESETTINGS_HAL_LLAMA
	bool "devicesettings-hal-llama"
	select BR2_PACKAGE_DEVICESETTINGS_HAL_HEADERS
	select BR2_PACKAGE_FPDRIVERLIB
	select BR2_PACKAGE_AML_TVSERVER
	help
	   rdk devicesettings-hal-llama .
```

## buildroot/buildroot/package/amlogic/wpe/devicesettings/Config.in
```kconfig
menuconfig BR2_PACKAGE_DEVICESETTINGS
	bool "devicesettings"
	select BR2_PACKAGE_DEVICESETTINGS_HAL_LLAMA
	select BR2_PACKAGE_IARMBUS
	help
	   rdk devicesettings.
```

## buildroot/buildroot/package/amlogic/wpe/fpdriverlib/Config.in
```kconfig
menuconfig BR2_PACKAGE_FPDRIVERLIB
	bool "fpdriverlib"
	help
	   rdk fpdriverlib.
```

## buildroot/buildroot/package/amlogic/wpe/hdmicec-hal-llama/Config.in
```kconfig
menuconfig BR2_PACKAGE_HDMICEC_HAL_LLAMA
	bool "hdmicec-hal-llama"
	select BR2_PACKAGE_HDMICEC_HEADER
	help
	   rdk hdmicec-hal-llama.
```

## buildroot/buildroot/package/amlogic/wpe/hdmicec-header/Config.in
```kconfig
menuconfig BR2_PACKAGE_HDMICEC_HEADER
	bool "hdmicec-header"
	help
	   rdk hdmicec-headers.
```

## buildroot/buildroot/package/amlogic/wpe/hdmicec/Config.in
```kconfig
menuconfig BR2_PACKAGE_HDMICEC
	bool "hdmicec"
	select BR2_PACKAGE_HDMICEC_HAL_LLAMA
	help
	   rdk rdk hdmicec .
```

## buildroot/buildroot/package/amlogic/wpe/iarmbus/Config.in
```kconfig
menuconfig BR2_PACKAGE_IARMBUS
	bool "iarmbas"
	select BR2_PACKAGE_LIBGLIB2
	select B22_PACKAGE_LIBXML2
	select BR2_PACKAGE_DBUS
	select BR2_PACKAGE_LIBPLAYER
	help
	   rdk iarmbas.
```

## buildroot/buildroot/package/amlogic/wpe/iarmmgrs-hal-headers/Config.in
```kconfig
menuconfig BR2_PACKAGE_IARMMGRS_HAL_HEADERS
	bool "iarmmgrs-hal-headers"
	help
	   rdk iarmmgrs-hal-headers.
```

## buildroot/buildroot/package/amlogic/wpe/iarmmgrs-hal-llama/Config.in
```kconfig
menuconfig BR2_PACKAGE_IARMMGRS_HAL_LLAMA
	bool "iarmmgrs-hal-llama"
	select BR2_PACKAGE_IARMMGRS-HAL-HEADERS
	select BR2_PACKAGE_IARMBUS
	help
	   rdk iarmmgrs-hal-llama .
```

## buildroot/buildroot/package/amlogic/wpe/iarmmgrs/Config.in
```kconfig
menuconfig BR2_PACKAGE_IARMMGRS
	bool "iarmmgrs"
	select BR2_PACKAGE_IARMMGRS_HAL_LLAMA
	select BR2_PACKAGE_IARMBUS
	select BR2_PACKAGE_HDMICEC
	select BR2_PACKAGE_RFC
	select BR2_PACKAGE_YAJL
	select BR2_PACKAGE_WDMP_C
	select BR2_PACKAGE_LIBDRM
	select BR2_PACKAGE_AML_SYSTEMD 

	help
	   rdk iarmmgrs
```

## buildroot/buildroot/package/amlogic/wpe/rdk-logger/Config.in
```kconfig
menuconfig BR2_PACKAGE_RDK_LOGGER
	bool "rdk-logger"
	select BR2_PACKAGE_LOG4C
	help
	   rdk logger.
```

## buildroot/buildroot/package/amlogic/wpe/rdkcobalt-plugin/Config.in
```kconfig
config BR2_PACKAGE_RDKCOBALT_PLUGIN
	bool "WPEFrameWork cobalt plugin"
	select RDKCOBALT_MAJOR_VERSION
	#select curl
	help
	   WPEFrameWork Cobalt plugin.


config BR2_PACKAGE_RDKCOBALT_HTMLAPP
	bool "htmlapp base on Cobalt"
	select BR2_PACKAGE_RDKCOBALT_PLUGIN
	help
		HTML app base on Cobalt

if BR2_PACKAGE_RDKCOBALT_HTMLAPP

config BR2_PACKAGE_RDKCOBALT_HTMLAPP_WEBFILEPATH
	string "web_file_path"
    default "/var/www"
	help
	  Local web file path

config BR2_PACKAGE_RDKCOBALT_HTMLAPP_URL
	string "URL"
    default "file:///launcher/launcher.html"
	help
	  Local web file path
endif
```

## buildroot/buildroot/package/amlogic/wpe/rdkcobalt/Config.in
```kconfig
config BR2_PACKAGE_RDKCOBALT
	bool "libcobalt"
	select BR2_PACKAGE_BROWSER_TOOLCHAIN_DEPOT_TOOLS
	select BR2_PACKAGE_BROWSER_TOOLCHAIN_GCC_LINARO_AARCH64 if BR2_aarch64
	select BR2_PACKAGE_BROWSER_TOOLCHAIN_GCC_LINARO_ARMEABIHF if BR2_arm
	#select curl
	help
	   rdk libcobalt.

config BR2_PACKAGE_RDKCOBALT_VERSION
	string "Cobalt version"
	default ""
	help
	  cobalt version

config BR2_PACKAGE_RDKCOBALT_VIDEO_RESOLUTION
	string "Cobalt Video Resolution"
	default "1080p"
	help
	  Cobalt Video Resolution, now current it just support 720p, 1080p, 2160p

config BR2_PACKAGE_RDKCOBALT_NPLB
	bool "nplb"
	default n
	help
	  Enable to build nplb
```

## buildroot/buildroot/package/amlogic/wpe/rdkservices/Config.in
```kconfig
config BR2_PACKAGE_RDKSERVICES
	bool "rdkservices"
	select BR2_PACKAGE_WPEFRAMEWORK
	select BR2_PACKAGE_DEVICESETTINGS
	select BR2_PACKAGE_IARMMGRS
	select BR2_PACKAGE_TROWER_BASE64
	help
	   rdk rdkservices
```
