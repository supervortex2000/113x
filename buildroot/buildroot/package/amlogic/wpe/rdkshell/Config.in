## buildroot/buildroot/package/amlogic/wpe/rdkshell/Config.in
```kconfig
menuconfig BR2_PACKAGE_RDKSHELL
	depends on BR2_PACKAGE_WESTEROS
	bool "rdkshell"
	help
	   rdk shell.
```

## buildroot/buildroot/package/amlogic/wpe/tr69hostif-headers/Config.in
```kconfig
menuconfig BR2_PACKAGE_TR69HOSTIF_HEADERS
	bool "tr69hostif-headers"
	help
	   rdk tr69hostif-headers/.
```

## buildroot/buildroot/package/amlogic/wpe/trower-base64/Config.in
```kconfig
config BR2_PACKAGE_TROWER_BASE64
	bool "trower-base64"
	help
	   rdk trower-base64
```

## buildroot/buildroot/package/amlogic/wpe/wdmp-c/Config.in
```kconfig
menuconfig BR2_PACKAGE_WDMP_C
	bool "wdmp-c"
	select BR2_PACKAGE_CJSON
	help
	    wdmp-c.
```

## buildroot/buildroot/package/amlogic/wpe/webkitbrowser-plugin/Config.in
```kconfig
config BR2_PACKAGE_WEBKITBROWSER_PLUGIN
	bool "webkitbrowser-plugin"
	help
	   rdk webkitbrowser-plugin
```

## buildroot/buildroot/package/amlogic/wpe/wpeframework-cdmi/Config.in
```kconfig
source "package/amlogic/wpe/wpeframework-cdmi/ClearkeyConfig.in"
source "package/amlogic/wpe/wpeframework-cdmi/PlayreadyConfig.in"
source "package/amlogic/wpe/wpeframework-cdmi/WidevineConfig.in"
source "package/amlogic/wpe/wpeframework-cdmi/NagraConfig.in"
source "package/amlogic/wpe/wpeframework-cdmi/NCASConfig.in"
```
